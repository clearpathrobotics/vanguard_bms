VERSION ""

NS_ :

BS_:

BU_: BMS CanAnalyzer Charger ANY BMS CanAnalyzer Charger ANY

VAL_TABLE_ FMI 22 "Data Drifted Low" 21 "Data Drifted High" 20 "Received Network Data In Error" 0 "Above normal (most severe)" 1 "Below normal (most severe)" 2 "Data erratic" 3 "Voltage above normal" 4 "Voltage below normal" 5 "Current below normal" 6 "Current above normal" 7 "Mechanical system not responding" 8 "Abnormal frequency" 9 "Abnormal update rate" 10 "Abnormal rate of change" 11 "Root cause not known" 12 "Bad intelligent device" 13 "Out of calibration" 14 "Special intstructions" 15 "Above normal (least severe)" 16 "Above normal (moderately severe)" 17 "Below normal (least severe)" 18 "Below normal (moderately severe)" 19 "Received network data in error" 31 "Condition Exists" ;
VAL_TABLE_ Ports 21 "Global (All ports)" 0 "Local" ;

BO_ 3221225472 VECTOR__INDEPENDENT_SIG_MSG: 0 Vector__XXX
 SG_ NewSignal_0140 : 32|8@1+ (1,0) [0|0] "" Vector__XXX
 SG_ NewSignal_0004 : 48|8@1+ (1,0) [0|0] "" Vector__XXX
 SG_ CellBalaStatu_01 : 32|16@1+ (1,0) [0|65535] "" Vector__XXX
 SG_ CellBalaStatu_02 : 32|16@1+ (1,0) [0|65535] "" Vector__XXX
 SG_ CellBalaStatu_03 : 32|16@1+ (1,0) [0|65535] "" Vector__XXX
 SG_ CellBalaStatu_04 : 32|16@1+ (1,0) [0|65535] "" Vector__XXX
 SG_ CellBalaStatu_05 : 32|16@1+ (1,0) [0|65535] "" Vector__XXX
 SG_ CellBalaStatu_06 : 32|16@1+ (1,0) [0|65535] "" Vector__XXX
 SG_ CellBalaStatu_07 : 32|16@1+ (1,0) [0|65535] "" Vector__XXX
 SG_ CellBalaStatu_08 : 32|16@1+ (1,0) [0|65535] "" Vector__XXX
 SG_ CellBalaStatu_09 : 32|16@1+ (1,0) [0|65535] "" Vector__XXX
 SG_ CellBalaStatu_10 : 32|16@1+ (1,0) [0|65535] "" Vector__XXX
 SG_ CellBalaStatu_11 : 32|16@1+ (1,0) [0|65535] "" Vector__XXX
 SG_ CellBalaStatu_12 : 32|16@1+ (1,0) [0|65535] "" Vector__XXX
 SG_ CellBalaStatu_13 : 32|16@1+ (1,0) [0|65535] "" Vector__XXX
 SG_ CellBalaStatu_14 : 32|16@1+ (1,0) [0|65535] "" Vector__XXX
 SG_ ChargeVolt1 : 16|16@1+ (1,0) [0|65535] "" Vector__XXX
 SG_ OverrideCommand_14 : 0|8@1+ (1,0) [0|255] "" Vector__XXX
 SG_ OverrideCommand_13 : 0|8@1+ (1,0) [0|255] "" Vector__XXX
 SG_ OverrideCommand_12 : 0|8@1+ (1,0) [0|255] "" Vector__XXX
 SG_ OverrideCommand_11 : 0|8@1+ (1,0) [0|255] "" Vector__XXX
 SG_ OverrideCommand_10 : 0|8@1+ (1,0) [0|255] "" Vector__XXX
 SG_ OverrideCommand_09 : 0|8@1+ (1,0) [0|255] "" Vector__XXX
 SG_ OverrideCommand_08 : 0|8@1+ (1,0) [0|255] "" Vector__XXX
 SG_ OverrideCommand_07 : 0|8@1+ (1,0) [0|255] "" Vector__XXX
 SG_ OverrideCommand_06 : 0|8@1+ (1,0) [0|255] "" Vector__XXX
 SG_ OverrideCommand_05 : 0|8@1+ (1,0) [0|255] "" Vector__XXX
 SG_ OverrideCommand_04 : 0|8@1+ (1,0) [0|255] "" Vector__XXX
 SG_ OverrideCommand_03 : 0|8@1+ (1,0) [0|255] "" Vector__XXX
 SG_ PackCurrentlvl_14 : 48|16@1- (50,-1600000) [0|65535] "mA" Vector__XXX
 SG_ PackVoltagelvl_14 : 32|16@1+ (50,0) [0|65535] "mV" Vector__XXX
 SG_ PackCurrentlvl_13 : 48|16@1- (50,-1600000) [0|65535] "mA" Vector__XXX
 SG_ PackVoltagelvl_13 : 32|16@1+ (50,0) [0|65535] "mV" Vector__XXX
 SG_ PackCurrentlvl_12 : 48|16@1- (50,-1600000) [0|65535] "mA" Vector__XXX
 SG_ PackVoltagelvl_12 : 32|16@1+ (50,0) [0|65535] "mV" Vector__XXX
 SG_ PackCurrentlvl_11 : 48|16@1- (50,-1600000) [0|65535] "mA" Vector__XXX
 SG_ PackVoltagelvl_11 : 32|16@1+ (50,0) [0|65535] "mV" Vector__XXX
 SG_ PackCurrentlvl_10 : 48|16@1- (50,-1600000) [0|65535] "mA" Vector__XXX
 SG_ PackVoltagelvl_10 : 32|16@1+ (50,0) [0|65535] "mV" Vector__XXX
 SG_ PackCurrentlvl_09 : 48|16@1- (50,-1600000) [0|65535] "mA" Vector__XXX
 SG_ PackVoltagelvl_09 : 32|16@1+ (50,0) [0|65535] "mV" Vector__XXX
 SG_ PackCurrentlvl_08 : 48|16@1- (50,-1600000) [0|65535] "mA" Vector__XXX
 SG_ PackVoltagelvl_08 : 32|16@1+ (50,0) [0|65535] "mV" Vector__XXX
 SG_ PackCurrentlvl_07 : 48|16@1- (50,-1600000) [0|65535] "mA" Vector__XXX
 SG_ PackVoltagelvl_07 : 32|16@1+ (50,0) [0|65535] "mV" Vector__XXX
 SG_ PackCurrentlvl_06 : 48|16@1- (50,-1600000) [0|65535] "mA" Vector__XXX
 SG_ PackVoltagelvl_06 : 32|16@1+ (50,0) [0|65535] "mV" Vector__XXX
 SG_ PackCurrentlvl_05 : 48|16@1- (50,-1600000) [0|65535] "mA" Vector__XXX
 SG_ PackVoltagelvl_05 : 32|16@1+ (50,0) [0|65535] "mV" Vector__XXX
 SG_ PackCurrentlvl_04 : 48|16@1- (50,-1600000) [0|65535] "mA" Vector__XXX
 SG_ PackVoltagelvl_04 : 32|16@1+ (50,0) [0|65535] "mV" Vector__XXX
 SG_ PackCurrentlvl_03 : 48|16@1- (50,-1600000) [0|65535] "mA" Vector__XXX
 SG_ PackVoltagelvl_03 : 32|16@1+ (50,0) [0|65535] "mV" Vector__XXX
 SG_ SoC_14 : 0|16@1+ (1,0) [0|120] "%" Vector__XXX
 SG_ SoC_13 : 0|16@1+ (1,0) [0|120] "%" Vector__XXX
 SG_ SoC_12 : 0|16@1+ (1,0) [0|120] "%" Vector__XXX
 SG_ SoC_11 : 0|16@1+ (1,0) [0|120] "%" Vector__XXX
 SG_ SoC_10 : 0|16@1+ (1,0) [0|120] "%" Vector__XXX
 SG_ SoC_09 : 0|16@1+ (1,0) [0|120] "%" Vector__XXX
 SG_ SoC_08 : 0|16@1+ (1,0) [0|120] "%" Vector__XXX
 SG_ SoC_07 : 0|16@1+ (1,0) [0|120] "%" Vector__XXX
 SG_ SoC_06 : 0|16@1+ (1,0) [0|120] "%" Vector__XXX
 SG_ SoC_05 : 0|16@1+ (1,0) [0|120] "%" Vector__XXX
 SG_ SoC_04 : 0|16@1+ (1,0) [0|120] "%" Vector__XXX
 SG_ SoC_03 : 0|16@1+ (1,0) [0|120] "%" Vector__XXX
 SG_ VoltageCell5_14 : 0|16@1+ (1,0) [0|65535] "mV" Vector__XXX
 SG_ VoltageCell6_14 : 16|16@1+ (1,0) [0|65535] "mV" Vector__XXX
 SG_ VoltageCell7_14 : 32|16@1+ (1,0) [0|65535] "mV" Vector__XXX
 SG_ VoltageCell8_14 : 48|16@1+ (1,0) [0|65535] "mV" Vector__XXX
 SG_ VoltageCell5_13 : 0|16@1+ (1,0) [0|65535] "mV" Vector__XXX
 SG_ VoltageCell6_13 : 16|16@1+ (1,0) [0|65535] "mV" Vector__XXX
 SG_ VoltageCell7_13 : 32|16@1+ (1,0) [0|65535] "mV" Vector__XXX
 SG_ VoltageCell8_13 : 48|16@1+ (1,0) [0|65535] "mV" Vector__XXX
 SG_ VoltageCell5_12 : 0|16@1+ (1,0) [0|65535] "mV" Vector__XXX
 SG_ VoltageCell6_12 : 16|16@1+ (1,0) [0|65535] "mV" Vector__XXX
 SG_ VoltageCell7_12 : 32|16@1+ (1,0) [0|65535] "mV" Vector__XXX
 SG_ VoltageCell8_12 : 48|16@1+ (1,0) [0|65535] "mV" Vector__XXX
 SG_ VoltageCell5_11 : 0|16@1+ (1,0) [0|65535] "mV" Vector__XXX
 SG_ VoltageCell6_11 : 16|16@1+ (1,0) [0|65535] "mV" Vector__XXX
 SG_ VoltageCell7_11 : 32|16@1+ (1,0) [0|65535] "mV" Vector__XXX
 SG_ VoltageCell8_11 : 48|16@1+ (1,0) [0|65535] "mV" Vector__XXX
 SG_ VoltageCell5_10 : 0|16@1+ (1,0) [0|65535] "mV" Vector__XXX
 SG_ VoltageCell6_10 : 16|16@1+ (1,0) [0|65535] "mV" Vector__XXX
 SG_ VoltageCell7_10 : 32|16@1+ (1,0) [0|65535] "mV" Vector__XXX
 SG_ VoltageCell8_10 : 48|16@1+ (1,0) [0|65535] "mV" Vector__XXX
 SG_ VoltageCell5_09 : 0|16@1+ (1,0) [0|65535] "mV" Vector__XXX
 SG_ VoltageCell6_09 : 16|16@1+ (1,0) [0|65535] "mV" Vector__XXX
 SG_ VoltageCell7_09 : 32|16@1+ (1,0) [0|65535] "mV" Vector__XXX
 SG_ VoltageCell8_09 : 48|16@1+ (1,0) [0|65535] "mV" Vector__XXX
 SG_ VoltageCell5_08 : 0|16@1+ (1,0) [0|65535] "mV" Vector__XXX
 SG_ VoltageCell6_08 : 16|16@1+ (1,0) [0|65535] "mV" Vector__XXX
 SG_ VoltageCell7_08 : 32|16@1+ (1,0) [0|65535] "mV" Vector__XXX
 SG_ VoltageCell8_08 : 48|16@1+ (1,0) [0|65535] "mV" Vector__XXX
 SG_ VoltageCell5_07 : 0|16@1+ (1,0) [0|65535] "mV" Vector__XXX
 SG_ VoltageCell6_07 : 16|16@1+ (1,0) [0|65535] "mV" Vector__XXX
 SG_ VoltageCell7_07 : 32|16@1+ (1,0) [0|65535] "mV" Vector__XXX
 SG_ VoltageCell8_07 : 48|16@1+ (1,0) [0|65535] "mV" Vector__XXX
 SG_ VoltageCell5_06 : 0|16@1+ (1,0) [0|65535] "mV" Vector__XXX
 SG_ VoltageCell6_06 : 16|16@1+ (1,0) [0|65535] "mV" Vector__XXX
 SG_ VoltageCell7_06 : 32|16@1+ (1,0) [0|65535] "mV" Vector__XXX
 SG_ VoltageCell8_06 : 48|16@1+ (1,0) [0|65535] "mV" Vector__XXX
 SG_ VoltageCell5_05 : 0|16@1+ (1,0) [0|65535] "mV" Vector__XXX
 SG_ VoltageCell6_05 : 16|16@1+ (1,0) [0|65535] "mV" Vector__XXX
 SG_ VoltageCell7_05 : 32|16@1+ (1,0) [0|65535] "mV" Vector__XXX
 SG_ VoltageCell8_05 : 48|16@1+ (1,0) [0|65535] "mV" Vector__XXX
 SG_ VoltageCell5_04 : 0|16@1+ (1,0) [0|65535] "mV" Vector__XXX
 SG_ VoltageCell6_04 : 16|16@1+ (1,0) [0|65535] "mV" Vector__XXX
 SG_ VoltageCell7_04 : 32|16@1+ (1,0) [0|65535] "mV" Vector__XXX
 SG_ VoltageCell8_04 : 48|16@1+ (1,0) [0|65535] "mV" Vector__XXX
 SG_ VoltageCell5_03 : 0|16@1+ (1,0) [0|65535] "mV" Vector__XXX
 SG_ VoltageCell6_03 : 16|16@1+ (1,0) [0|65535] "mV" Vector__XXX
 SG_ VoltageCell7_03 : 32|16@1+ (1,0) [0|65535] "mV" Vector__XXX
 SG_ VoltageCell8_03 : 48|16@1+ (1,0) [0|65535] "mV" Vector__XXX
 SG_ VoltageCell13_14 : 0|16@1+ (1,0) [0|65535] "mV" Vector__XXX
 SG_ VoltageCell14_14 : 16|16@1+ (1,0) [0|65535] "mV" Vector__XXX
 SG_ VoltageCell13_13 : 0|16@1+ (1,0) [0|65535] "mV" Vector__XXX
 SG_ VoltageCell14_13 : 16|16@1+ (1,0) [0|65535] "mV" Vector__XXX
 SG_ VoltageCell13_12 : 0|16@1+ (1,0) [0|65535] "mV" Vector__XXX
 SG_ VoltageCell14_12 : 16|16@1+ (1,0) [0|65535] "mV" Vector__XXX
 SG_ VoltageCell13_11 : 0|16@1+ (1,0) [0|65535] "mV" Vector__XXX
 SG_ VoltageCell14_11 : 16|16@1+ (1,0) [0|65535] "mV" Vector__XXX
 SG_ VoltageCell13_10 : 0|16@1+ (1,0) [0|65535] "mV" Vector__XXX
 SG_ VoltageCell14_10 : 16|16@1+ (1,0) [0|65535] "mV" Vector__XXX
 SG_ VoltageCell13_09 : 0|16@1+ (1,0) [0|65535] "mV" Vector__XXX
 SG_ VoltageCell14_09 : 16|16@1+ (1,0) [0|65535] "mV" Vector__XXX
 SG_ VoltageCell13_08 : 0|16@1+ (1,0) [0|65535] "mV" Vector__XXX
 SG_ VoltageCell14_08 : 16|16@1+ (1,0) [0|65535] "mV" Vector__XXX
 SG_ VoltageCell13_07 : 0|16@1- (10,0) [0|65535] "mV" Vector__XXX
 SG_ VoltageCell14_07 : 16|16@1- (1,0) [0|65535] "mV" Vector__XXX
 SG_ VoltageCell13_06 : 0|16@1+ (1,0) [0|65535] "mV" Vector__XXX
 SG_ VoltageCell14_06 : 16|16@1+ (1,0) [0|65535] "mV" Vector__XXX
 SG_ VoltageCell13_05 : 0|16@1+ (1,0) [0|65535] "mV" Vector__XXX
 SG_ VoltageCell14_05 : 16|16@1+ (1,0) [0|65535] "mV" Vector__XXX
 SG_ VoltageCell13_04 : 0|16@1+ (1,0) [0|65535] "mV" Vector__XXX
 SG_ VoltageCell14_04 : 16|16@1+ (1,0) [0|65535] "mV" Vector__XXX
 SG_ VoltageCell13_03 : 0|16@1+ (1,0) [0|65535] "mV" Vector__XXX
 SG_ VoltageCell14_03 : 16|16@1+ (1,0) [0|65535] "mV" Vector__XXX
 SG_ HighestCMATemperature_13 : 0|8@1- (1,-40) [-40|210] "C" Vector__XXX
 SG_ LowestCMATemperature_13 : 8|8@1- (1,-40) [-40|210] "C" Vector__XXX
 SG_ AverageCMATemperature_13 : 16|8@1- (1,-40) [-40|210] "C" Vector__XXX
 SG_ AFE_Temperature_13 : 24|8@1- (1,-40) [-40|210] "C" Vector__XXX
 SG_ HighestCMATemperature_12 : 0|8@1- (1,-40) [-40|210] "C" Vector__XXX
 SG_ LowestCMATemperature_12 : 8|8@1- (1,-40) [-40|210] "C" Vector__XXX
 SG_ AverageCMATemperature_12 : 16|8@1- (1,-40) [-40|210] "C" Vector__XXX
 SG_ AFE_Temperature_12 : 24|8@1- (1,-40) [-40|210] "C" Vector__XXX
 SG_ HighestCMATemperature_11 : 0|8@1- (1,-40) [-40|210] "C" Vector__XXX
 SG_ LowestCMATemperature_11 : 8|8@1- (1,-40) [-40|210] "C" Vector__XXX
 SG_ AverageCMATemperature_11 : 16|8@1- (1,-40) [-40|210] "C" Vector__XXX
 SG_ AFE_Temperature_11 : 24|8@1- (1,-40) [-40|210] "C" Vector__XXX
 SG_ HighestCMATemperature_10 : 0|8@1- (1,-40) [-40|210] "C" Vector__XXX
 SG_ LowestCMATemperature_10 : 8|8@1- (1,-40) [-40|210] "C" Vector__XXX
 SG_ AverageCMATemperature_10 : 16|8@1- (1,-40) [-40|210] "C" Vector__XXX
 SG_ AFE_Temperature_10 : 24|8@1- (1,-40) [-40|210] "C" Vector__XXX
 SG_ HighestCMATemperature_09 : 0|8@1- (1,-40) [-40|210] "C" Vector__XXX
 SG_ LowestCMATemperature_09 : 8|8@1- (1,-40) [-40|210] "C" Vector__XXX
 SG_ AverageCMATemperature_09 : 16|8@1- (1,-40) [-40|210] "C" Vector__XXX
 SG_ AFE_Temperature_09 : 24|8@1- (1,-40) [-40|210] "C" Vector__XXX
 SG_ HighestCMATemperature_08 : 0|8@1- (1,-40) [-40|210] "C" Vector__XXX
 SG_ LowestCMATemperature_08 : 8|8@1- (1,-40) [-40|210] "C" Vector__XXX
 SG_ AverageCMATemperature_08 : 16|8@1- (1,-40) [-40|210] "C" Vector__XXX
 SG_ AFE_Temperature_08 : 24|8@1- (1,-40) [-40|210] "C" Vector__XXX
 SG_ HighestCMATemperature_07 : 0|8@1- (1,-40) [-40|210] "C" Vector__XXX
 SG_ LowestCMATemperature_07 : 8|8@1- (1,-40) [-40|210] "C" Vector__XXX
 SG_ AverageCMATemperature_07 : 16|8@1- (1,-40) [-40|210] "C" Vector__XXX
 SG_ AFE_Temperature_07 : 24|8@1- (1,-40) [-40|210] "C" Vector__XXX
 SG_ HighestCMATemperature_06 : 0|8@1- (1,-40) [-40|210] "C" Vector__XXX
 SG_ LowestCMATemperature_06 : 8|8@1- (1,-40) [-40|210] "C" Vector__XXX
 SG_ AverageCMATemperature_06 : 16|8@1- (1,-40) [-40|210] "C" Vector__XXX
 SG_ AFE_Temperature_06 : 24|8@1- (1,-40) [-40|210] "C" Vector__XXX
 SG_ HighestCMATemperature_05 : 0|8@1- (1,-40) [-40|210] "C" Vector__XXX
 SG_ LowestCMATemperature_05 : 8|8@1- (1,-40) [-40|210] "C" Vector__XXX
 SG_ AverageCMATemperature_05 : 16|8@1- (1,-40) [-40|210] "C" Vector__XXX
 SG_ AFE_Temperature_05 : 24|8@1- (1,-40) [-40|210] "C" Vector__XXX
 SG_ HighestCMATemperature_04 : 0|8@1- (1,-40) [-40|210] "C" Vector__XXX
 SG_ LowestCMATemperature_04 : 8|8@1- (1,-40) [-40|210] "C" Vector__XXX
 SG_ AverageCMATemperature_04 : 16|8@1- (1,-40) [-40|210] "C" Vector__XXX
 SG_ AFE_Temperature_04 : 24|8@1- (1,-40) [-40|210] "C" Vector__XXX
 SG_ HighestCMATemperature_03 : 0|8@1- (1,-40) [-40|210] "C" Vector__XXX
 SG_ LowestCMATemperature_03 : 8|8@1- (1,-40) [-40|210] "C" Vector__XXX
 SG_ AverageCMATemperature_03 : 16|8@1- (1,-40) [-40|210] "C" Vector__XXX
 SG_ AFE_Temperature_03 : 24|8@1- (1,-40) [-40|210] "C" Vector__XXX
 SG_ CommMode_14 : 0|1@1+ (1,0) [0|1] "" Vector__XXX
 SG_ DischargeMode_14 : 1|1@1+ (1,0) [0|1] "" Vector__XXX
 SG_ ChargeMode_14 : 2|1@1+ (1,0) [0|1] "" Vector__XXX
 SG_ BSDCMDMode_14 : 3|1@1+ (1,0) [0|1] "" Vector__XXX
 SG_ ReadyStatus_14 : 8|1@1+ (1,0) [0|1] "" Vector__XXX
 SG_ NormalStatus_14 : 9|1@1+ (1,0) [0|1] "" Vector__XXX
 SG_ FinishStatus_14 : 10|1@1+ (1,0) [0|1] "" Vector__XXX
 SG_ ProtectStatus_14 : 11|1@1+ (1,0) [0|1] "" Vector__XXX
 SG_ LowVoltageProtect_14 : 16|1@1+ (1,0) [0|1] "" Vector__XXX
 SG_ TemperatureProtect_14 : 17|1@1+ (1,0) [0|1] "" Vector__XXX
 SG_ CurrentProtect_141 : 18|1@1+ (1,0) [0|1] "" Vector__XXX
 SG_ ZeroCurrentProtect_141 : 19|1@1+ (1,0) [0|1] "" Vector__XXX
 SG_ OverVoltageProtect_14 : 20|1@1+ (1,0) [0|1] "" Vector__XXX
 SG_ MaintenProtect_14 : 21|1@1+ (1,0) [0|1] "" Vector__XXX
 SG_ BalanceProtect_14 : 22|1@1+ (1,0) [0|1] "" Vector__XXX
 SG_ ChargerNotMatchProtect_14 : 23|1@1+ (1,0) [0|1] "" Vector__XXX
 SG_ NoCanMsgEnableProtect_14 : 24|1@1+ (1,0) [0|1] "" Vector__XXX
 SG_ ContactorIssueProtect_14 : 25|1@1+ (1,0) [0|1] "" Vector__XXX
 SG_ EStopProtect_14 : 26|1@1+ (1,0) [0|1] "" Vector__XXX
 SG_ StartVoltProtect_14 : 27|1@1+ (1,0) [0|1] "" Vector__XXX
 SG_ BMSAddrChangedProtect_14 : 30|1@1+ (1,0) [0|1] "" Vector__XXX
 SG_ PermanentFaultProtect_14 : 31|1@1+ (1,0) [0|1] "" Vector__XXX
 SG_ LowVoltageAlarm_14 : 32|1@1+ (1,0) [0|1] "" Vector__XXX
 SG_ TemperatureAlarm_14 : 33|1@1+ (1,0) [0|1] "" Vector__XXX
 SG_ CurrentAlarm_14 : 34|1@1+ (1,0) [0|1] "" Vector__XXX
 SG_ ZeroCurrentAlarm_14 : 35|1@1+ (1,0) [0|1] "" Vector__XXX
 SG_ OverVoltAlarm_14 : 36|1@1+ (1,0) [0|1] "" Vector__XXX
 SG_ MaintenaceAlarm_14 : 37|1@1+ (1,0) [0|1] "" Vector__XXX
 SG_ BalanaceAlarm_14 : 38|1@1+ (1,0) [0|1] "" Vector__XXX
 SG_ ChargerNotMatchAlarm_14 : 39|1@1+ (1,0) [0|1] "" Vector__XXX
 SG_ CanMsgAlarm_14 : 40|1@1+ (1,0) [0|1] "" Vector__XXX
 SG_ ContactorAlarm_14 : 41|1@1+ (1,0) [0|1] "" Vector__XXX
 SG_ EstopAlarm_14 : 42|1@1+ (1,0) [0|1] "" Vector__XXX
 SG_ StartVoltAlarm_14 : 43|1@1+ (1,0) [0|1] "" Vector__XXX
 SG_ BMSMultipleAddressFault_14 : 48|8@1+ (1,0) [0|255] "" Vector__XXX
 SG_ BSDCFGMODE_14 : 4|1@1+ (1,0) [0|1] "" Vector__XXX
 SG_ ChargerStatu_14 : 56|8@1+ (1,0) [0|255] "" Vector__XXX
 SG_ CommMode_13 : 0|1@1+ (1,0) [0|1] "" Vector__XXX
 SG_ DischargeMode_13 : 1|1@1+ (1,0) [0|1] "" Vector__XXX
 SG_ ChargeMode_13 : 2|1@1+ (1,0) [0|1] "" Vector__XXX
 SG_ BSDCMDMode_13 : 3|1@1+ (1,0) [0|1] "" Vector__XXX
 SG_ ReadyStatus_13 : 8|1@1+ (1,0) [0|1] "" Vector__XXX
 SG_ NormalStatus_13 : 9|1@1+ (1,0) [0|1] "" Vector__XXX
 SG_ FinishStatus_13 : 10|1@1+ (1,0) [0|1] "" Vector__XXX
 SG_ ProtectStatus_13 : 11|1@1+ (1,0) [0|1] "" Vector__XXX
 SG_ LowVoltageProtect_13 : 16|1@1+ (1,0) [0|1] "" Vector__XXX
 SG_ TemperatureProtect_13 : 17|1@1+ (1,0) [0|1] "" Vector__XXX
 SG_ CurrentProtect_13 : 18|1@1+ (1,0) [0|1] "" Vector__XXX
 SG_ ZeroCurrentProtect_13 : 19|1@1+ (1,0) [0|1] "" Vector__XXX
 SG_ OverVoltageProtect_13 : 20|1@1+ (1,0) [0|1] "" Vector__XXX
 SG_ MaintenProtect_13 : 21|1@1+ (1,0) [0|1] "" Vector__XXX
 SG_ BalanceProtect_13 : 22|1@1+ (1,0) [0|1] "" Vector__XXX
 SG_ ChargerNotMatchProtect_13 : 23|1@1+ (1,0) [0|1] "" Vector__XXX
 SG_ NoCanMsgEnableProtect_13 : 24|1@1+ (1,0) [0|1] "" Vector__XXX
 SG_ ContactorIssueProtect_13 : 25|1@1+ (1,0) [0|1] "" Vector__XXX
 SG_ EStopProtect_13 : 26|1@1+ (1,0) [0|1] "" Vector__XXX
 SG_ StartVoltProtect_13 : 27|1@1+ (1,0) [0|1] "" Vector__XXX
 SG_ BMSAddrChangedProtect_13 : 30|1@1+ (1,0) [0|1] "" Vector__XXX
 SG_ PermanentFaultProtect_13 : 31|1@1+ (1,0) [0|1] "" Vector__XXX
 SG_ LowVoltageAlarm_13 : 32|1@1+ (1,0) [0|1] "" Vector__XXX
 SG_ TemperatureAlarm_13 : 33|1@1+ (1,0) [0|1] "" Vector__XXX
 SG_ CurrentAlarm_131 : 34|1@1+ (1,0) [0|1] "" Vector__XXX
 SG_ ZeroCurrentAlarm_13 : 35|1@1+ (1,0) [0|1] "" Vector__XXX
 SG_ OverVoltAlarm_13 : 36|1@1+ (1,0) [0|1] "" Vector__XXX
 SG_ MaintenaceAlarm_13 : 37|1@1+ (1,0) [0|1] "" Vector__XXX
 SG_ BalanaceAlarm_13 : 38|1@1+ (1,0) [0|1] "" Vector__XXX
 SG_ ChargerNotMatchAlarm_13 : 39|1@1+ (1,0) [0|1] "" Vector__XXX
 SG_ CanMsgAlarm_13 : 40|1@1+ (1,0) [0|1] "" Vector__XXX
 SG_ ContactorAlarm_13 : 41|1@1+ (1,0) [0|1] "" Vector__XXX
 SG_ EstopAlarm_13 : 42|1@1+ (1,0) [0|1] "" Vector__XXX
 SG_ StartVoltAlarm_13 : 43|1@1+ (1,0) [0|1] "" Vector__XXX
 SG_ BMSMultipleAddressFault_13 : 48|8@1+ (1,0) [0|255] "" Vector__XXX
 SG_ BSDCFGMODE_13 : 4|1@1+ (1,0) [0|1] "" Vector__XXX
 SG_ ChargerStatu_13 : 56|8@1+ (1,0) [0|255] "" Vector__XXX
 SG_ CommMode_12 : 0|1@1+ (1,0) [0|1] "" Vector__XXX
 SG_ DischargeMode_12 : 1|1@1+ (1,0) [0|1] "" Vector__XXX
 SG_ ChargeMode_12 : 2|1@1+ (1,0) [0|1] "" Vector__XXX
 SG_ BSDCMDMode_12 : 3|1@1+ (1,0) [0|1] "" Vector__XXX
 SG_ ReadyStatus_12 : 8|1@1+ (1,0) [0|1] "" Vector__XXX
 SG_ NormalStatus_12 : 9|1@1+ (1,0) [0|1] "" Vector__XXX
 SG_ FinishStatus_12 : 10|1@1+ (1,0) [0|1] "" Vector__XXX
 SG_ ProtectStatus_12 : 11|1@1+ (1,0) [0|1] "" Vector__XXX
 SG_ LowVoltageProtect_12 : 16|1@1+ (1,0) [0|1] "" Vector__XXX
 SG_ TemperatureProtect_12 : 17|1@1+ (1,0) [0|1] "" Vector__XXX
 SG_ CurrentProtect_12 : 18|1@1+ (1,0) [0|1] "" Vector__XXX
 SG_ ZeroCurrentProtect_12 : 19|1@1+ (1,0) [0|1] "" Vector__XXX
 SG_ OverVoltageProtect_12 : 20|1@1+ (1,0) [0|1] "" Vector__XXX
 SG_ MaintenProtect_12 : 21|1@1+ (1,0) [0|1] "" Vector__XXX
 SG_ BalanceProtect_12 : 22|1@1+ (1,0) [0|1] "" Vector__XXX
 SG_ ChargerNotMatchProtect_12 : 23|1@1+ (1,0) [0|1] "" Vector__XXX
 SG_ NoCanMsgEnableProtect_12 : 24|1@1+ (1,0) [0|1] "" Vector__XXX
 SG_ ContactorIssueProtect_12 : 25|1@1+ (1,0) [0|1] "" Vector__XXX
 SG_ EStopProtect_12 : 26|1@1+ (1,0) [0|1] "" Vector__XXX
 SG_ StartVoltProtect_12 : 27|1@1+ (1,0) [0|1] "" Vector__XXX
 SG_ BMSAddrChangedProtect_12 : 30|1@1+ (1,0) [0|1] "" Vector__XXX
 SG_ PermanentFaultProtect_12 : 31|1@1+ (1,0) [0|1] "" Vector__XXX
 SG_ LowVoltageAlarm_12 : 32|1@1+ (1,0) [0|1] "" Vector__XXX
 SG_ TemperatureAlarm_12 : 33|1@1+ (1,0) [0|1] "" Vector__XXX
 SG_ CurrentAlarm_12 : 34|1@1+ (1,0) [0|1] "" Vector__XXX
 SG_ ZeroCurrentAlarm_12 : 35|1@1+ (1,0) [0|1] "" Vector__XXX
 SG_ OverVoltAlarm_12 : 36|1@1+ (1,0) [0|1] "" Vector__XXX
 SG_ MaintenaceAlarm_12 : 37|1@1+ (1,0) [0|1] "" Vector__XXX
 SG_ BalanaceAlarm_12 : 38|1@1+ (1,0) [0|1] "" Vector__XXX
 SG_ ChargerNotMatchAlarm_12 : 39|1@1+ (1,0) [0|1] "" Vector__XXX
 SG_ CanMsgAlarm_12 : 40|1@1+ (1,0) [0|1] "" Vector__XXX
 SG_ ContactorAlarm_12 : 41|1@1+ (1,0) [0|1] "" Vector__XXX
 SG_ EstopAlarm_12 : 42|1@1+ (1,0) [0|1] "" Vector__XXX
 SG_ StartVoltAlarm_12 : 43|1@1+ (1,0) [0|1] "" Vector__XXX
 SG_ BMSMultipleAddressFault_12 : 48|8@1+ (1,0) [0|255] "" Vector__XXX
 SG_ BSDCFGMODE_12 : 4|1@1+ (1,0) [0|1] "" Vector__XXX
 SG_ ChargerStatu_12 : 56|8@1+ (1,0) [0|255] "" Vector__XXX
 SG_ CommMode_11 : 0|1@1+ (1,0) [0|1] "" Vector__XXX
 SG_ DischargeMode_11 : 1|1@1+ (1,0) [0|1] "" Vector__XXX
 SG_ ChargeMode_11 : 2|1@1+ (1,0) [0|1] "" Vector__XXX
 SG_ BSDCMDMode_11 : 3|1@1+ (1,0) [0|1] "" Vector__XXX
 SG_ ReadyStatus_11 : 8|1@1+ (1,0) [0|1] "" Vector__XXX
 SG_ NormalStatus_11 : 9|1@1+ (1,0) [0|1] "" Vector__XXX
 SG_ FinishStatus_11 : 10|1@1+ (1,0) [0|1] "" Vector__XXX
 SG_ ProtectStatus_11 : 11|1@1+ (1,0) [0|1] "" Vector__XXX
 SG_ LowVoltageProtect_11 : 16|1@1+ (1,0) [0|1] "" Vector__XXX
 SG_ TemperatureProtect_11 : 17|1@1+ (1,0) [0|1] "" Vector__XXX
 SG_ CurrentProtect_11 : 18|1@1+ (1,0) [0|1] "" Vector__XXX
 SG_ ZeroCurrentProtect_11 : 19|1@1+ (1,0) [0|1] "" Vector__XXX
 SG_ OverVoltageProtect_11 : 20|1@1+ (1,0) [0|1] "" Vector__XXX
 SG_ MaintenProtect_11 : 21|1@1+ (1,0) [0|1] "" Vector__XXX
 SG_ BalanceProtect_11 : 22|1@1+ (1,0) [0|1] "" Vector__XXX
 SG_ ChargerNotMatchProtect_11 : 23|1@1+ (1,0) [0|1] "" Vector__XXX
 SG_ NoCanMsgEnableProtect_11 : 24|1@1+ (1,0) [0|1] "" Vector__XXX
 SG_ ContactorIssueProtect_11 : 25|1@1+ (1,0) [0|1] "" Vector__XXX
 SG_ EStopProtect_11 : 26|1@1+ (1,0) [0|1] "" Vector__XXX
 SG_ StartVoltProtect_11 : 27|1@1+ (1,0) [0|1] "" Vector__XXX
 SG_ BMSAddrChangedProtect_11 : 30|1@1+ (1,0) [0|1] "" Vector__XXX
 SG_ PermanentFaultProtect_11 : 31|1@1+ (1,0) [0|1] "" Vector__XXX
 SG_ LowVoltageAlarm_11 : 32|1@1+ (1,0) [0|1] "" Vector__XXX
 SG_ TemperatureAlarm_11 : 33|1@1+ (1,0) [0|1] "" Vector__XXX
 SG_ CurrentAlarm_11 : 34|1@1+ (1,0) [0|1] "" Vector__XXX
 SG_ ZeroCurrentAlarm_11 : 35|1@1+ (1,0) [0|1] "" Vector__XXX
 SG_ OverVoltAlarm_11 : 36|1@1+ (1,0) [0|1] "" Vector__XXX
 SG_ MaintenaceAlarm_11 : 37|1@1+ (1,0) [0|1] "" Vector__XXX
 SG_ BalanaceAlarm_11 : 38|1@1+ (1,0) [0|1] "" Vector__XXX
 SG_ ChargerNotMatchAlarm_11 : 39|1@1+ (1,0) [0|1] "" Vector__XXX
 SG_ CanMsgAlarm_11 : 40|1@1+ (1,0) [0|1] "" Vector__XXX
 SG_ ContactorAlarm_11 : 41|1@1+ (1,0) [0|1] "" Vector__XXX
 SG_ EstopAlarm_11 : 42|1@1+ (1,0) [0|1] "" Vector__XXX
 SG_ StartVoltAlarm_11 : 43|1@1+ (1,0) [0|1] "" Vector__XXX
 SG_ BMSMultipleAddressFault_11 : 48|1@1+ (1,0) [0|255] "" Vector__XXX
 SG_ BSDCFGMODE_11 : 4|1@1+ (1,0) [0|1] "" Vector__XXX
 SG_ ChargerStatu_11 : 56|8@1+ (1,0) [0|255] "" Vector__XXX
 SG_ CommMode_10 : 0|1@1+ (1,0) [0|1] "" Vector__XXX
 SG_ DischargeMode_10 : 1|1@1+ (1,0) [0|1] "" Vector__XXX
 SG_ ChargeMode_10 : 2|1@1+ (1,0) [0|1] "" Vector__XXX
 SG_ BSDCMDMode_10 : 3|1@1+ (1,0) [0|1] "" Vector__XXX
 SG_ ReadyStatus_10 : 8|1@1+ (1,0) [0|1] "" Vector__XXX
 SG_ NormalStatus_10 : 9|1@1+ (1,0) [0|1] "" Vector__XXX
 SG_ FinishStatus_10 : 10|1@1+ (1,0) [0|1] "" Vector__XXX
 SG_ ProtectStatus_10 : 11|1@1+ (1,0) [0|1] "" Vector__XXX
 SG_ LowVoltageProtect_10 : 16|1@1+ (1,0) [0|1] "" Vector__XXX
 SG_ TemperatureProtect_10 : 17|1@1+ (1,0) [0|1] "" Vector__XXX
 SG_ CurrentProtect_10 : 18|1@1+ (1,0) [0|1] "" Vector__XXX
 SG_ ZeroCurrentProtect_10 : 19|1@1+ (1,0) [0|1] "" Vector__XXX
 SG_ OverVoltageProtect_10 : 20|1@1+ (1,0) [0|1] "" Vector__XXX
 SG_ MaintenProtect_10 : 21|1@1+ (1,0) [0|1] "" Vector__XXX
 SG_ BalanceProtect_10 : 22|1@1+ (1,0) [0|1] "" Vector__XXX
 SG_ ChargerNotMatchProtect_10 : 23|1@1+ (1,0) [0|1] "" Vector__XXX
 SG_ NoCanMsgEnableProtect_10 : 24|1@1+ (1,0) [0|1] "" Vector__XXX
 SG_ ContactorIssueProtect_10 : 25|1@1+ (1,0) [0|1] "" Vector__XXX
 SG_ EStopProtect_10 : 26|1@1+ (1,0) [0|1] "" Vector__XXX
 SG_ StartVoltProtect_10 : 27|1@1+ (1,0) [0|1] "" Vector__XXX
 SG_ BMSAddrChangedProtect_10 : 30|1@1+ (1,0) [0|1] "" Vector__XXX
 SG_ PermanentFaultProtect_10 : 31|1@1+ (1,0) [0|1] "" Vector__XXX
 SG_ LowVoltageAlarm_10 : 32|1@1+ (1,0) [0|1] "" Vector__XXX
 SG_ TemperatureAlarm_10 : 33|1@1+ (1,0) [0|1] "" Vector__XXX
 SG_ CurrentAlarm_10 : 34|1@1+ (1,0) [0|1] "" Vector__XXX
 SG_ ZeroCurrentAlarm_10 : 35|1@1+ (1,0) [0|1] "" Vector__XXX
 SG_ OverVoltAlarm_10 : 36|1@1+ (1,0) [0|1] "" Vector__XXX
 SG_ MaintenaceAlarm_10 : 37|1@1+ (1,0) [0|1] "" Vector__XXX
 SG_ BalanaceAlarm_10 : 38|1@1+ (1,0) [0|1] "" Vector__XXX
 SG_ ChargerNotMatchAlarm_10 : 39|1@1+ (1,0) [0|1] "" Vector__XXX
 SG_ CanMsgAlarm_10 : 40|1@1+ (1,0) [0|1] "" Vector__XXX
 SG_ ContactorAlarm_10 : 41|1@1+ (1,0) [0|1] "" Vector__XXX
 SG_ EstopAlarm_10 : 42|1@1+ (1,0) [0|1] "" Vector__XXX
 SG_ StartVoltAlarm_10 : 43|1@1+ (1,0) [0|1] "" Vector__XXX
 SG_ BMSMultipleAddressFault_10 : 48|8@1+ (1,0) [0|255] "" Vector__XXX
 SG_ BSDCFGMODE_10 : 4|1@1+ (1,0) [0|1] "" Vector__XXX
 SG_ ChargerStatu_10 : 56|8@1+ (1,0) [0|0] "" Vector__XXX
 SG_ CommMode_09 : 0|1@1+ (1,0) [0|1] "" Vector__XXX
 SG_ DischargeMode_09 : 1|1@1+ (1,0) [0|1] "" Vector__XXX
 SG_ ChargeMode_09 : 2|1@1+ (1,0) [0|1] "" Vector__XXX
 SG_ BSDCMDMode_09 : 3|1@1+ (1,0) [0|1] "" Vector__XXX
 SG_ ReadyStatus_09 : 8|1@1+ (1,0) [0|1] "" Vector__XXX
 SG_ NormalStatus_09 : 9|1@1+ (1,0) [0|1] "" Vector__XXX
 SG_ FinishStatus_09 : 10|1@1+ (1,0) [0|1] "" Vector__XXX
 SG_ ProtectStatus_09 : 11|1@1+ (1,0) [0|1] "" Vector__XXX
 SG_ LowVoltageProtect_09 : 16|1@1+ (1,0) [0|1] "" Vector__XXX
 SG_ TemperatureProtect_09 : 17|1@1+ (1,0) [0|1] "" Vector__XXX
 SG_ CurrentProtect_09 : 18|1@1+ (1,0) [0|1] "" Vector__XXX
 SG_ ZeroCurrentProtect_09 : 19|1@1+ (1,0) [0|1] "" Vector__XXX
 SG_ OverVoltageProtect__09 : 20|1@1+ (1,0) [0|1] "" Vector__XXX
 SG_ MaintenProtect_09 : 21|1@1+ (1,0) [0|1] "" Vector__XXX
 SG_ BalanceProtect_09 : 22|1@1+ (1,0) [0|1] "" Vector__XXX
 SG_ ChargerNotMatchProtect_09 : 23|1@1+ (1,0) [0|1] "" Vector__XXX
 SG_ NoCanMsgEnableProtect_09 : 24|1@1+ (1,0) [0|1] "" Vector__XXX
 SG_ ContactorIssueProtect_09 : 25|1@1+ (1,0) [0|1] "" Vector__XXX
 SG_ EStopProtect_09 : 26|1@1+ (1,0) [0|1] "" Vector__XXX
 SG_ StartVoltProtect_09 : 27|1@1+ (1,0) [0|1] "" Vector__XXX
 SG_ BMSAddrChangedProtect_09 : 30|1@1+ (1,0) [0|1] "" Vector__XXX
 SG_ PermanentFaultProtect_09 : 31|1@1+ (1,0) [0|1] "" Vector__XXX
 SG_ LowVoltageAlarm_09 : 32|1@1+ (1,0) [0|1] "" Vector__XXX
 SG_ TemperatureAlarm_09 : 33|1@1+ (1,0) [0|1] "" Vector__XXX
 SG_ CurrentAlarm_09 : 34|1@1+ (1,0) [0|1] "" Vector__XXX
 SG_ ZeroCurrentAlarm_09 : 35|1@1+ (1,0) [0|1] "" Vector__XXX
 SG_ OverVoltAlarm_09 : 36|1@1+ (1,0) [0|1] "" Vector__XXX
 SG_ MaintenaceAlarm_09 : 37|1@1+ (1,0) [0|1] "" Vector__XXX
 SG_ BalanaceAlarm_09 : 38|1@1+ (1,0) [0|1] "" Vector__XXX
 SG_ ChargerNotMatchAlarm_09 : 39|1@1+ (1,0) [0|1] "" Vector__XXX
 SG_ CanMsgAlarm_09 : 40|1@1+ (1,0) [0|1] "" Vector__XXX
 SG_ ContactorAlarm_09 : 41|1@1+ (1,0) [0|1] "" Vector__XXX
 SG_ EstopAlarm_09 : 42|1@1+ (1,0) [0|1] "" Vector__XXX
 SG_ StartVoltAlarm_09 : 43|1@1+ (1,0) [0|1] "" Vector__XXX
 SG_ BMSMultipleAddressFault_09 : 48|8@1+ (1,0) [0|255] "" Vector__XXX
 SG_ BSDCFGMODE_09 : 4|1@1+ (1,0) [0|1] "" Vector__XXX
 SG_ ChargerStatu_09 : 56|8@1+ (1,0) [0|255] "" Vector__XXX
 SG_ CommMode_08 : 0|1@1+ (1,0) [0|1] "" Vector__XXX
 SG_ DischargeMode_08 : 1|1@1+ (1,0) [0|1] "" Vector__XXX
 SG_ ChargeMode_08 : 2|1@1+ (1,0) [0|1] "" Vector__XXX
 SG_ BSDCMDMode_08 : 3|1@1+ (1,0) [0|1] "" Vector__XXX
 SG_ ReadyStatus_08 : 8|1@1+ (1,0) [0|1] "" Vector__XXX
 SG_ NormalStatus_08 : 9|1@1+ (1,0) [0|1] "" Vector__XXX
 SG_ FinishStatus_08 : 10|1@1+ (1,0) [0|1] "" Vector__XXX
 SG_ ProtectStatus_08 : 11|1@1+ (1,0) [0|1] "" Vector__XXX
 SG_ LowVoltageProtect_08 : 16|1@1+ (1,0) [0|1] "" Vector__XXX
 SG_ TemperatureProtect_08 : 17|1@1+ (1,0) [0|1] "" Vector__XXX
 SG_ CurrentProtect_08 : 18|1@1+ (1,0) [0|1] "" Vector__XXX
 SG_ ZeroCurrentProtect_08 : 19|1@1+ (1,0) [0|1] "" Vector__XXX
 SG_ OverVoltageProtect_08 : 20|1@1+ (1,0) [0|1] "" Vector__XXX
 SG_ MaintenProtect_08 : 21|1@1+ (1,0) [0|1] "" Vector__XXX
 SG_ BalanceProtect_08 : 22|1@1+ (1,0) [0|1] "" Vector__XXX
 SG_ ChargerNotMatchProtect_08 : 23|1@1+ (1,0) [0|1] "" Vector__XXX
 SG_ NoCanMsgEnableProtect_08 : 24|1@1+ (1,0) [0|1] "" Vector__XXX
 SG_ ContactorIssueProtect__08 : 25|1@1+ (1,0) [0|1] "" Vector__XXX
 SG_ EStopProtect__08 : 26|1@1+ (1,0) [0|1] "" Vector__XXX
 SG_ StartVoltProtect_08 : 27|1@1+ (1,0) [0|1] "" Vector__XXX
 SG_ BMSAddrChangedProtect_08 : 30|1@1+ (1,0) [0|1] "" Vector__XXX
 SG_ PermanentFaultProtect_08 : 31|1@1+ (1,0) [0|1] "" Vector__XXX
 SG_ LowVoltageAlarm_08 : 32|1@1+ (1,0) [0|1] "" Vector__XXX
 SG_ TemperatureAlarm_08 : 33|1@1+ (1,0) [0|1] "" Vector__XXX
 SG_ CurrentAlarm_08 : 34|1@1+ (1,0) [0|1] "" Vector__XXX
 SG_ ZeroCurrentAlarm_08 : 35|1@1+ (1,0) [0|1] "" Vector__XXX
 SG_ OverVoltAlarm_08 : 36|1@1+ (1,0) [0|1] "" Vector__XXX
 SG_ MaintenaceAlarm_08 : 37|1@1+ (1,0) [0|1] "" Vector__XXX
 SG_ BalanaceAlarm_08 : 38|1@1+ (1,0) [0|1] "" Vector__XXX
 SG_ ChargerNotMatchAlarm_08 : 39|1@1+ (1,0) [0|1] "" Vector__XXX
 SG_ CanMsgAlarm_08 : 40|1@1+ (1,0) [0|1] "" Vector__XXX
 SG_ ContactorAlarm_08 : 41|1@1+ (1,0) [0|1] "" Vector__XXX
 SG_ EstopAlarm_08 : 42|1@1+ (1,0) [0|1] "" Vector__XXX
 SG_ StartVoltAlarm_08 : 43|1@1+ (1,0) [0|1] "" Vector__XXX
 SG_ BMSMultipleAddressFault_08 : 48|8@1+ (1,0) [0|255] "" Vector__XXX
 SG_ BSDCFGMODE_08 : 4|1@1+ (1,0) [0|1] "" Vector__XXX
 SG_ ChargerStatu_08 : 56|8@1+ (1,0) [0|255] "" Vector__XXX
 SG_ CommMode_07 : 0|1@1+ (1,0) [0|1] "" Vector__XXX
 SG_ DischargeMode_07 : 1|1@1+ (1,0) [0|1] "" Vector__XXX
 SG_ ChargeMode_07 : 2|1@1+ (1,0) [0|1] "" Vector__XXX
 SG_ BSDCMDMode_07 : 3|1@1+ (1,0) [0|1] "" Vector__XXX
 SG_ ReadyStatus_07 : 8|1@1+ (1,0) [0|1] "" Vector__XXX
 SG_ NormalStatus_07 : 9|1@1+ (1,0) [0|1] "" Vector__XXX
 SG_ FinishStatus_07 : 10|1@1+ (1,0) [0|1] "" Vector__XXX
 SG_ ProtectStatus_07 : 11|1@1+ (1,0) [0|1] "" Vector__XXX
 SG_ LowVoltageProtect_07 : 16|1@1+ (1,0) [0|1] "" Vector__XXX
 SG_ TemperatureProtect_07 : 17|1@1+ (1,0) [0|1] "" Vector__XXX
 SG_ CurrentProtect__07 : 18|1@1+ (1,0) [0|1] "" Vector__XXX
 SG_ ZeroCurrentProtect_07 : 19|1@1+ (1,0) [0|1] "" Vector__XXX
 SG_ OverVoltageProtect_07 : 20|1@1+ (1,0) [0|1] "" Vector__XXX
 SG_ MaintenProtect_07 : 21|1@1+ (1,0) [0|1] "" Vector__XXX
 SG_ BalanceProtect_07 : 22|1@1+ (1,0) [0|1] "" Vector__XXX
 SG_ ChargerNotMatchProtect_07 : 23|1@1+ (1,0) [0|1] "" Vector__XXX
 SG_ NoCanMsgEnableProtect_07 : 24|1@1+ (1,0) [0|1] "" Vector__XXX
 SG_ ContactorIssueProtect_07 : 25|1@1+ (1,0) [0|1] "" Vector__XXX
 SG_ EStopProtect_07 : 26|1@1+ (1,0) [0|1] "" Vector__XXX
 SG_ StartVoltProtect_07 : 27|1@1+ (1,0) [0|1] "" Vector__XXX
 SG_ BMSAddrChangedProtect_07 : 30|1@1+ (1,0) [0|1] "" Vector__XXX
 SG_ PermanentFaultProtect_07 : 31|1@1+ (1,0) [0|1] "" Vector__XXX
 SG_ LowVoltageAlarm_07 : 32|1@1+ (1,0) [0|1] "" Vector__XXX
 SG_ TemperatureAlarm_07 : 33|1@1+ (1,0) [0|1] "" Vector__XXX
 SG_ CurrentAlarm_07 : 34|1@1+ (1,0) [0|1] "" Vector__XXX
 SG_ ZeroCurrentAlarm_07 : 35|1@1+ (1,0) [0|1] "" Vector__XXX
 SG_ OverVoltAlarm_07 : 36|1@1+ (1,0) [0|1] "" Vector__XXX
 SG_ MaintenaceAlarm_07 : 37|1@1+ (1,0) [0|1] "" Vector__XXX
 SG_ BalanaceAlarm_07 : 38|1@1+ (1,0) [0|1] "" Vector__XXX
 SG_ ChargerNotMatchAlarm_07 : 39|1@1+ (1,0) [0|1] "" Vector__XXX
 SG_ CanMsgAlarm_07 : 40|1@1+ (1,0) [0|1] "" Vector__XXX
 SG_ ContactorAlarm_07 : 41|1@1+ (1,0) [0|1] "" Vector__XXX
 SG_ EstopAlarm_07 : 42|1@1+ (1,0) [0|1] "" Vector__XXX
 SG_ StartVoltAlarm_07 : 43|1@1+ (1,0) [0|1] "" Vector__XXX
 SG_ BMSMultipleAddressFault_07 : 48|8@1+ (1,0) [0|255] "" Vector__XXX
 SG_ BSDCFGMODE_07 : 4|1@1+ (1,0) [0|1] "" Vector__XXX
 SG_ ChargerStatu_07 : 56|8@1+ (1,0) [0|255] "" Vector__XXX
 SG_ CommMode_06 : 0|1@1+ (1,0) [0|1] "" Vector__XXX
 SG_ DischargeMode_06 : 1|1@1+ (1,0) [0|1] "" Vector__XXX
 SG_ ChargeMode_06 : 2|1@1+ (1,0) [0|1] "" Vector__XXX
 SG_ BSDCMDMode_06 : 3|1@1+ (1,0) [0|1] "" Vector__XXX
 SG_ ReadyStatus_06 : 8|1@1+ (1,0) [0|1] "" Vector__XXX
 SG_ NormalStatus_06 : 9|1@1+ (1,0) [0|1] "" Vector__XXX
 SG_ FinishStatus_06 : 10|1@1+ (1,0) [0|1] "" Vector__XXX
 SG_ ProtectStatus_06 : 11|1@1+ (1,0) [0|1] "" Vector__XXX
 SG_ LowVoltageProtect_06 : 16|1@1+ (1,0) [0|1] "" Vector__XXX
 SG_ TemperatureProtect_06 : 17|1@1+ (1,0) [0|1] "" Vector__XXX
 SG_ CurrentProtect__06 : 18|1@1+ (1,0) [0|1] "" Vector__XXX
 SG_ ZeroCurrentProtect_06 : 19|1@1+ (1,0) [0|1] "" Vector__XXX
 SG_ OverVoltageProtect__06 : 20|1@1+ (1,0) [0|1] "" Vector__XXX
 SG_ MaintenProtect_06 : 21|1@1+ (1,0) [0|1] "" Vector__XXX
 SG_ BalanceProtect__06 : 22|1@1+ (1,0) [0|1] "" Vector__XXX
 SG_ ChargerNotMatchProtect_06 : 23|1@1+ (1,0) [0|1] "" Vector__XXX
 SG_ NoCanMsgEnableProtect_06 : 24|1@1+ (1,0) [0|1] "" Vector__XXX
 SG_ ContactorIssueProtect_06 : 25|1@1+ (1,0) [0|1] "" Vector__XXX
 SG_ EStopProtect_06 : 26|1@1+ (1,0) [0|1] "" Vector__XXX
 SG_ StartVoltProtect_06 : 27|1@1+ (1,0) [0|1] "" Vector__XXX
 SG_ BMSAddrChangedProtect_06 : 30|1@1+ (1,0) [0|1] "" Vector__XXX
 SG_ PermanentFaultProtect_06 : 31|1@1+ (1,0) [0|1] "" Vector__XXX
 SG_ LowVoltageAlarm_06 : 32|1@1+ (1,0) [0|1] "" Vector__XXX
 SG_ TemperatureAlarm_06 : 33|1@1+ (1,0) [0|1] "" Vector__XXX
 SG_ CurrentAlarm_06 : 34|1@1+ (1,0) [0|1] "" Vector__XXX
 SG_ ZeroCurrentAlarm_06 : 35|1@1+ (1,0) [0|1] "" Vector__XXX
 SG_ OverVoltAlarm_06 : 36|1@1+ (1,0) [0|1] "" Vector__XXX
 SG_ MaintenaceAlarm_06 : 37|1@1+ (1,0) [0|1] "" Vector__XXX
 SG_ BalanaceAlarm_06 : 38|1@1+ (1,0) [0|1] "" Vector__XXX
 SG_ ChargerNotMatchAlarm_06 : 39|1@1+ (1,0) [0|1] "" Vector__XXX
 SG_ CanMsgAlarm_06 : 40|1@1+ (1,0) [0|1] "" Vector__XXX
 SG_ ContactorAlarm_06 : 41|1@1+ (1,0) [0|1] "" Vector__XXX
 SG_ EstopAlarm_06 : 42|1@1+ (1,0) [0|1] "" Vector__XXX
 SG_ StartVoltAlarm_06 : 43|1@1+ (1,0) [0|1] "" Vector__XXX
 SG_ BMSMultipleAddressFault_06 : 48|8@1+ (1,0) [0|255] "" Vector__XXX
 SG_ BSDCFGMODE_06 : 4|1@1+ (1,0) [0|1] "" Vector__XXX
 SG_ ChargerStatu_06 : 56|8@1+ (1,0) [0|255] "" Vector__XXX
 SG_ CommMode_05 : 0|1@1+ (1,0) [0|1] "" Vector__XXX
 SG_ DischargeMode_05 : 1|1@1+ (1,0) [0|1] "" Vector__XXX
 SG_ ChargeMode_05 : 2|1@1+ (1,0) [0|1] "" Vector__XXX
 SG_ BSDCMDMode_05 : 3|1@1+ (1,0) [0|1] "" Vector__XXX
 SG_ ReadyStatus_05 : 8|1@1+ (1,0) [0|1] "" Vector__XXX
 SG_ NormalStatus_05 : 9|1@1+ (1,0) [0|1] "" Vector__XXX
 SG_ FinishStatus_05 : 10|1@1+ (1,0) [0|1] "" Vector__XXX
 SG_ ProtectStatus_05 : 11|1@1+ (1,0) [0|1] "" Vector__XXX
 SG_ LowVoltageProtect_05 : 16|1@1+ (1,0) [0|1] "" Vector__XXX
 SG_ TemperatureProtect_05 : 17|1@1+ (1,0) [0|1] "" Vector__XXX
 SG_ CurrentProtect_05 : 18|1@1+ (1,0) [0|1] "" Vector__XXX
 SG_ ZeroCurrentProtect_05 : 19|1@1+ (1,0) [0|1] "" Vector__XXX
 SG_ OverVoltageProtect_05 : 20|1@1+ (1,0) [0|1] "" Vector__XXX
 SG_ MaintenProtect_05 : 21|1@1+ (1,0) [0|1] "" Vector__XXX
 SG_ BalanceProtect_05 : 22|1@1+ (1,0) [0|1] "" Vector__XXX
 SG_ ChargerNotMatchProtect_05 : 23|1@1+ (1,0) [0|1] "" Vector__XXX
 SG_ NoCanMsgEnableProtect_05 : 24|1@1+ (1,0) [0|1] "" Vector__XXX
 SG_ ContactorIssueProtect_05 : 25|1@1+ (1,0) [0|1] "" Vector__XXX
 SG_ EStopProtect_05 : 26|1@1+ (1,0) [0|1] "" Vector__XXX
 SG_ StartVoltProtect_05 : 27|1@1+ (1,0) [0|1] "" Vector__XXX
 SG_ BMSAddrChangedProtect_05 : 30|1@1+ (1,0) [0|1] "" Vector__XXX
 SG_ PermanentFaultProtect_05 : 31|1@1+ (1,0) [0|1] "" Vector__XXX
 SG_ LowVoltageAlarm_05 : 32|1@1+ (1,0) [0|1] "" Vector__XXX
 SG_ TemperatureAlarm_05 : 33|1@1+ (1,0) [0|1] "" Vector__XXX
 SG_ CurrentAlarm_05 : 34|1@1+ (1,0) [0|1] "" Vector__XXX
 SG_ ZeroCurrentAlarm_05 : 35|1@1+ (1,0) [0|1] "" Vector__XXX
 SG_ OverVoltAlarm_05 : 36|1@1+ (1,0) [0|1] "" Vector__XXX
 SG_ MaintenaceAlarm_05 : 37|1@1+ (1,0) [0|1] "" Vector__XXX
 SG_ BalanaceAlarm_05 : 38|1@1+ (1,0) [0|1] "" Vector__XXX
 SG_ ChargerNotMatchAlarm_05 : 39|1@1+ (1,0) [0|1] "" Vector__XXX
 SG_ CanMsgAlarm_05 : 40|1@1+ (1,0) [0|1] "" Vector__XXX
 SG_ ContactorAlarm_05 : 41|1@1+ (1,0) [0|1] "" Vector__XXX
 SG_ EstopAlarm_05 : 42|1@1+ (1,0) [0|1] "" Vector__XXX
 SG_ StartVoltAlarm_05 : 43|1@1+ (1,0) [0|1] "" Vector__XXX
 SG_ BMSMultipleAddressFault_05 : 48|8@1+ (1,0) [0|255] "" Vector__XXX
 SG_ BSDCFGMODE_05 : 4|1@1+ (1,0) [0|1] "" Vector__XXX
 SG_ ChargerStatu_05 : 56|8@1+ (1,0) [0|255] "" Vector__XXX
 SG_ CommMode_04 : 0|1@1+ (1,0) [0|1] "" Vector__XXX
 SG_ DischargeMode_04 : 1|1@1+ (1,0) [0|1] "" Vector__XXX
 SG_ ChargeMode_04 : 2|1@1+ (1,0) [0|1] "" Vector__XXX
 SG_ BSDCMDMode_04 : 3|1@1+ (1,0) [0|1] "" Vector__XXX
 SG_ ReadyStatus_04 : 8|1@1+ (1,0) [0|1] "" Vector__XXX
 SG_ NormalStatus_04 : 9|1@1+ (1,0) [0|1] "" Vector__XXX
 SG_ FinishStatus_04 : 10|1@1+ (1,0) [0|1] "" Vector__XXX
 SG_ ProtectStatus_04 : 11|1@1+ (1,0) [0|1] "" Vector__XXX
 SG_ LowVoltageProtect_04 : 16|1@1+ (1,0) [0|1] "" Vector__XXX
 SG_ TemperatureProtect_04 : 17|1@1+ (1,0) [0|1] "" Vector__XXX
 SG_ CurrentProtect__04 : 18|1@1+ (1,0) [0|1] "" Vector__XXX
 SG_ ZeroCurrentProtect_04 : 19|1@1+ (1,0) [0|1] "" Vector__XXX
 SG_ OverVoltageProtect__04 : 20|1@1+ (1,0) [0|1] "" Vector__XXX
 SG_ MaintenProtect_04 : 21|1@1+ (1,0) [0|1] "" Vector__XXX
 SG_ BalanceProtect__04 : 22|1@1+ (1,0) [0|1] "" Vector__XXX
 SG_ ChargerNotMatchProtect_04 : 23|1@1+ (1,0) [0|1] "" Vector__XXX
 SG_ NoCanMsgEnableProtect_04 : 24|1@1+ (1,0) [0|1] "" Vector__XXX
 SG_ ContactorIssueProtect_04 : 25|1@1+ (1,0) [0|1] "" Vector__XXX
 SG_ EStopProtect_04 : 26|1@1+ (1,0) [0|1] "" Vector__XXX
 SG_ StartVoltProtect_04 : 27|1@1+ (1,0) [0|1] "" Vector__XXX
 SG_ BMSAddrChangedProtect_04 : 30|1@1+ (1,0) [0|1] "" Vector__XXX
 SG_ PermanentFaultProtect_04 : 31|1@1+ (1,0) [0|1] "" Vector__XXX
 SG_ LowVoltageAlarm_04 : 32|1@1+ (1,0) [0|1] "" Vector__XXX
 SG_ TemperatureAlarm_04 : 33|1@1+ (1,0) [0|1] "" Vector__XXX
 SG_ CurrentAlarm_04 : 34|1@1+ (1,0) [0|1] "" Vector__XXX
 SG_ ZeroCurrentAlarm_04 : 35|1@1+ (1,0) [0|1] "" Vector__XXX
 SG_ OverVoltAlarm_04 : 36|1@1+ (1,0) [0|1] "" Vector__XXX
 SG_ MaintenaceAlarm_04 : 37|1@1+ (1,0) [0|1] "" Vector__XXX
 SG_ BalanaceAlarm_04 : 38|1@1+ (1,0) [0|1] "" Vector__XXX
 SG_ ChargerNotMatchAlarm_04 : 39|1@1+ (1,0) [0|1] "" Vector__XXX
 SG_ CanMsgAlarm_04 : 40|1@1+ (1,0) [0|1] "" Vector__XXX
 SG_ ContactorAlarm_04 : 41|1@1+ (1,0) [0|1] "" Vector__XXX
 SG_ EstopAlarm_04 : 42|1@1+ (1,0) [0|1] "" Vector__XXX
 SG_ StartVoltAlarm_04 : 43|1@1+ (1,0) [0|1] "" Vector__XXX
 SG_ BMSMultipleAddressFault_04 : 48|8@1+ (1,0) [0|255] "" Vector__XXX
 SG_ BSDCFGMODE_04 : 4|1@1+ (1,0) [0|1] "" Vector__XXX
 SG_ ChargerStatu_04 : 56|8@1+ (1,0) [0|255] "" Vector__XXX
 SG_ CommMode_03 : 0|1@1+ (1,0) [0|1] "" Vector__XXX
 SG_ DischargeMode_03 : 1|1@1+ (1,0) [0|1] "" Vector__XXX
 SG_ ChargeMode_03 : 2|1@1+ (1,0) [0|1] "" Vector__XXX
 SG_ BSDCMDMode_03 : 3|1@1+ (1,0) [0|1] "" Vector__XXX
 SG_ ReadyStatus_03 : 8|1@1+ (1,0) [0|1] "" Vector__XXX
 SG_ NormalStatus_03 : 9|1@1+ (1,0) [0|1] "" Vector__XXX
 SG_ FinishStatus_03 : 10|1@1+ (1,0) [0|1] "" Vector__XXX
 SG_ ProtectStatus_03 : 11|1@1+ (1,0) [0|1] "" Vector__XXX
 SG_ LowVoltageProtect_03 : 16|1@1+ (1,0) [0|1] "" Vector__XXX
 SG_ TemperatureProtect_03 : 17|1@1+ (1,0) [0|1] "" Vector__XXX
 SG_ CurrentProtect__03 : 18|1@1+ (1,0) [0|1] "" Vector__XXX
 SG_ ZeroCurrentProtect_03 : 19|1@1+ (1,0) [0|1] "" Vector__XXX
 SG_ OverVoltageProtect__03 : 20|1@1+ (1,0) [0|1] "" Vector__XXX
 SG_ MaintenProtect_03 : 21|1@1+ (1,0) [0|1] "" Vector__XXX
 SG_ BalanceProtect__03 : 22|1@1+ (1,0) [0|1] "" Vector__XXX
 SG_ ChargerNotMatchProtect_03 : 23|1@1+ (1,0) [0|1] "" Vector__XXX
 SG_ NoCanMsgEnableProtect_03 : 24|8@1+ (1,0) [0|255] "" Vector__XXX
 SG_ ContactorIssueProtect_03 : 25|1@1+ (1,0) [0|1] "" Vector__XXX
 SG_ EStopProtect_03 : 26|1@1+ (1,0) [0|1] "" Vector__XXX
 SG_ StartVoltProtect_03 : 27|1@1+ (1,0) [0|1] "" Vector__XXX
 SG_ BMSAddrChangedProtect_03 : 30|1@1+ (1,0) [0|1] "" Vector__XXX
 SG_ PermanentFaultProtect_03 : 31|1@1+ (1,0) [0|1] "" Vector__XXX
 SG_ LowVoltageAlarm_03 : 32|1@1+ (1,0) [0|1] "" Vector__XXX
 SG_ TemperatureAlarm_03 : 33|1@1+ (1,0) [0|1] "" Vector__XXX
 SG_ CurrentAlarm_03 : 34|1@1+ (1,0) [0|1] "" Vector__XXX
 SG_ ZeroCurrentAlarm_03 : 35|1@1+ (1,0) [0|1] "" Vector__XXX
 SG_ OverVoltAlarm_03 : 36|1@1+ (1,0) [0|1] "" Vector__XXX
 SG_ MaintenaceAlarm_03 : 37|1@1+ (1,0) [0|1] "" Vector__XXX
 SG_ BalanaceAlarm_03 : 38|1@1+ (1,0) [0|1] "" Vector__XXX
 SG_ ChargerNotMatchAlarm_03 : 39|1@1+ (1,0) [0|1] "" Vector__XXX
 SG_ CanMsgAlarm_03 : 40|1@1+ (1,0) [0|1] "" Vector__XXX
 SG_ ContactorAlarm_03 : 41|1@1+ (1,0) [0|1] "" Vector__XXX
 SG_ EstopAlarm_03 : 42|1@1+ (1,0) [0|1] "" Vector__XXX
 SG_ StartVoltAlarm_03 : 43|1@1+ (1,0) [0|1] "" Vector__XXX
 SG_ BMSMultipleAddressFault_03 : 48|8@1+ (1,0) [0|255] "" Vector__XXX
 SG_ BSDCFGMODE_03 : 4|1@1+ (1,0) [0|1] "" Vector__XXX
 SG_ ChargerStatu_03 : 56|8@1+ (1,0) [0|255] "" Vector__XXX
 SG_ AvgCellV_14 : 32|16@1+ (1,0) [0|65535] "mV" Vector__XXX
 SG_ LowestCellVModuleNum_14 : 16|8@1+ (1,0) [0|250] "" Vector__XXX
 SG_ HighestCellVModuleNum_14 : 0|8@1+ (1,0) [0|250] "" Vector__XXX
 SG_ CellVoltageMaxMinDifferMv_14 : 48|16@1+ (1,0) [0|65535] "mV" Vector__XXX
 SG_ AvgCellV_13 : 32|16@1+ (1,0) [0|65535] "mV" Vector__XXX
 SG_ LowestCellVModuleNum_13 : 16|8@1+ (1,0) [0|250] "" Vector__XXX
 SG_ HighestCellVModuleNum_13 : 0|8@1+ (1,0) [0|250] "" Vector__XXX
 SG_ CellVoltageMaxMinDifferMv_13 : 48|16@1+ (1,0) [0|65535] "mV" Vector__XXX
 SG_ AvgCellV_12 : 32|16@1+ (1,0) [0|65535] "mV" Vector__XXX
 SG_ LowestCellVModuleNum_12 : 16|8@1+ (1,0) [0|250] "" Vector__XXX
 SG_ HighestCellVModuleNum_12 : 0|8@1+ (1,0) [0|250] "" Vector__XXX
 SG_ CellVoltageMaxMinDifferMv_12 : 48|16@1+ (1,0) [0|65535] "mV" Vector__XXX
 SG_ AvgCellV_11 : 32|16@1+ (1,0) [0|65535] "mV" Vector__XXX
 SG_ LowestCellVModuleNum_11 : 16|8@1+ (1,0) [0|250] "" Vector__XXX
 SG_ HighestCellVModuleNum_11 : 0|8@1+ (1,0) [0|250] "" Vector__XXX
 SG_ CellVoltageMaxMinDifferMv_11 : 48|16@1+ (1,0) [0|65535] "mV" Vector__XXX
 SG_ AvgCellV_10 : 32|16@1+ (1,0) [0|65535] "mV" Vector__XXX
 SG_ LowestCellVModuleNum_10 : 16|8@1+ (1,0) [0|250] "" Vector__XXX
 SG_ HighestCellVModuleNum_10 : 0|8@1+ (1,0) [0|250] "" Vector__XXX
 SG_ CellVoltageMaxMinDifferMv_10 : 48|16@1+ (1,0) [0|65535] "mV" Vector__XXX
 SG_ AvgCellV_09 : 32|16@1+ (1,0) [0|65535] "mV" Vector__XXX
 SG_ LowestCellVModuleNum_09 : 16|8@1+ (1,0) [0|250] "" Vector__XXX
 SG_ HighestCellVModuleNum_09 : 0|8@1+ (1,0) [0|250] "" Vector__XXX
 SG_ CellVoltageMaxMinDifferMv_09 : 48|16@1+ (1,0) [0|65535] "mV" Vector__XXX
 SG_ AvgCellV_08 : 32|16@1+ (1,0) [0|65535] "mV" Vector__XXX
 SG_ LowestCellVModuleNum_08 : 16|8@1+ (1,0) [0|250] "" Vector__XXX
 SG_ HighestCellVModuleNum_08 : 0|8@1+ (1,0) [0|250] "" Vector__XXX
 SG_ CellVoltageMaxMinDifferMv_08 : 48|16@1+ (1,0) [0|65535] "mV" Vector__XXX
 SG_ AvgCellV_07 : 32|16@1+ (1,0) [0|65535] "mV" Vector__XXX
 SG_ LowestCellVModuleNum_07 : 16|8@1+ (1,0) [0|250] "" Vector__XXX
 SG_ HighestCellVModuleNum_07 : 0|8@1+ (1,0) [0|250] "" Vector__XXX
 SG_ CellVoltageMaxMinDifferMv_07 : 48|16@1+ (1,0) [0|65535] "mV" Vector__XXX
 SG_ AvgCellV_06 : 32|16@1+ (1,0) [0|65535] "mV" Vector__XXX
 SG_ LowestCellVModuleNum_06 : 16|8@1+ (1,0) [0|250] "" Vector__XXX
 SG_ HighestCellVModuleNum_06 : 0|8@1+ (1,0) [0|250] "" Vector__XXX
 SG_ CellVoltageMaxMinDifferMv_06 : 48|16@1+ (1,0) [0|65535] "mV" Vector__XXX
 SG_ AvgCellV_05 : 32|16@1+ (1,0) [0|65535] "mV" Vector__XXX
 SG_ LowestCellVModuleNum_05 : 16|8@1+ (1,0) [0|250] "" Vector__XXX
 SG_ HighestCellVModuleNum_05 : 0|8@1+ (1,0) [0|250] "" Vector__XXX
 SG_ CellVoltageMaxMinDifferMv_05 : 48|16@1+ (1,0) [0|65535] "mV" Vector__XXX
 SG_ AvgCellV_04 : 32|16@1+ (1,0) [0|65535] "mV" Vector__XXX
 SG_ LowestCellVModuleNum_04 : 16|8@1+ (1,0) [0|250] "" Vector__XXX
 SG_ HighestCellVModuleNum_04 : 0|8@1+ (1,0) [0|250] "" Vector__XXX
 SG_ CellVoltageMaxMinDifferMv_04 : 48|16@1+ (1,0) [0|65535] "mV" Vector__XXX
 SG_ AvgCellV_03 : 32|16@1+ (1,0) [0|65535] "mV" Vector__XXX
 SG_ LowestCellVModuleNum_03 : 16|8@1+ (1,0) [0|250] "" Vector__XXX
 SG_ HighestCellVModuleNum_03 : 0|8@1+ (1,0) [0|250] "" Vector__XXX
 SG_ CellVoltageMaxMinDifferMv_03 : 48|16@1+ (1,0) [0|65535] "mV" Vector__XXX
 SG_ CellBalancingActive_14 : 30|2@1+ (1,0) [0|3] "" Vector__XXX
 SG_ CellBalanceStatus_14 : 28|2@1+ (1,0) [0|3] "" Vector__XXX
 SG_ HVBusContactorStNEG_14 : 2|2@1+ (1,0) [0|3] "" Vector__XXX
 SG_ HVBusContactorStPOS_14 : 0|2@1+ (1,0) [0|3] "" Vector__XXX
 SG_ BMSADDR_14 : 48|4@1+ (1,0) [0|15] "" Vector__XXX
 SG_ EStopInput_14 : 52|1@1+ (1,0) [0|1] "" Vector__XXX
 SG_ DischargeKeyInput_14 : 53|1@1+ (1,0) [0|1] "" Vector__XXX
 SG_ ChargeInput_14 : 54|1@1+ (1,0) [0|1] "" Vector__XXX
 SG_ RelayOutput_14 : 56|1@1+ (1,0) [0|1] "" Vector__XXX
 SG_ FaultOouput_14 : 57|1@1+ (1,0) [0|1] "" Vector__XXX
 SG_ AlarmOutput_14 : 58|1@1+ (1,0) [0|1] "" Vector__XXX
 SG_ FutureOutput_14 : 59|1@1+ (1,0) [0|1] "" Vector__XXX
 SG_ Aux12VOutput_14 : 60|1@1+ (1,0) [0|1] "" Vector__XXX
 SG_ CellBalancingActive_13 : 30|2@1+ (1,0) [0|3] "" Vector__XXX
 SG_ CellBalanceStatus_13 : 28|2@1+ (1,0) [0|3] "" Vector__XXX
 SG_ HVBusContactorStNEG_13 : 2|2@1+ (1,0) [0|3] "" Vector__XXX
 SG_ HVBusContactorStPOS_13 : 0|2@1+ (1,0) [0|3] "" Vector__XXX
 SG_ BMSADDR_13 : 48|4@1+ (1,0) [0|15] "" Vector__XXX
 SG_ EStopInput_13 : 52|1@1+ (1,0) [0|1] "" Vector__XXX
 SG_ DischargeKeyInput_13 : 53|1@1+ (1,0) [0|1] "" Vector__XXX
 SG_ ChargeInput_13 : 54|1@1+ (1,0) [0|1] "" Vector__XXX
 SG_ RelayOutput_13 : 56|1@1+ (1,0) [0|1] "" Vector__XXX
 SG_ FaultOouput_13 : 57|1@1+ (1,0) [0|1] "" Vector__XXX
 SG_ AlarmOutput_13 : 58|1@1+ (1,0) [0|1] "" Vector__XXX
 SG_ FutureOutput_13 : 59|1@1+ (1,0) [0|1] "" Vector__XXX
 SG_ Aux12VOutput_13 : 60|1@1+ (1,0) [0|1] "" Vector__XXX
 SG_ CellBalancingActive_12 : 30|2@1+ (1,0) [0|3] "" Vector__XXX
 SG_ CellBalanceStatus_12 : 28|2@1+ (1,0) [0|3] "" Vector__XXX
 SG_ HVBusContactorStNEG_12 : 2|2@1+ (1,0) [0|3] "" Vector__XXX
 SG_ HVBusContactorStPOS_12 : 0|2@1+ (1,0) [0|3] "" Vector__XXX
 SG_ BMSADDR_12 : 48|4@1+ (1,0) [0|15] "" Vector__XXX
 SG_ EStopInput_12 : 52|1@1+ (1,0) [0|1] "" Vector__XXX
 SG_ DischargeKeyInput_12 : 53|1@1+ (1,0) [0|1] "" Vector__XXX
 SG_ ChargeInput_12 : 54|1@1+ (1,0) [0|1] "" Vector__XXX
 SG_ RelayOutput_12 : 56|1@1+ (1,0) [0|1] "" Vector__XXX
 SG_ FaultOouput_12 : 57|1@1+ (1,0) [0|1] "" Vector__XXX
 SG_ AlarmOutput_12 : 58|1@1+ (1,0) [0|1] "" Vector__XXX
 SG_ FutureOutput_12 : 59|1@1+ (1,0) [0|1] "" Vector__XXX
 SG_ Aux12VOutput_12 : 60|1@1+ (1,0) [0|1] "" Vector__XXX
 SG_ CellBalancingActive_11 : 30|2@1+ (1,0) [0|3] "" Vector__XXX
 SG_ CellBalanceStatus_11 : 28|2@1+ (1,0) [0|3] "" Vector__XXX
 SG_ HVBusContactorStNEG_11 : 2|2@1+ (1,0) [0|3] "" Vector__XXX
 SG_ HVBusContactorStPOS_11 : 0|2@1+ (1,0) [0|3] "" Vector__XXX
 SG_ BMSADDR_11 : 48|4@1+ (1,0) [0|15] "" Vector__XXX
 SG_ EStopInput_11 : 52|1@1+ (1,0) [0|1] "" Vector__XXX
 SG_ DischargeKeyInput_11 : 53|1@1+ (1,0) [0|1] "" Vector__XXX
 SG_ ChargeInput_11 : 54|1@1+ (1,0) [0|1] "" Vector__XXX
 SG_ RelayOutput_11 : 56|1@1+ (1,0) [0|1] "" Vector__XXX
 SG_ FaultOouput_11 : 57|1@1+ (1,0) [0|1] "" Vector__XXX
 SG_ AlarmOutput_11 : 58|1@1+ (1,0) [0|1] "" Vector__XXX
 SG_ FutureOutput_11 : 59|1@1+ (1,0) [0|1] "" Vector__XXX
 SG_ Aux12VOutput_11 : 60|1@1+ (1,0) [0|1] "" Vector__XXX
 SG_ CellBalancingActive_10 : 30|2@1+ (1,0) [0|3] "" Vector__XXX
 SG_ CellBalanceStatus_10 : 28|2@1+ (1,0) [0|3] "" Vector__XXX
 SG_ HVBusContactorStNEG_10 : 2|2@1+ (1,0) [0|3] "" Vector__XXX
 SG_ HVBusContactorStPOS_10 : 0|2@1+ (1,0) [0|3] "" Vector__XXX
 SG_ BMSADDR_10 : 48|4@1+ (1,0) [0|15] "" Vector__XXX
 SG_ EStopInput_10 : 52|1@1+ (1,0) [0|1] "" Vector__XXX
 SG_ DischargeKeyInput_10 : 53|1@1+ (1,0) [0|1] "" Vector__XXX
 SG_ ChargeInput_10 : 54|1@1+ (1,0) [0|1] "" Vector__XXX
 SG_ RelayOutput_10 : 56|1@1+ (1,0) [0|1] "" Vector__XXX
 SG_ FaultOouput_10 : 57|1@1+ (1,0) [0|1] "" Vector__XXX
 SG_ AlarmOutput_10 : 58|1@1+ (1,0) [0|1] "" Vector__XXX
 SG_ FutureOutput_10 : 59|1@1+ (1,0) [0|1] "" Vector__XXX
 SG_ Aux12VOutput_10 : 60|1@1+ (1,0) [0|1] "" Vector__XXX
 SG_ CellBalancingActive_09 : 30|2@1+ (1,0) [0|3] "" Vector__XXX
 SG_ CellBalanceStatus_09 : 28|2@1+ (1,0) [0|3] "" Vector__XXX
 SG_ HVBusContactorStNEG_09 : 2|2@1+ (1,0) [0|3] "" Vector__XXX
 SG_ HVBusContactorStPOS_09 : 0|2@1+ (1,0) [0|3] "" Vector__XXX
 SG_ BMSADDR_09 : 48|4@1+ (1,0) [0|15] "" Vector__XXX
 SG_ EStopInput_09 : 52|1@1+ (1,0) [0|1] "" Vector__XXX
 SG_ DischargeKeyInput_09 : 53|1@1+ (1,0) [0|1] "" Vector__XXX
 SG_ ChargeInput_09 : 54|1@1+ (1,0) [0|1] "" Vector__XXX
 SG_ RelayOutput_09 : 56|1@1+ (1,0) [0|1] "" Vector__XXX
 SG_ FaultOouput_09 : 57|1@1+ (1,0) [0|1] "" Vector__XXX
 SG_ AlarmOutput_09 : 58|1@1+ (1,0) [0|1] "" Vector__XXX
 SG_ FutureOutput_09 : 59|1@1+ (1,0) [0|1] "" Vector__XXX
 SG_ Aux12VOutput_09 : 60|1@1+ (1,0) [0|1] "" Vector__XXX
 SG_ CellBalancingActive_08 : 30|2@1+ (1,0) [0|3] "" Vector__XXX
 SG_ CellBalanceStatus_08 : 28|2@1+ (1,0) [0|3] "" Vector__XXX
 SG_ HVBusContactorStNEG_08 : 2|2@1+ (1,0) [0|3] "" Vector__XXX
 SG_ HVBusContactorStPOS_08 : 0|2@1+ (1,0) [0|3] "" Vector__XXX
 SG_ BMSADDR_08 : 48|4@1+ (1,0) [0|15] "" Vector__XXX
 SG_ EStopInput_08 : 52|1@1+ (1,0) [0|1] "" Vector__XXX
 SG_ DischargeKeyInput_08 : 53|1@1+ (1,0) [0|1] "" Vector__XXX
 SG_ ChargeInput_08 : 54|1@1+ (1,0) [0|1] "" Vector__XXX
 SG_ RelayOutput_08 : 56|1@1+ (1,0) [0|1] "" Vector__XXX
 SG_ FaultOouput_08 : 57|1@1+ (1,0) [0|1] "" Vector__XXX
 SG_ AlarmOutput_08 : 58|1@1+ (1,0) [0|1] "" Vector__XXX
 SG_ FutureOutput_08 : 59|1@1+ (1,0) [0|1] "" Vector__XXX
 SG_ Aux12VOutput_08 : 60|1@1+ (1,0) [0|1] "" Vector__XXX
 SG_ CellBalancingActive_07 : 30|2@1+ (1,0) [0|3] "" Vector__XXX
 SG_ CellBalanceStatus_07 : 28|2@1+ (1,0) [0|3] "" Vector__XXX
 SG_ HVBusContactorStNEG_07 : 2|2@1+ (1,0) [0|3] "" Vector__XXX
 SG_ HVBusContactorStPOS_07 : 0|2@1+ (1,0) [0|3] "" Vector__XXX
 SG_ BMSADDR_07 : 48|4@1+ (1,0) [0|15] "" Vector__XXX
 SG_ EStopInput_07 : 52|1@1+ (1,0) [0|1] "" Vector__XXX
 SG_ DischargeKeyInput_07 : 53|1@1+ (1,0) [0|1] "" Vector__XXX
 SG_ ChargeInput_07 : 54|1@1+ (1,0) [0|1] "" Vector__XXX
 SG_ RelayOutput_07 : 56|1@1+ (1,0) [0|1] "" Vector__XXX
 SG_ FaultOouput_07 : 57|1@1+ (1,0) [0|1] "" Vector__XXX
 SG_ AlarmOutput_07 : 58|1@1+ (1,0) [0|1] "" Vector__XXX
 SG_ FutureOutput_07 : 59|1@1+ (1,0) [0|1] "" Vector__XXX
 SG_ Aux12VOutput_07 : 60|1@1+ (1,0) [0|1] "" Vector__XXX
 SG_ CellBalancingActive_06 : 30|2@1+ (1,0) [0|3] "" Vector__XXX
 SG_ CellBalanceStatus_06 : 28|8@1+ (1,0) [0|3] "" Vector__XXX
 SG_ HVBusContactorStNEG_06 : 2|2@1+ (1,0) [0|3] "" Vector__XXX
 SG_ HVBusContactorStPOS_06 : 0|2@1+ (1,0) [0|3] "" Vector__XXX
 SG_ BMSADDR_06 : 48|4@1+ (1,0) [0|15] "" Vector__XXX
 SG_ EStopInput_06 : 52|1@1+ (1,0) [0|1] "" Vector__XXX
 SG_ DischargeKeyInput_06 : 53|1@1+ (1,0) [0|1] "" Vector__XXX
 SG_ ChargeInput_06 : 54|1@1+ (1,0) [0|1] "" Vector__XXX
 SG_ RelayOutput_06 : 56|1@1+ (1,0) [0|1] "" Vector__XXX
 SG_ FaultOouput_06 : 57|1@1+ (1,0) [0|1] "" Vector__XXX
 SG_ AlarmOutput_06 : 58|1@1+ (1,0) [0|1] "" Vector__XXX
 SG_ FutureOutput_06 : 59|1@1+ (1,0) [0|1] "" Vector__XXX
 SG_ Aux12VOutput_06 : 60|1@1+ (1,0) [0|1] "" Vector__XXX
 SG_ CellBalancingActive_05 : 30|2@1+ (1,0) [0|3] "" Vector__XXX
 SG_ CellBalanceStatus_05 : 28|2@1+ (1,0) [0|3] "" Vector__XXX
 SG_ HVBusContactorStNEG_05 : 2|2@1+ (1,0) [0|3] "" Vector__XXX
 SG_ HVBusContactorStPOS_05 : 0|8@1+ (1,0) [0|3] "" Vector__XXX
 SG_ BMSADDR_05 : 48|4@1+ (1,0) [0|15] "" Vector__XXX
 SG_ EStopInput_05 : 52|1@1+ (1,0) [0|1] "" Vector__XXX
 SG_ DischargeKeyInput_05 : 53|1@1+ (1,0) [0|1] "" Vector__XXX
 SG_ ChargeInput_05 : 54|1@1+ (1,0) [0|1] "" Vector__XXX
 SG_ RelayOutput_05 : 56|1@1+ (1,0) [0|1] "" Vector__XXX
 SG_ FaultOouput_05 : 57|1@1+ (1,0) [0|1] "" Vector__XXX
 SG_ AlarmOutput_05 : 58|1@1+ (1,0) [0|1] "" Vector__XXX
 SG_ FutureOutput_05 : 59|1@1+ (1,0) [0|1] "" Vector__XXX
 SG_ Aux12VOutput_05 : 60|1@1+ (1,0) [0|1] "" Vector__XXX
 SG_ CellBalancingActive_04 : 30|2@1+ (1,0) [0|3] "" Vector__XXX
 SG_ CellBalanceStatus_04 : 28|2@1+ (1,0) [0|3] "" Vector__XXX
 SG_ HVBusContactorStNEG_04 : 2|2@1+ (1,0) [0|3] "" Vector__XXX
 SG_ HVBusContactorStPOS_04 : 0|2@1+ (1,0) [0|3] "" Vector__XXX
 SG_ BMSADDR_04 : 48|4@1+ (1,0) [0|1] "" Vector__XXX
 SG_ EStopInput_04 : 52|1@1+ (1,0) [0|1] "" Vector__XXX
 SG_ DischargeKeyInput_04 : 53|1@1+ (1,0) [0|1] "" Vector__XXX
 SG_ ChargeInput_04 : 54|1@1+ (1,0) [0|1] "" Vector__XXX
 SG_ RelayOutput_04 : 56|1@1+ (1,0) [0|1] "" Vector__XXX
 SG_ FaultOouput_04 : 57|1@1+ (1,0) [0|1] "" Vector__XXX
 SG_ AlarmOutput_04 : 58|1@1+ (1,0) [0|1] "" Vector__XXX
 SG_ FutureOutput_04 : 59|1@1+ (1,0) [0|1] "" Vector__XXX
 SG_ Aux12VOutput_04 : 60|1@1+ (1,0) [0|1] "" Vector__XXX
 SG_ CellBalancingActive_03 : 30|2@1+ (1,0) [0|3] "" Vector__XXX
 SG_ CellBalanceStatus_03 : 28|2@1+ (1,0) [0|3] "" Vector__XXX
 SG_ HVBusContactorStNEG_03 : 2|2@1+ (1,0) [0|3] "" Vector__XXX
 SG_ HVBusContactorStPOS_03 : 0|2@1+ (1,0) [0|3] "" Vector__XXX
 SG_ BMSADDR_03 : 48|4@1+ (1,0) [0|1] "" Vector__XXX
 SG_ EStopInput_03 : 52|1@1+ (1,0) [0|1] "" Vector__XXX
 SG_ DischargeKeyInput_03 : 53|1@1+ (1,0) [0|1] "" Vector__XXX
 SG_ ChargeInput_03 : 54|1@1+ (1,0) [0|1] "" Vector__XXX
 SG_ RelayOutput_03 : 56|1@1+ (1,0) [0|1] "" Vector__XXX
 SG_ FaultOouput_03 : 57|1@1+ (1,0) [0|1] "" Vector__XXX
 SG_ AlarmOutput_03 : 58|1@1+ (1,0) [0|1] "" Vector__XXX
 SG_ FutureOutput_03 : 59|1@1+ (1,0) [0|1] "" Vector__XXX
 SG_ Aux12VOutput_03 : 60|1@1+ (1,0) [0|1] "" Vector__XXX
 SG_ BusVoltage_14 : 0|16@1+ (1,0) [0|65535] "mV" Vector__XXX
 SG_ BusVoltage_13 : 0|16@1+ (1,0) [0|65535] "mV" Vector__XXX
 SG_ BusVoltage_12 : 0|16@1+ (1,0) [0|65535] "mV" Vector__XXX
 SG_ BusVoltage_11 : 0|16@1+ (1,0) [0|65535] "mV" Vector__XXX
 SG_ BusVoltage_10 : 0|16@1+ (1,0) [0|65535] "mV" Vector__XXX
 SG_ BusVoltage_09 : 0|16@1+ (1,0) [0|65535] "mV" Vector__XXX
 SG_ BusVoltage_08 : 0|16@1+ (1,0) [0|65535] "mV" Vector__XXX
 SG_ BusVoltage_07 : 0|16@1+ (1,0) [0|65535] "mV" Vector__XXX
 SG_ BusVoltage_06 : 0|16@1+ (1,0) [0|65535] "mV" Vector__XXX
 SG_ BusVoltage_05 : 0|16@1+ (1,0) [0|65535] "mV" Vector__XXX
 SG_ BusVoltage_04 : 0|16@1+ (1,0) [0|65535] "mV" Vector__XXX
 SG_ BusVoltage_03 : 0|16@1+ (1,0) [0|65535] "mV" Vector__XXX
 SG_ ChargeCapacity_14 : 16|16@1+ (10,0) [0|655350] "mAh" Vector__XXX
 SG_ DischargeCapacity_14 : 0|16@1+ (10,0) [0|655350] "mAh" Vector__XXX
 SG_ AvailableCapacity_14 : 32|32@1+ (1,0) [0|2147480000] "mASec" Vector__XXX
 SG_ ChargeCapacity_13 : 16|16@1+ (10,0) [0|655350] "mAh" Vector__XXX
 SG_ DischargeCapacity_13 : 0|16@1+ (10,0) [0|655350] "mAh" Vector__XXX
 SG_ AvailableCapacity_13 : 32|32@1+ (1,0) [0|2147480000] "mASec" Vector__XXX
 SG_ ChargeCapacity_12 : 16|16@1+ (10,0) [0|655350] "mAh" Vector__XXX
 SG_ DischargeCapacity_12 : 0|16@1+ (10,0) [0|655350] "mAh" Vector__XXX
 SG_ AvailableCapacity_12 : 32|32@1+ (1,0) [0|2147480000] "mASec" Vector__XXX
 SG_ ChargeCapacity_11 : 16|16@1+ (10,0) [0|655350] "mAh" Vector__XXX
 SG_ DischargeCapacity_11 : 0|16@1+ (10,0) [0|655350] "mAh" Vector__XXX
 SG_ AvailableCapacity_11 : 32|32@1+ (1,0) [0|2147480000] "mASec" Vector__XXX
 SG_ ChargeCapacity_10 : 16|16@1+ (10,0) [0|655350] "mAh" Vector__XXX
 SG_ DischargeCapacity_10 : 0|16@1+ (10,0) [0|655350] "mAh" Vector__XXX
 SG_ AvailableCapacity_10 : 32|32@1+ (1,0) [0|2147480000] "mASec" Vector__XXX
 SG_ ChargeCapacity_09 : 16|16@1+ (10,0) [0|655350] "mAh" Vector__XXX
 SG_ DischargeCapacity_09 : 0|16@1+ (10,0) [0|655350] "mAh" Vector__XXX
 SG_ AvailableCapacity_09 : 32|32@1+ (1,0) [0|2147480000] "mASec" Vector__XXX
 SG_ ChargeCapacity_08 : 16|16@1+ (10,0) [0|655350] "mAh" Vector__XXX
 SG_ DischargeCapacity_08 : 0|16@1+ (10,0) [0|655350] "mAh" Vector__XXX
 SG_ AvailableCapacity_08 : 32|32@1+ (1,0) [0|2147480000] "mASec" Vector__XXX
 SG_ ChargeCapacity_07 : 16|16@1+ (10,0) [0|655350] "mAh" Vector__XXX
 SG_ DischargeCapacity_07 : 0|16@1+ (10,0) [0|655350] "mAh" Vector__XXX
 SG_ AvailableCapacity_07 : 32|32@1+ (1,0) [0|2147480000] "mASec" Vector__XXX
 SG_ ChargeCapacity_06 : 16|16@1+ (10,0) [0|655350] "mAh" Vector__XXX
 SG_ DischargeCapacity_06 : 0|16@1+ (10,0) [0|655350] "mAh" Vector__XXX
 SG_ AvailableCapacity_06 : 32|32@1+ (1,0) [0|2147480000] "mASec" Vector__XXX
 SG_ ChargeCapacity_05 : 16|16@1+ (10,0) [0|655350] "mAh" Vector__XXX
 SG_ DischargeCapacity_05 : 0|16@1+ (10,0) [0|655350] "mAh" Vector__XXX
 SG_ AvailableCapacity_05 : 32|32@1+ (1,0) [0|2147480000] "mASec" Vector__XXX
 SG_ ChargeCapacity_04 : 16|16@1+ (10,0) [0|655350] "mAh" Vector__XXX
 SG_ DischargeCapacity_04 : 0|16@1+ (10,0) [0|655350] "mAh" Vector__XXX
 SG_ AvailableCapacity_04 : 32|32@1+ (1,0) [0|2147480000] "mASec" Vector__XXX
 SG_ ChargeCapacity_03 : 16|16@1+ (10,0) [0|655350] "mAh" Vector__XXX
 SG_ DischargeCapacity_03 : 0|16@1+ (10,0) [0|655350] "mAh" Vector__XXX
 SG_ AvailableCapacity_03 : 32|32@1+ (1,0) [0|2147480000] "mASec" Vector__XXX
 SG_ Temperature1_14 : 0|8@1- (1,-40) [-40|210] "C" Vector__XXX
 SG_ Temperature2_14 : 8|8@1- (1,-40) [-40|210] "C" Vector__XXX
 SG_ Temperature3_14 : 16|8@1- (1,-40) [-40|210] "C" Vector__XXX
 SG_ Temperature4_14 : 24|8@1- (1,-40) [-40|210] "C" Vector__XXX
 SG_ Temperature5_14 : 32|8@1- (1,-40) [-40|210] "C" Vector__XXX
 SG_ Temperature6_14 : 40|8@1- (1,-40) [-40|210] "C" Vector__XXX
 SG_ Temperature7_14 : 48|8@1- (1,-40) [-40|210] "C" Vector__XXX
 SG_ Temperature1_13 : 0|8@1- (1,-40) [-40|210] "C" Vector__XXX
 SG_ Temperature2_13 : 8|8@1- (1,-40) [-40|210] "C" Vector__XXX
 SG_ Temperature3_13 : 16|8@1- (1,-40) [-40|210] "C" Vector__XXX
 SG_ Temperature4_13 : 24|8@1- (1,-40) [-40|210] "C" Vector__XXX
 SG_ Temperature5_13 : 32|8@1- (1,-40) [-40|210] "C" Vector__XXX
 SG_ Temperature6_13 : 40|8@1- (1,-40) [-40|210] "C" Vector__XXX
 SG_ Temperature7_13 : 48|8@1- (1,-40) [-40|210] "C" Vector__XXX
 SG_ Temperature1_12 : 0|8@1- (1,-40) [-40|210] "C" Vector__XXX
 SG_ Temperature2_12 : 8|8@1- (1,-40) [-40|210] "C" Vector__XXX
 SG_ Temperature3_12 : 16|8@1- (1,-40) [-40|210] "C" Vector__XXX
 SG_ Temperature4_12 : 24|8@1- (1,-40) [-40|210] "C" Vector__XXX
 SG_ Temperature5_12 : 32|8@1- (1,-40) [-40|210] "C" Vector__XXX
 SG_ Temperature6_12 : 40|8@1- (1,-40) [-40|210] "C" Vector__XXX
 SG_ Temperature7_12 : 48|8@1- (1,-40) [-40|210] "C" Vector__XXX
 SG_ Temperature1_11 : 0|8@1- (1,-40) [-40|210] "C" Vector__XXX
 SG_ Temperature2_11 : 8|8@1- (1,-40) [-40|210] "C" Vector__XXX
 SG_ Temperature3_11 : 16|8@1- (1,-40) [-40|210] "C" Vector__XXX
 SG_ Temperature4_11 : 24|8@1- (1,-40) [-40|210] "C" Vector__XXX
 SG_ Temperature5_11 : 32|8@1- (1,-40) [-40|210] "C" Vector__XXX
 SG_ Temperature6_11 : 40|8@1- (1,-40) [-40|210] "C" Vector__XXX
 SG_ Temperature7_11 : 48|8@1- (1,-40) [-40|210] "C" Vector__XXX
 SG_ Temperature1_10 : 0|8@1- (1,-40) [-40|210] "C" Vector__XXX
 SG_ Temperature2_10 : 8|8@1- (1,-40) [-40|210] "C" Vector__XXX
 SG_ Temperature3_10 : 16|8@1- (1,-40) [-40|210] "C" Vector__XXX
 SG_ Temperature4_10 : 24|8@1- (1,-40) [-40|210] "C" Vector__XXX
 SG_ Temperature5_10 : 32|8@1- (1,-40) [-40|210] "C" Vector__XXX
 SG_ Temperature6_10 : 40|8@1- (1,-40) [-40|210] "C" Vector__XXX
 SG_ Temperature7_10 : 48|8@1- (1,-40) [-40|210] "C" Vector__XXX
 SG_ Temperature1_09 : 0|8@1- (1,-40) [-40|210] "C" Vector__XXX
 SG_ Temperature2_09 : 8|8@1- (1,-40) [-40|210] "C" Vector__XXX
 SG_ Temperature3_09 : 16|8@1- (1,-40) [-40|210] "C" Vector__XXX
 SG_ Temperature4_09 : 24|8@1- (1,-40) [-40|210] "C" Vector__XXX
 SG_ Temperature5_09 : 32|8@1- (1,-40) [-40|210] "C" Vector__XXX
 SG_ Temperature6_09 : 40|8@1- (1,-40) [-40|210] "C" Vector__XXX
 SG_ Temperature7_09 : 48|8@1- (1,-40) [-40|210] "C" Vector__XXX
 SG_ Temperature1_08 : 0|8@1- (1,-40) [-40|210] "C" Vector__XXX
 SG_ Temperature2_08 : 8|8@1- (1,-40) [-40|210] "C" Vector__XXX
 SG_ Temperature3_08 : 16|8@1- (1,-40) [-40|210] "C" Vector__XXX
 SG_ Temperature4_08 : 24|8@1- (1,-40) [-40|210] "C" Vector__XXX
 SG_ Temperature5_08 : 32|8@1- (1,-40) [-40|210] "C" Vector__XXX
 SG_ Temperature6_08 : 40|8@1- (1,-40) [-40|210] "C" Vector__XXX
 SG_ Temperature7_08 : 48|8@1- (1,-40) [-40|210] "C" Vector__XXX
 SG_ Temperature1_07 : 0|8@1- (1,-40) [-40|210] "C" Vector__XXX
 SG_ Temperature2_07 : 8|8@1- (1,-40) [-40|210] "C" Vector__XXX
 SG_ Temperature3_07 : 16|8@1- (1,-40) [-40|210] "C" Vector__XXX
 SG_ Temperature4_07 : 24|8@1- (1,-40) [-40|210] "C" Vector__XXX
 SG_ Temperature5_07 : 32|8@1- (1,-40) [-40|210] "C" Vector__XXX
 SG_ Temperature6_07 : 40|8@1- (1,-40) [-40|210] "C" Vector__XXX
 SG_ Temperature7_07 : 48|8@1- (1,-40) [-40|210] "C" Vector__XXX
 SG_ Temperature1_06 : 0|8@1- (1,-40) [-40|210] "C" Vector__XXX
 SG_ Temperature2_06 : 8|8@1- (1,-40) [-40|210] "C" Vector__XXX
 SG_ Temperature3_06 : 16|8@1- (1,-40) [-40|210] "C" Vector__XXX
 SG_ Temperature4_06 : 24|8@1- (1,-40) [-40|210] "C" Vector__XXX
 SG_ Temperature5_06 : 32|8@1- (1,-40) [-40|210] "C" Vector__XXX
 SG_ Temperature6_06 : 40|8@1- (1,-40) [-40|210] "C" Vector__XXX
 SG_ Temperature7_06 : 48|8@1- (1,-40) [-40|210] "C" Vector__XXX
 SG_ Temperature1_05 : 0|8@1- (1,-40) [-40|210] "C" Vector__XXX
 SG_ Temperature2_05 : 8|8@1- (1,-40) [-40|210] "C" Vector__XXX
 SG_ Temperature3_05 : 16|8@1- (1,-40) [-40|210] "C" Vector__XXX
 SG_ Temperature4_05 : 24|8@1- (1,-40) [-40|210] "C" Vector__XXX
 SG_ Temperature5_05 : 32|8@1- (1,-40) [-40|210] "C" Vector__XXX
 SG_ Temperature6_05 : 40|8@1- (1,-40) [-40|210] "C" Vector__XXX
 SG_ Temperature7_05 : 48|8@1- (1,-40) [-40|210] "C" Vector__XXX
 SG_ Temperature1_04 : 0|8@1- (1,-40) [-40|210] "C" Vector__XXX
 SG_ Temperature2_04 : 8|8@1- (1,-40) [-40|210] "C" Vector__XXX
 SG_ Temperature3_04 : 16|8@1- (1,-40) [-40|210] "C" Vector__XXX
 SG_ Temperature4_04 : 24|8@1- (1,-40) [-40|210] "C" Vector__XXX
 SG_ Temperature5_04 : 32|8@1- (1,-40) [-40|210] "C" Vector__XXX
 SG_ Temperature6_04 : 40|8@1- (1,-40) [-40|210] "C" Vector__XXX
 SG_ Temperature7_04 : 48|8@1- (1,-40) [-40|210] "C" Vector__XXX
 SG_ Temperature1_03 : 0|8@1- (1,-40) [-40|210] "C" Vector__XXX
 SG_ Temperature2_03 : 8|8@1- (1,-40) [-40|210] "C" Vector__XXX
 SG_ Temperature3_03 : 16|8@1- (1,-40) [-40|210] "C" Vector__XXX
 SG_ Temperature4_03 : 24|8@1- (1,-40) [-40|210] "C" Vector__XXX
 SG_ Temperature5_03 : 32|8@1- (1,-40) [-40|210] "C" Vector__XXX
 SG_ Temperature6_03 : 40|8@1- (1,-40) [-40|210] "C" Vector__XXX
 SG_ Temperature7_03 : 48|8@1- (1,-40) [-40|210] "C" Vector__XXX
 SG_ Temperature8_14 : 0|8@1- (1,-40) [-40|210] "C" Vector__XXX
 SG_ Temperature9_14 : 8|8@1- (1,-40) [-40|210] "C" Vector__XXX
 SG_ Temperature10_14 : 16|8@1- (1,-40) [-40|210] "C" Vector__XXX
 SG_ Temperature11_14 : 24|8@1- (1,-40) [-40|210] "C" Vector__XXX
 SG_ Temperature12_14 : 32|8@1- (1,-40) [-40|210] "C" Vector__XXX
 SG_ Temperature13_14 : 40|8@1- (1,-40) [-40|210] "C" Vector__XXX
 SG_ Temperature14_14 : 48|8@1- (1,-40) [-40|210] "C" Vector__XXX
 SG_ Temperature8_13 : 0|8@1- (1,-40) [-40|210] "C" Vector__XXX
 SG_ Temperature9_13 : 8|8@1- (1,-40) [-40|210] "C" Vector__XXX
 SG_ Temperature10_13 : 16|8@1- (1,-40) [-40|210] "C" Vector__XXX
 SG_ Temperature11_13 : 24|8@1- (1,-40) [-40|210] "C" Vector__XXX
 SG_ Temperature12_13 : 32|8@1- (1,-40) [-40|210] "C" Vector__XXX
 SG_ Temperature13_13 : 40|8@1- (1,-40) [-40|210] "C" Vector__XXX
 SG_ Temperature14_13 : 48|8@1- (1,-40) [-40|210] "C" Vector__XXX
 SG_ Temperature8_12 : 0|8@1- (1,-40) [-40|210] "C" Vector__XXX
 SG_ Temperature9_12 : 8|8@1- (1,-40) [-40|210] "C" Vector__XXX
 SG_ Temperature10_12 : 16|8@1- (1,-40) [-40|210] "C" Vector__XXX
 SG_ Temperature11_12 : 24|8@1- (1,-40) [-40|210] "C" Vector__XXX
 SG_ Temperature12_12 : 32|8@1- (1,-40) [-40|210] "C" Vector__XXX
 SG_ Temperature13_12 : 40|8@1- (1,-40) [-40|210] "C" Vector__XXX
 SG_ Temperature14_12 : 48|8@1- (1,-40) [-40|210] "C" Vector__XXX
 SG_ Temperature8_11 : 0|8@1- (1,-40) [-40|210] "" Vector__XXX
 SG_ Temperature9_11 : 8|8@1- (1,-40) [-40|210] "" Vector__XXX
 SG_ Temperature10_11 : 16|8@1- (1,-40) [-40|210] "" Vector__XXX
 SG_ Temperature11_11 : 24|8@1- (1,-40) [-40|210] "" Vector__XXX
 SG_ Temperature12_11 : 32|8@1- (1,-40) [-40|210] "" Vector__XXX
 SG_ Temperature13_11 : 40|8@1- (1,-40) [-40|210] "" Vector__XXX
 SG_ Temperature14_11 : 48|8@1- (1,-40) [-40|210] "" Vector__XXX
 SG_ Temperature8_10 : 0|8@1- (1,-40) [-40|210] "C" Vector__XXX
 SG_ Temperature9_10 : 8|8@1- (1,-40) [-40|210] "C" Vector__XXX
 SG_ Temperature10_10 : 16|8@1- (1,-40) [-40|210] "C" Vector__XXX
 SG_ Temperature11_10 : 24|8@1- (1,-40) [-40|210] "C" Vector__XXX
 SG_ Temperature12_10 : 32|8@1- (1,-40) [-40|210] "C" Vector__XXX
 SG_ Temperature13_10 : 40|8@1- (1,-40) [-40|210] "C" Vector__XXX
 SG_ Temperature14_10 : 48|8@1- (1,-40) [-40|210] "C" Vector__XXX
 SG_ Temperature8_09 : 0|8@1- (1,-40) [-40|210] "C" Vector__XXX
 SG_ Temperature9_09 : 8|8@1- (1,-40) [-40|210] "C" Vector__XXX
 SG_ Temperature10_09 : 16|8@1- (1,-40) [-40|210] "C" Vector__XXX
 SG_ Temperature11_09 : 24|8@1- (1,-40) [-40|210] "C" Vector__XXX
 SG_ Temperature12_09 : 32|8@1- (1,-40) [-40|210] "C" Vector__XXX
 SG_ Temperature13_09 : 40|8@1- (1,-40) [-40|210] "C" Vector__XXX
 SG_ Temperature14_09 : 48|8@1- (1,-40) [-40|210] "C" Vector__XXX
 SG_ Temperature8_08 : 0|8@1- (1,-40) [-40|210] "C" Vector__XXX
 SG_ Temperature9_08 : 8|8@1- (1,-40) [-40|210] "C" Vector__XXX
 SG_ Temperature10_08 : 16|8@1- (1,-40) [-40|210] "C" Vector__XXX
 SG_ Temperature11_08 : 24|8@1- (1,-40) [-40|210] "C" Vector__XXX
 SG_ Temperature12_08 : 32|8@1- (1,-40) [-40|210] "C" Vector__XXX
 SG_ Temperature13_08 : 40|8@1- (1,-40) [-40|210] "C" Vector__XXX
 SG_ Temperature14_08 : 48|8@1- (1,-40) [-40|210] "C" Vector__XXX
 SG_ Temperature8_07 : 0|8@1- (1,-40) [-40|210] "C" Vector__XXX
 SG_ Temperature9_07 : 8|8@1- (1,-40) [-40|210] "C" Vector__XXX
 SG_ Temperature10_07 : 16|8@1- (1,-40) [-40|210] "C" Vector__XXX
 SG_ Temperature11_07 : 24|8@1- (1,-40) [-40|210] "C" Vector__XXX
 SG_ Temperature12_07 : 32|8@1- (1,-40) [-40|210] "C" Vector__XXX
 SG_ Temperature13_07 : 40|8@1- (1,-40) [-40|210] "C" Vector__XXX
 SG_ Temperature14_07 : 48|8@1- (1,-40) [-40|210] "C" Vector__XXX
 SG_ Temperature8_06 : 0|8@1- (1,-40) [-40|210] "C" Vector__XXX
 SG_ Temperature9_06 : 8|8@1- (1,-40) [-40|210] "C" Vector__XXX
 SG_ Temperature10_06 : 16|8@1- (1,-40) [-40|210] "C" Vector__XXX
 SG_ Temperature11_06 : 24|8@1- (1,-40) [-40|210] "C" Vector__XXX
 SG_ Temperature12_06 : 32|8@1- (1,-40) [-40|210] "C" Vector__XXX
 SG_ Temperature13_06 : 40|8@1- (1,-40) [-40|210] "C" Vector__XXX
 SG_ Temperature14_06 : 48|8@1- (1,-40) [-40|210] "C" Vector__XXX
 SG_ Temperature8_05 : 0|8@1- (1,-40) [-40|210] "C" Vector__XXX
 SG_ Temperature9_05 : 8|8@1- (1,-40) [-40|210] "C" Vector__XXX
 SG_ Temperature10_05 : 16|8@1- (1,-40) [-40|210] "C" Vector__XXX
 SG_ Temperature11_05 : 24|8@1- (1,-40) [-40|210] "C" Vector__XXX
 SG_ Temperature12_05 : 32|8@1- (1,-40) [-40|210] "C" Vector__XXX
 SG_ Temperature13_05 : 40|8@1- (1,-40) [-40|210] "C" Vector__XXX
 SG_ Temperature14_05 : 48|8@1- (1,-40) [-40|210] "C" Vector__XXX
 SG_ Temperature8_04 : 0|8@1- (1,-40) [-40|210] "C" Vector__XXX
 SG_ Temperature9_04 : 8|8@1- (1,-40) [-40|210] "C" Vector__XXX
 SG_ Temperature10_04 : 16|8@1- (1,-40) [-40|210] "C" Vector__XXX
 SG_ Temperature11_04 : 24|8@1- (1,-40) [-40|210] "C" Vector__XXX
 SG_ Temperature12_04 : 32|8@1- (1,-40) [-40|210] "C" Vector__XXX
 SG_ Temperature13_04 : 40|8@1- (1,-40) [-40|210] "C" Vector__XXX
 SG_ Temperature14_04 : 48|8@1- (1,-40) [-40|210] "C" Vector__XXX
 SG_ Temperature8_03 : 0|8@1- (1,-40) [-40|210] "" Vector__XXX
 SG_ Temperature9_03 : 8|8@1- (1,-40) [-40|210] "" Vector__XXX
 SG_ Temperature10_03 : 16|8@1- (1,-40) [-40|210] "" Vector__XXX
 SG_ Temperature11_03 : 24|8@1- (1,-40) [-40|210] "" Vector__XXX
 SG_ Temperature12_03 : 32|8@1- (1,-40) [-40|210] "" Vector__XXX
 SG_ Temperature13_03 : 40|8@1- (1,-40) [-40|210] "" Vector__XXX
 SG_ Temperature14_03 : 48|8@1- (1,-40) [-40|210] "" Vector__XXX
 SG_ VoltageCell1_14 : 0|16@1+ (1,0) [0|65535] "mV" Vector__XXX
 SG_ VoltageCell2_14 : 16|16@1+ (1,0) [0|65535] "mV" Vector__XXX
 SG_ VoltageCell3_14 : 32|16@1+ (1,0) [0|65535] "mV" Vector__XXX
 SG_ VoltageCell4_14 : 48|16@1+ (1,0) [0|65535] "mV" Vector__XXX
 SG_ VoltageCell1_13 : 0|16@1+ (1,0) [0|65535] "mV" Vector__XXX
 SG_ VoltageCell2_13 : 16|16@1+ (1,0) [0|65535] "mV" Vector__XXX
 SG_ VoltageCell3_13 : 32|16@1+ (1,0) [0|65535] "mV" Vector__XXX
 SG_ VoltageCell4_13 : 48|16@1+ (1,0) [0|65535] "mV" Vector__XXX
 SG_ VoltageCell1_12 : 0|16@1+ (1,0) [0|65535] "mV" Vector__XXX
 SG_ VoltageCell2_12 : 16|16@1+ (1,0) [0|65535] "mV" Vector__XXX
 SG_ VoltageCell3_12 : 32|16@1+ (1,0) [0|65535] "mV" Vector__XXX
 SG_ VoltageCell4_12 : 48|16@1+ (1,0) [0|65535] "mV" Vector__XXX
 SG_ VoltageCell1_11 : 0|16@1+ (1,0) [0|65535] "mV" Vector__XXX
 SG_ VoltageCell2_11 : 16|16@1+ (1,0) [0|65535] "mV" Vector__XXX
 SG_ VoltageCell3_11 : 32|16@1+ (1,0) [0|65535] "mV" Vector__XXX
 SG_ VoltageCell4_11 : 48|16@1+ (1,0) [0|65535] "mV" Vector__XXX
 SG_ VoltageCell1_10 : 0|16@1+ (1,0) [0|65535] "mV" Vector__XXX
 SG_ VoltageCell2_10 : 16|16@1+ (1,0) [0|65535] "mV" Vector__XXX
 SG_ VoltageCell3_10 : 32|16@1+ (1,0) [0|65535] "mV" Vector__XXX
 SG_ VoltageCell4_10 : 48|16@1+ (1,0) [0|65535] "mV" Vector__XXX
 SG_ VoltageCell1_09 : 0|16@1+ (1,0) [0|65535] "mV" Vector__XXX
 SG_ VoltageCell2_09 : 16|16@1+ (1,0) [0|65535] "mV" Vector__XXX
 SG_ VoltageCell3_09 : 32|16@1+ (1,0) [0|65535] "mV" Vector__XXX
 SG_ VoltageCell4_09 : 48|16@1+ (1,0) [0|65535] "mV" Vector__XXX
 SG_ VoltageCell1_08 : 0|16@1+ (1,0) [0|65535] "mV" Vector__XXX
 SG_ VoltageCell2_08 : 16|16@1+ (1,0) [0|65535] "mV" Vector__XXX
 SG_ VoltageCell3_08 : 32|16@1+ (1,0) [0|65535] "mV" Vector__XXX
 SG_ VoltageCell4_08 : 48|16@1+ (1,0) [0|65535] "mV" Vector__XXX
 SG_ VoltageCell1_07 : 0|16@1+ (1,0) [0|65535] "mV" Vector__XXX
 SG_ VoltageCell2_07 : 16|16@1+ (1,0) [0|65535] "mV" Vector__XXX
 SG_ VoltageCell3_07 : 32|16@1+ (1,0) [0|65535] "mV" Vector__XXX
 SG_ VoltageCell4_07 : 48|16@1+ (1,0) [0|65535] "mV" Vector__XXX
 SG_ VoltageCell1_06 : 0|16@1+ (1,0) [0|65535] "mV" Vector__XXX
 SG_ VoltageCell2_06 : 16|16@1+ (1,0) [0|65535] "mV" Vector__XXX
 SG_ VoltageCell3_06 : 32|16@1+ (1,0) [0|65535] "mV" Vector__XXX
 SG_ VoltageCell4_06 : 48|16@1+ (1,0) [0|65535] "mV" Vector__XXX
 SG_ VoltageCell1_05 : 0|16@1+ (1,0) [0|65535] "mV" Vector__XXX
 SG_ VoltageCell2_05 : 16|16@1+ (1,0) [0|65535] "mV" Vector__XXX
 SG_ VoltageCell3_05 : 32|16@1+ (1,0) [0|65535] "mV" Vector__XXX
 SG_ VoltageCell4_05 : 48|16@1+ (1,0) [0|65535] "mV" Vector__XXX
 SG_ VoltageCell1_04 : 0|16@1+ (1,0) [0|65535] "mV" Vector__XXX
 SG_ VoltageCell2_04 : 16|16@1+ (1,0) [0|65535] "mV" Vector__XXX
 SG_ VoltageCell3_04 : 32|16@1+ (1,0) [0|65535] "mV" Vector__XXX
 SG_ VoltageCell4_04 : 48|16@1+ (1,0) [0|65535] "mV" Vector__XXX
 SG_ VoltageCell1_03 : 0|16@1+ (1,0) [0|65535] "mV" Vector__XXX
 SG_ VoltageCell2_03 : 16|16@1+ (1,0) [0|65535] "mV" Vector__XXX
 SG_ VoltageCell3_03 : 32|16@1+ (1,0) [0|65535] "mV" Vector__XXX
 SG_ VoltageCell4_03 : 48|16@1+ (1,0) [0|65535] "mV" Vector__XXX
 SG_ VoltageCell9_14 : 0|16@1+ (1,0) [0|65535] "mV" Vector__XXX
 SG_ VoltageCell10_14 : 16|16@1+ (1,0) [0|65535] "mV" Vector__XXX
 SG_ VoltageCell11_14 : 32|16@1+ (1,0) [0|65535] "mV" Vector__XXX
 SG_ VoltageCell12_14 : 48|16@1+ (1,0) [0|65535] "mV" Vector__XXX
 SG_ VoltageCell9_13 : 0|16@1+ (1,0) [0|65535] "mV" Vector__XXX
 SG_ VoltageCell10_13 : 16|16@1+ (1,0) [0|65535] "mV" Vector__XXX
 SG_ VoltageCell11_13 : 32|16@1+ (1,0) [0|65535] "mV" Vector__XXX
 SG_ VoltageCell12_13 : 48|16@1+ (1,0) [0|65535] "mV" Vector__XXX
 SG_ VoltageCell9_12 : 0|16@1+ (1,0) [0|65535] "mV" Vector__XXX
 SG_ VoltageCell10_12 : 16|16@1+ (1,0) [0|65535] "mV" Vector__XXX
 SG_ VoltageCell11_12 : 32|16@1+ (1,0) [0|65535] "mV" Vector__XXX
 SG_ VoltageCell12_12 : 48|16@1+ (1,0) [0|65535] "mV" Vector__XXX
 SG_ VoltageCell9_11 : 0|16@1+ (1,0) [0|65535] "mV" Vector__XXX
 SG_ VoltageCell10_11 : 16|16@1+ (1,0) [0|65535] "mV" Vector__XXX
 SG_ VoltageCell11_11 : 32|16@1+ (1,0) [0|65535] "mV" Vector__XXX
 SG_ VoltageCell12_11 : 48|16@1+ (1,0) [0|65535] "mV" Vector__XXX
 SG_ VoltageCell9_10 : 0|16@1+ (1,0) [0|65535] "mV" Vector__XXX
 SG_ VoltageCell10_10 : 16|16@1+ (1,0) [0|65535] "mV" Vector__XXX
 SG_ VoltageCell11_10 : 32|16@1+ (1,0) [0|65535] "mV" Vector__XXX
 SG_ VoltageCell12_10 : 48|16@1+ (1,0) [0|65535] "mV" Vector__XXX
 SG_ VoltageCell9_09 : 0|16@1+ (1,0) [0|65535] "mV" Vector__XXX
 SG_ VoltageCell10_09 : 16|16@1+ (1,0) [0|65535] "mV" Vector__XXX
 SG_ VoltageCell11_09 : 32|16@1+ (1,0) [0|65535] "mV" Vector__XXX
 SG_ VoltageCell12_09 : 48|16@1+ (1,0) [0|65535] "mV" Vector__XXX
 SG_ VoltageCell9_08 : 0|16@1+ (1,0) [0|65535] "mV" Vector__XXX
 SG_ VoltageCell10_08 : 16|16@1+ (1,0) [0|65535] "mV" Vector__XXX
 SG_ VoltageCell11_08 : 32|16@1+ (1,0) [0|65535] "mV" Vector__XXX
 SG_ VoltageCell12_08 : 48|16@1+ (1,0) [0|65535] "mV" Vector__XXX
 SG_ VoltageCell9_07 : 0|16@1+ (1,0) [0|65535] "mV" Vector__XXX
 SG_ VoltageCell10_07 : 16|16@1+ (1,0) [0|65535] "mV" Vector__XXX
 SG_ VoltageCell11_07 : 32|16@1+ (1,0) [0|65535] "mV" Vector__XXX
 SG_ VoltageCell12_07 : 48|16@1+ (1,0) [0|65535] "mV" Vector__XXX
 SG_ VoltageCell9_06 : 0|16@1+ (1,0) [0|65535] "mV" Vector__XXX
 SG_ VoltageCell10_06 : 16|16@1+ (1,0) [0|65535] "mV" Vector__XXX
 SG_ VoltageCell11_06 : 32|16@1+ (1,0) [0|65535] "mV" Vector__XXX
 SG_ VoltageCell12_06 : 48|16@1+ (1,0) [0|65535] "mV" Vector__XXX
 SG_ VoltageCell9_05 : 0|16@1+ (1,0) [0|65535] "mV" Vector__XXX
 SG_ VoltageCell10_05 : 16|16@1+ (1,0) [0|65535] "mV" Vector__XXX
 SG_ VoltageCell11_05 : 32|16@1+ (1,0) [0|65535] "mV" Vector__XXX
 SG_ VoltageCell12_05 : 48|16@1+ (1,0) [0|65535] "mV" Vector__XXX
 SG_ VoltageCell9_04 : 0|16@1+ (1,0) [0|65535] "mV" Vector__XXX
 SG_ VoltageCell10_04 : 16|16@1+ (1,0) [0|65535] "mV" Vector__XXX
 SG_ VoltageCell11_04 : 32|16@1+ (1,0) [0|65535] "mV" Vector__XXX
 SG_ VoltageCell12_04 : 48|16@1+ (1,0) [0|65535] "mV" Vector__XXX
 SG_ VoltageCell9_03 : 0|16@1+ (1,0) [0|65535] "mV" Vector__XXX
 SG_ VoltageCell10_03 : 16|16@1+ (1,0) [0|65535] "mV" Vector__XXX
 SG_ VoltageCell11_03 : 32|16@1+ (1,0) [0|65535] "mV" Vector__XXX
 SG_ VoltageCell12_03 : 48|16@1+ (1,0) [0|65535] "mV" Vector__XXX
 SG_ ReadVoltAndStatusCMD : 0|8@1+ (1,0) [0|255] "" Vector__XXX
 SG_ BMS_Self_Number : 8|8@1+ (1,0) [0|255] "" Vector__XXX
 SG_ BatteryVoltage : 16|32@1+ (1,0) [0|1000000] "mv" Vector__XXX
 SG_ MainRunCommMode : 48|1@1+ (1,0) [0|1] "" Vector__XXX
 SG_ MainRunDischargeMode : 49|1@1+ (1,0) [0|1] "" Vector__XXX
 SG_ MainRunChargeMode : 50|1@1+ (1,0) [0|1] "" Vector__XXX
 SG_ MainRunBSDCMDMode : 51|1@1+ (1,0) [0|1] "" Vector__XXX
 SG_ MainRunBSDCFGMode : 52|1@1+ (1,0) [0|1] "" Vector__XXX
 SG_ DischargeInputValid : 57|1@1+ (1,0) [0|1] "" Vector__XXX
 SG_ ChargeInputValid : 58|1@1+ (1,0) [0|1] "" Vector__XXX
 SG_ BMS_Fault : 63|1@1+ (1,0) [0|1] "" Vector__XXX
 SG_ ConfigAddressCMD : 0|8@1+ (1,0) [0|255] "" Vector__XXX
 SG_ BMSTotalQty : 8|8@1+ (1,0) [0|255] "pcs" Vector__XXX
 SG_ BMS_ID : 16|32@1+ (1,0) [0|-1] "" Vector__XXX
 SG_ BMS_Number : 56|8@1+ (1,0) [0|255] "" Vector__XXX
 SG_ ChargeMode1 : 0|8@1+ (1,0) [0|255] "" Vector__XXX
 SG_ HighestCMATemperature_14 : 0|8@1- (1,-40) [-40|210] "C" Vector__XXX
 SG_ LowestCMATemperature_14 : 8|8@1- (1,-40) [-40|210] "C" Vector__XXX
 SG_ AverageCMATemperature_14 : 16|8@1- (1,-40) [-40|210] "C" Vector__XXX
 SG_ AFE_Temperature_14 : 24|8@1- (1,-40) [-40|210] "C" Vector__XXX
 SG_ HVBusConnectCmd_M01 : 0|2@1+ (1,0) [0|3] "" Vector__XXX
 SG_ BMSAddr_M01 : 24|8@1+ (1,0) [101|114] "" Vector__XXX
 SG_ OverrideCommand_01 : 0|8@1+ (1,0) [0|255] ""  CanAnalyzer
 SG_ OverrideCommand_02 : 0|8@1+ (1,0) [0|255] "" Vector__XXX
 SG_ TestPackCurrentlvl_01 : 0|32@1- (50,-1600000) [0|1600000] "mA" Vector__XXX
 SG_ NewSignal_0001 : 16|8@1+ (1,0) [0|0] "" Vector__XXX

CM_ BU_ BMS "Microchip";
CM_ BU_ CanAnalyzer "Kvaser";
CM_ BU_ Charger "Offboard Charger";
CM_ SG_ 3221225472 OverrideCommand_14 "Clear [Permanent] Fault -> If Byte 1=207 (HEX CF), clear any permanent faults.
Disable Alarm -> If Byte 1=218 (HEX DA), overide an active BMS alarm and sets ALARM = NO until key-cycled or until Byte 1=0 (resume normal operation).
Disable Fault -> If Byte 1=223 (HEX DF), overide an active BMS fault and alarm and sets FAULT, ALARM = NO until key-cycled or until Byte 1=0 (resume normal operation).
Force [Contactor] Break -> If Byte 1=251 (HEX FB), force turn-off (open) the contactor until key-cycled or until Byte 1=0 (resume normal operation).
Force [Contactor] Closed -> If Byte 1=252 (HEX FC), force turn-on (close) the contactor until key-cycled or until Byte 1=0 (resume normal operation). ";
CM_ SG_ 3221225472 OverrideCommand_13 "Clear [Permanent] Fault -> If Byte 1=207 (HEX CF), clear any permanent faults.
Disable Alarm -> If Byte 1=218 (HEX DA), overide an active BMS alarm and sets ALARM = NO until key-cycled or until Byte 1=0 (resume normal operation).
Disable Fault -> If Byte 1=223 (HEX DF), overide an active BMS fault and alarm and sets FAULT, ALARM = NO until key-cycled or until Byte 1=0 (resume normal operation).
Force [Contactor] Break -> If Byte 1=251 (HEX FB), force turn-off (open) the contactor until key-cycled or until Byte 1=0 (resume normal operation).
Force [Contactor] Closed -> If Byte 1=252 (HEX FC), force turn-on (close) the contactor until key-cycled or until Byte 1=0 (resume normal operation). ";
CM_ SG_ 3221225472 OverrideCommand_12 "Clear [Permanent] Fault -> If Byte 1=207 (HEX CF), clear any permanent faults.
Disable Alarm -> If Byte 1=218 (HEX DA), overide an active BMS alarm and sets ALARM = NO until key-cycled or until Byte 1=0 (resume normal operation).
Disable Fault -> If Byte 1=223 (HEX DF), overide an active BMS fault and alarm and sets FAULT, ALARM = NO until key-cycled or until Byte 1=0 (resume normal operation).
Force [Contactor] Break -> If Byte 1=251 (HEX FB), force turn-off (open) the contactor until key-cycled or until Byte 1=0 (resume normal operation).
Force [Contactor] Closed -> If Byte 1=252 (HEX FC), force turn-on (close) the contactor until key-cycled or until Byte 1=0 (resume normal operation). ";
CM_ SG_ 3221225472 OverrideCommand_11 "Clear [Permanent] Fault -> If Byte 1=207 (HEX CF), clear any permanent faults.
Disable Alarm -> If Byte 1=218 (HEX DA), overide an active BMS alarm and sets ALARM = NO until key-cycled or until Byte 1=0 (resume normal operation).
Disable Fault -> If Byte 1=223 (HEX DF), overide an active BMS fault and alarm and sets FAULT, ALARM = NO until key-cycled or until Byte 1=0 (resume normal operation).
Force [Contactor] Break -> If Byte 1=251 (HEX FB), force turn-off (open) the contactor until key-cycled or until Byte 1=0 (resume normal operation).
Force [Contactor] Closed -> If Byte 1=252 (HEX FC), force turn-on (close) the contactor until key-cycled or until Byte 1=0 (resume normal operation). ";
CM_ SG_ 3221225472 OverrideCommand_10 "Clear [Permanent] Fault -> If Byte 1=207 (HEX CF), clear any permanent faults.
Disable Alarm -> If Byte 1=218 (HEX DA), overide an active BMS alarm and sets ALARM = NO until key-cycled or until Byte 1=0 (resume normal operation).
Disable Fault -> If Byte 1=223 (HEX DF), overide an active BMS fault and alarm and sets FAULT, ALARM = NO until key-cycled or until Byte 1=0 (resume normal operation).
Force [Contactor] Break -> If Byte 1=251 (HEX FB), force turn-off (open) the contactor until key-cycled or until Byte 1=0 (resume normal operation).
Force [Contactor] Closed -> If Byte 1=252 (HEX FC), force turn-on (close) the contactor until key-cycled or until Byte 1=0 (resume normal operation). ";
CM_ SG_ 3221225472 OverrideCommand_09 "Clear [Permanent] Fault -> If Byte 1=207 (HEX CF), clear any permanent faults.
Disable Alarm -> If Byte 1=218 (HEX DA), overide an active BMS alarm and sets ALARM = NO until key-cycled or until Byte 1=0 (resume normal operation).
Disable Fault -> If Byte 1=223 (HEX DF), overide an active BMS fault and alarm and sets FAULT, ALARM = NO until key-cycled or until Byte 1=0 (resume normal operation).
Force [Contactor] Break -> If Byte 1=251 (HEX FB), force turn-off (open) the contactor until key-cycled or until Byte 1=0 (resume normal operation).
Force [Contactor] Closed -> If Byte 1=252 (HEX FC), force turn-on (close) the contactor until key-cycled or until Byte 1=0 (resume normal operation). ";
CM_ SG_ 3221225472 OverrideCommand_08 "Clear [Permanent] Fault -> If Byte 1=207 (HEX CF), clear any permanent faults.
Disable Alarm -> If Byte 1=218 (HEX DA), overide an active BMS alarm and sets ALARM = NO until key-cycled or until Byte 1=0 (resume normal operation).
Disable Fault -> If Byte 1=223 (HEX DF), overide an active BMS fault and alarm and sets FAULT, ALARM = NO until key-cycled or until Byte 1=0 (resume normal operation).
Force [Contactor] Break -> If Byte 1=251 (HEX FB), force turn-off (open) the contactor until key-cycled or until Byte 1=0 (resume normal operation).
Force [Contactor] Closed -> If Byte 1=252 (HEX FC), force turn-on (close) the contactor until key-cycled or until Byte 1=0 (resume normal operation). ";
CM_ SG_ 3221225472 OverrideCommand_07 "Clear [Permanent] Fault -> If Byte 1=207 (HEX CF), clear any permanent faults.
Disable Alarm -> If Byte 1=218 (HEX DA), overide an active BMS alarm and sets ALARM = NO until key-cycled or until Byte 1=0 (resume normal operation).
Disable Fault -> If Byte 1=223 (HEX DF), overide an active BMS fault and alarm and sets FAULT, ALARM = NO until key-cycled or until Byte 1=0 (resume normal operation).
Force [Contactor] Break -> If Byte 1=251 (HEX FB), force turn-off (open) the contactor until key-cycled or until Byte 1=0 (resume normal operation).
Force [Contactor] Closed -> If Byte 1=252 (HEX FC), force turn-on (close) the contactor until key-cycled or until Byte 1=0 (resume normal operation). ";
CM_ SG_ 3221225472 OverrideCommand_06 "Clear [Permanent] Fault -> If Byte 1=207 (HEX CF), clear any permanent faults.
Disable Alarm -> If Byte 1=218 (HEX DA), overide an active BMS alarm and sets ALARM = NO until key-cycled or until Byte 1=0 (resume normal operation).
Disable Fault -> If Byte 1=223 (HEX DF), overide an active BMS fault and alarm and sets FAULT, ALARM = NO until key-cycled or until Byte 1=0 (resume normal operation).
Force [Contactor] Break -> If Byte 1=251 (HEX FB), force turn-off (open) the contactor until key-cycled or until Byte 1=0 (resume normal operation).
Force [Contactor] Closed -> If Byte 1=252 (HEX FC), force turn-on (close) the contactor until key-cycled or until Byte 1=0 (resume normal operation). ";
CM_ SG_ 3221225472 OverrideCommand_05 "Clear [Permanent] Fault -> If Byte 1=207 (HEX CF), clear any permanent faults.
Disable Alarm -> If Byte 1=218 (HEX DA), overide an active BMS alarm and sets ALARM = NO until key-cycled or until Byte 1=0 (resume normal operation).
Disable Fault -> If Byte 1=223 (HEX DF), overide an active BMS fault and alarm and sets FAULT, ALARM = NO until key-cycled or until Byte 1=0 (resume normal operation).
Force [Contactor] Break -> If Byte 1=251 (HEX FB), force turn-off (open) the contactor until key-cycled or until Byte 1=0 (resume normal operation).
Force [Contactor] Closed -> If Byte 1=252 (HEX FC), force turn-on (close) the contactor until key-cycled or until Byte 1=0 (resume normal operation). ";
CM_ SG_ 3221225472 OverrideCommand_04 "Clear [Permanent] Fault -> If Byte 1=207 (HEX CF), clear any permanent faults.
Disable Alarm -> If Byte 1=218 (HEX DA), overide an active BMS alarm and sets ALARM = NO until key-cycled or until Byte 1=0 (resume normal operation).
Disable Fault -> If Byte 1=223 (HEX DF), overide an active BMS fault and alarm and sets FAULT, ALARM = NO until key-cycled or until Byte 1=0 (resume normal operation).
Force [Contactor] Break -> If Byte 1=251 (HEX FB), force turn-off (open) the contactor until key-cycled or until Byte 1=0 (resume normal operation).
Force [Contactor] Closed -> If Byte 1=252 (HEX FC), force turn-on (close) the contactor until key-cycled or until Byte 1=0 (resume normal operation). ";
CM_ SG_ 3221225472 OverrideCommand_03 "Clear [Permanent] Fault -> If Byte 1=207 (HEX CF), clear any permanent faults.
Disable Alarm -> If Byte 1=218 (HEX DA), overide an active BMS alarm and sets ALARM = NO until key-cycled or until Byte 1=0 (resume normal operation).
Disable Fault -> If Byte 1=223 (HEX DF), overide an active BMS fault and alarm and sets FAULT, ALARM = NO until key-cycled or until Byte 1=0 (resume normal operation).
Force [Contactor] Break -> If Byte 1=251 (HEX FB), force turn-off (open) the contactor until key-cycled or until Byte 1=0 (resume normal operation).
Force [Contactor] Closed -> If Byte 1=252 (HEX FC), force turn-on (close) the contactor until key-cycled or until Byte 1=0 (resume normal operation). ";
CM_ SG_ 3221225472 PackCurrentlvl_14 "The current in or out of the High Voltage Energy Storage 1 pack (or system). This parameter should be synchronized with SPN 5919 (HVES1 Voltage Level) such that a realized power value can be calculated. This parameter is defined from the high ... ";
CM_ SG_ 3221225472 PackVoltagelvl_14 "The voltage level of the High Voltage Energy Storage 1 pack (or system). This parameter should be synchronized with SPN 5920 (HVES1 Current) such that a realized power value can be calculated. If the HVES component physically contains the ... ";
CM_ SG_ 3221225472 PackCurrentlvl_13 "The current in or out of the High Voltage Energy Storage 1 pack (or system). This parameter should be synchronized with SPN 5919 (HVES1 Voltage Level) such that a realized power value can be calculated. This parameter is defined from the high ... ";
CM_ SG_ 3221225472 PackVoltagelvl_13 "The voltage level of the High Voltage Energy Storage 1 pack (or system). This parameter should be synchronized with SPN 5920 (HVES1 Current) such that a realized power value can be calculated. If the HVES component physically contains the ... ";
CM_ SG_ 3221225472 PackCurrentlvl_12 "The current in or out of the High Voltage Energy Storage 1 pack (or system). This parameter should be synchronized with SPN 5919 (HVES1 Voltage Level) such that a realized power value can be calculated. This parameter is defined from the high ... ";
CM_ SG_ 3221225472 PackVoltagelvl_12 "The voltage level of the High Voltage Energy Storage 1 pack (or system). This parameter should be synchronized with SPN 5920 (HVES1 Current) such that a realized power value can be calculated. If the HVES component physically contains the ... ";
CM_ SG_ 3221225472 PackCurrentlvl_11 "The current in or out of the High Voltage Energy Storage 1 pack (or system). This parameter should be synchronized with SPN 5919 (HVES1 Voltage Level) such that a realized power value can be calculated. This parameter is defined from the high ... ";
CM_ SG_ 3221225472 PackVoltagelvl_11 "The voltage level of the High Voltage Energy Storage 1 pack (or system). This parameter should be synchronized with SPN 5920 (HVES1 Current) such that a realized power value can be calculated. If the HVES component physically contains the ... ";
CM_ SG_ 3221225472 PackCurrentlvl_10 "The current in or out of the High Voltage Energy Storage 1 pack (or system). This parameter should be synchronized with SPN 5919 (HVES1 Voltage Level) such that a realized power value can be calculated. This parameter is defined from the high ... ";
CM_ SG_ 3221225472 PackVoltagelvl_10 "The voltage level of the High Voltage Energy Storage 1 pack (or system). This parameter should be synchronized with SPN 5920 (HVES1 Current) such that a realized power value can be calculated. If the HVES component physically contains the ... ";
CM_ SG_ 3221225472 PackCurrentlvl_09 "The current in or out of the High Voltage Energy Storage 1 pack (or system). This parameter should be synchronized with SPN 5919 (HVES1 Voltage Level) such that a realized power value can be calculated. This parameter is defined from the high ... ";
CM_ SG_ 3221225472 PackVoltagelvl_09 "The voltage level of the High Voltage Energy Storage 1 pack (or system). This parameter should be synchronized with SPN 5920 (HVES1 Current) such that a realized power value can be calculated. If the HVES component physically contains the ... ";
CM_ SG_ 3221225472 PackCurrentlvl_08 "The current in or out of the High Voltage Energy Storage 1 pack (or system). This parameter should be synchronized with SPN 5919 (HVES1 Voltage Level) such that a realized power value can be calculated. This parameter is defined from the high ... ";
CM_ SG_ 3221225472 PackVoltagelvl_08 "The voltage level of the High Voltage Energy Storage 1 pack (or system). This parameter should be synchronized with SPN 5920 (HVES1 Current) such that a realized power value can be calculated. If the HVES component physically contains the ... ";
CM_ SG_ 3221225472 PackCurrentlvl_07 "The current in or out of the High Voltage Energy Storage 1 pack (or system). This parameter should be synchronized with SPN 5919 (HVES1 Voltage Level) such that a realized power value can be calculated. This parameter is defined from the high ... ";
CM_ SG_ 3221225472 PackVoltagelvl_07 "The voltage level of the High Voltage Energy Storage 1 pack (or system). This parameter should be synchronized with SPN 5920 (HVES1 Current) such that a realized power value can be calculated. If the HVES component physically contains the ... ";
CM_ SG_ 3221225472 PackCurrentlvl_06 "The current in or out of the High Voltage Energy Storage 1 pack (or system). This parameter should be synchronized with SPN 5919 (HVES1 Voltage Level) such that a realized power value can be calculated. This parameter is defined from the high ... ";
CM_ SG_ 3221225472 PackVoltagelvl_06 "The voltage level of the High Voltage Energy Storage 1 pack (or system). This parameter should be synchronized with SPN 5920 (HVES1 Current) such that a realized power value can be calculated. If the HVES component physically contains the ... ";
CM_ SG_ 3221225472 PackCurrentlvl_05 "The current in or out of the High Voltage Energy Storage 1 pack (or system). This parameter should be synchronized with SPN 5919 (HVES1 Voltage Level) such that a realized power value can be calculated. This parameter is defined from the high ... ";
CM_ SG_ 3221225472 PackVoltagelvl_05 "The voltage level of the High Voltage Energy Storage 1 pack (or system). This parameter should be synchronized with SPN 5920 (HVES1 Current) such that a realized power value can be calculated. If the HVES component physically contains the ... ";
CM_ SG_ 3221225472 PackCurrentlvl_04 "The current in or out of the High Voltage Energy Storage 1 pack (or system). This parameter should be synchronized with SPN 5919 (HVES1 Voltage Level) such that a realized power value can be calculated. This parameter is defined from the high ... ";
CM_ SG_ 3221225472 PackVoltagelvl_04 "The voltage level of the High Voltage Energy Storage 1 pack (or system). This parameter should be synchronized with SPN 5920 (HVES1 Current) such that a realized power value can be calculated. If the HVES component physically contains the ... ";
CM_ SG_ 3221225472 PackCurrentlvl_03 "The current in or out of the High Voltage Energy Storage 1 pack (or system). This parameter should be synchronized with SPN 5919 (HVES1 Voltage Level) such that a realized power value can be calculated. This parameter is defined from the high ... ";
CM_ SG_ 3221225472 PackVoltagelvl_03 "The voltage level of the High Voltage Energy Storage 1 pack (or system). This parameter should be synchronized with SPN 5920 (HVES1 Current) such that a realized power value can be calculated. If the HVES component physically contains the ... ";
CM_ SG_ 3221225472 SoC_14 "State of charge from 0 to 120% ";
CM_ SG_ 3221225472 SoC_13 "State of charge from 0 to 120% ";
CM_ SG_ 3221225472 SoC_12 "State of charge from 0 to 120% ";
CM_ SG_ 3221225472 SoC_11 "State of charge from 0 to 120% ";
CM_ SG_ 3221225472 SoC_10 "State of charge from 0 to 120% ";
CM_ SG_ 3221225472 SoC_09 "State of charge from 0 to 120% ";
CM_ SG_ 3221225472 SoC_08 "State of charge from 0 to 120% ";
CM_ SG_ 3221225472 SoC_07 "State of charge from 0 to 120% ";
CM_ SG_ 3221225472 SoC_06 "State of charge from 0 to 120% ";
CM_ SG_ 3221225472 SoC_05 "State of charge from 0 to 120% ";
CM_ SG_ 3221225472 SoC_04 "State of charge from 0 to 120% ";
CM_ SG_ 3221225472 SoC_03 "State of charge from 0 to 120% ";
CM_ SG_ 3221225472 VoltageCell5_14 "Voltage (Cell) 5 ";
CM_ SG_ 3221225472 VoltageCell6_14 "Voltage (Cell) 6";
CM_ SG_ 3221225472 VoltageCell7_14 "Voltage (Cell) 7";
CM_ SG_ 3221225472 VoltageCell8_14 "Voltage (Cell) 8";
CM_ SG_ 3221225472 VoltageCell5_13 "Voltage (Cell) 5";
CM_ SG_ 3221225472 VoltageCell6_13 "Voltage (Cell) 6";
CM_ SG_ 3221225472 VoltageCell7_13 "Voltage (Cell) 7";
CM_ SG_ 3221225472 VoltageCell8_13 "Voltage (Cell) 8";
CM_ SG_ 3221225472 VoltageCell5_12 "Voltage (Cell) 5";
CM_ SG_ 3221225472 VoltageCell6_12 "Voltage (Cell) 6";
CM_ SG_ 3221225472 VoltageCell7_12 "Voltage (Cell) 7";
CM_ SG_ 3221225472 VoltageCell8_12 "Voltage (Cell) 8";
CM_ SG_ 3221225472 VoltageCell5_11 "Voltage (Cell) 5";
CM_ SG_ 3221225472 VoltageCell6_11 "Voltage (Cell) 6";
CM_ SG_ 3221225472 VoltageCell7_11 "Voltage (Cell) 7";
CM_ SG_ 3221225472 VoltageCell8_11 "Voltage (Cell) 8";
CM_ SG_ 3221225472 VoltageCell5_10 "Voltage (Cell) 5";
CM_ SG_ 3221225472 VoltageCell6_10 "Voltage (Cell) 6";
CM_ SG_ 3221225472 VoltageCell7_10 "Voltage (Cell) 7";
CM_ SG_ 3221225472 VoltageCell8_10 "Voltage (Cell) 8";
CM_ SG_ 3221225472 VoltageCell5_09 "Voltage (Cell) 5";
CM_ SG_ 3221225472 VoltageCell6_09 "Voltage (Cell) 6";
CM_ SG_ 3221225472 VoltageCell7_09 "Voltage (Cell) 7";
CM_ SG_ 3221225472 VoltageCell8_09 "Voltage (Cell) 8";
CM_ SG_ 3221225472 VoltageCell5_08 "Voltage (Cell) 5";
CM_ SG_ 3221225472 VoltageCell6_08 "Voltage (Cell) 6";
CM_ SG_ 3221225472 VoltageCell7_08 "Voltage (Cell) 7";
CM_ SG_ 3221225472 VoltageCell8_08 "Voltage (Cell) 8";
CM_ SG_ 3221225472 VoltageCell5_07 "Voltage (Cell) 5";
CM_ SG_ 3221225472 VoltageCell6_07 "Voltage (Cell) 6";
CM_ SG_ 3221225472 VoltageCell7_07 "Voltage (Cell) 7";
CM_ SG_ 3221225472 VoltageCell8_07 "Voltage (Cell) 8";
CM_ SG_ 3221225472 VoltageCell5_06 "Voltage (Cell) 5";
CM_ SG_ 3221225472 VoltageCell6_06 "Voltage (Cell) 6";
CM_ SG_ 3221225472 VoltageCell7_06 "Voltage (Cell) 7";
CM_ SG_ 3221225472 VoltageCell8_06 "Voltage (Cell) 8";
CM_ SG_ 3221225472 VoltageCell5_05 "Voltage (Cell) 5";
CM_ SG_ 3221225472 VoltageCell6_05 "Voltage (Cell) 6";
CM_ SG_ 3221225472 VoltageCell7_05 "Voltage (Cell) 7";
CM_ SG_ 3221225472 VoltageCell8_05 "Voltage (Cell) 8";
CM_ SG_ 3221225472 VoltageCell5_04 "Voltage (Cell) 5";
CM_ SG_ 3221225472 VoltageCell6_04 "Voltage (Cell) 6";
CM_ SG_ 3221225472 VoltageCell7_04 "Voltage (Cell) 7";
CM_ SG_ 3221225472 VoltageCell8_04 "Voltage (Cell) 8";
CM_ SG_ 3221225472 VoltageCell5_03 "Voltage (Cell) 5";
CM_ SG_ 3221225472 VoltageCell6_03 "Voltage (Cell) 6";
CM_ SG_ 3221225472 VoltageCell7_03 "Voltage (Cell) 7";
CM_ SG_ 3221225472 VoltageCell8_03 "Voltage (Cell) 8";
CM_ SG_ 3221225472 VoltageCell13_14 "Voltage (Cell) 13 ";
CM_ SG_ 3221225472 VoltageCell14_14 "Voltage (Cell) 14";
CM_ SG_ 3221225472 VoltageCell13_13 "Voltage (Cell) 13 ";
CM_ SG_ 3221225472 VoltageCell14_13 "Voltage (Cell) 14";
CM_ SG_ 3221225472 VoltageCell13_12 "Voltage (Cell) 13 ";
CM_ SG_ 3221225472 VoltageCell14_12 "Voltage (Cell) 14";
CM_ SG_ 3221225472 VoltageCell13_11 "Voltage (Cell) 13 ";
CM_ SG_ 3221225472 VoltageCell14_11 "Voltage (Cell) 14";
CM_ SG_ 3221225472 VoltageCell13_10 "Voltage (Cell) 13 ";
CM_ SG_ 3221225472 VoltageCell14_10 "Voltage (Cell) 14";
CM_ SG_ 3221225472 VoltageCell13_09 "Voltage (Cell) 13 ";
CM_ SG_ 3221225472 VoltageCell14_09 "Voltage (Cell) 14";
CM_ SG_ 3221225472 VoltageCell13_08 "Voltage (Cell) 13 ";
CM_ SG_ 3221225472 VoltageCell14_08 "Voltage (Cell) 14";
CM_ SG_ 3221225472 VoltageCell13_07 "Voltage (Cell) 13 ";
CM_ SG_ 3221225472 VoltageCell14_07 "Voltage (Cell) 14";
CM_ SG_ 3221225472 VoltageCell13_06 "Voltage (Cell) 13 ";
CM_ SG_ 3221225472 VoltageCell14_06 "Voltage (Cell) 14";
CM_ SG_ 3221225472 VoltageCell13_05 "Voltage (Cell) 13 ";
CM_ SG_ 3221225472 VoltageCell14_05 "Voltage (Cell) 14";
CM_ SG_ 3221225472 VoltageCell13_04 "Voltage (Cell) 13 ";
CM_ SG_ 3221225472 VoltageCell14_04 "Voltage (Cell) 14";
CM_ SG_ 3221225472 VoltageCell13_03 "Voltage (Cell) 13 ";
CM_ SG_ 3221225472 VoltageCell14_03 "Voltage (Cell) 14";
CM_ SG_ 3221225472 HighestCMATemperature_13 "Highest CMA Temperature";
CM_ SG_ 3221225472 LowestCMATemperature_13 "Lowest CMA Temperature";
CM_ SG_ 3221225472 AverageCMATemperature_13 "Average CMA Temperature";
CM_ SG_ 3221225472 HighestCMATemperature_12 "Highest CMA Temperature";
CM_ SG_ 3221225472 LowestCMATemperature_12 "Lowest CMA Temperature";
CM_ SG_ 3221225472 AverageCMATemperature_12 "Average CMA Temperature";
CM_ SG_ 3221225472 HighestCMATemperature_11 "Highest CMA Temperature";
CM_ SG_ 3221225472 LowestCMATemperature_11 "Lowest CMA Temperature";
CM_ SG_ 3221225472 AverageCMATemperature_11 "Average CMA Temperature";
CM_ SG_ 3221225472 HighestCMATemperature_10 "Highest CMA Temperature";
CM_ SG_ 3221225472 LowestCMATemperature_10 "Lowest CMA Temperature";
CM_ SG_ 3221225472 AverageCMATemperature_10 "Average CMA Temperature";
CM_ SG_ 3221225472 HighestCMATemperature_09 "Highest CMA Temperature";
CM_ SG_ 3221225472 LowestCMATemperature_09 "Lowest CMA Temperature";
CM_ SG_ 3221225472 AverageCMATemperature_09 "Average CMA Temperature";
CM_ SG_ 3221225472 HighestCMATemperature_08 "Highest CMA Temperature";
CM_ SG_ 3221225472 LowestCMATemperature_08 "Lowest CMA Temperature";
CM_ SG_ 3221225472 AverageCMATemperature_08 "Average CMA Temperature";
CM_ SG_ 3221225472 HighestCMATemperature_07 "Highest CMA Temperature";
CM_ SG_ 3221225472 LowestCMATemperature_07 "Lowest CMA Temperature";
CM_ SG_ 3221225472 AverageCMATemperature_07 "Average CMA Temperature";
CM_ SG_ 3221225472 HighestCMATemperature_06 "Highest CMA Temperature";
CM_ SG_ 3221225472 LowestCMATemperature_06 "Lowest CMA Temperature";
CM_ SG_ 3221225472 AverageCMATemperature_06 "Average CMA Temperature";
CM_ SG_ 3221225472 HighestCMATemperature_05 "Highest CMA Temperature";
CM_ SG_ 3221225472 LowestCMATemperature_05 "Lowest CMA Temperature";
CM_ SG_ 3221225472 AverageCMATemperature_05 "Average CMA Temperature";
CM_ SG_ 3221225472 HighestCMATemperature_04 "Highest CMA Temperature";
CM_ SG_ 3221225472 LowestCMATemperature_04 "Lowest CMA Temperature";
CM_ SG_ 3221225472 AverageCMATemperature_04 "Average CMA Temperature";
CM_ SG_ 3221225472 HighestCMATemperature_03 "Highest CMA Temperature";
CM_ SG_ 3221225472 LowestCMATemperature_03 "Lowest CMA Temperature";
CM_ SG_ 3221225472 AverageCMATemperature_03 "Average CMA Temperature";
CM_ SG_ 3221225472 CommMode_14 "Standby Mode
Discharge Mode
Charge Mode";
CM_ SG_ 3221225472 DischargeMode_14 "Ready to Operate
Normal Operating State
Read to Operate (Fully Charged)
BMS in a protected state";
CM_ SG_ 3221225472 ChargeMode_14 "Fault: Low Voltage Protection
Fault: Temperature Protection
Fault: Current Protection
Contactor Issue
Fault: Over Voltage Protection
Fault: Balance Protection
Charger not capable of charging.";
CM_ SG_ 3221225472 CommMode_13 "Standby Mode
Discharge Mode
Charge Mode";
CM_ SG_ 3221225472 DischargeMode_13 "Ready to Operate
Normal Operating State
Read to Operate (Fully Charged)
BMS in a protected state";
CM_ SG_ 3221225472 ChargeMode_13 "Fault: Low Voltage Protection
Fault: Temperature Protection
Fault: Current Protection
Contactor Issue
Fault: Over Voltage Protection
Fault: Balance Protection
Charger not capable of charging.";
CM_ SG_ 3221225472 CommMode_12 "Standby Mode
Discharge Mode
Charge Mode";
CM_ SG_ 3221225472 DischargeMode_12 "Ready to Operate
Normal Operating State
Read to Operate (Fully Charged)
BMS in a protected state";
CM_ SG_ 3221225472 ChargeMode_12 "Fault: Low Voltage Protection
Fault: Temperature Protection
Fault: Current Protection
Contactor Issue
Fault: Over Voltage Protection
Fault: Balance Protection
Charger not capable of charging.";
CM_ SG_ 3221225472 CommMode_11 "Standby Mode
Discharge Mode
Charge Mode";
CM_ SG_ 3221225472 DischargeMode_11 "Ready to Operate
Normal Operating State
Read to Operate (Fully Charged)
BMS in a protected state";
CM_ SG_ 3221225472 ChargeMode_11 "Fault: Low Voltage Protection
Fault: Temperature Protection
Fault: Current Protection
Contactor Issue
Fault: Over Voltage Protection
Fault: Balance Protection
Charger not capable of charging.";
CM_ SG_ 3221225472 CommMode_10 "Standby Mode
Discharge Mode
Charge Mode";
CM_ SG_ 3221225472 DischargeMode_10 "Ready to Operate
Normal Operating State
Read to Operate (Fully Charged)
BMS in a protected state";
CM_ SG_ 3221225472 ChargeMode_10 "Fault: Low Voltage Protection
Fault: Temperature Protection
Fault: Current Protection
Contactor Issue
Fault: Over Voltage Protection
Fault: Balance Protection
Charger not capable of charging.";
CM_ SG_ 3221225472 CommMode_09 "Standby Mode
Discharge Mode
Charge Mode";
CM_ SG_ 3221225472 DischargeMode_09 "Ready to Operate
Normal Operating State
Read to Operate (Fully Charged)
BMS in a protected state";
CM_ SG_ 3221225472 ChargeMode_09 "Fault: Low Voltage Protection
Fault: Temperature Protection
Fault: Current Protection
Contactor Issue
Fault: Over Voltage Protection
Fault: Balance Protection
Charger not capable of charging.";
CM_ SG_ 3221225472 CommMode_08 "Standby Mode
Discharge Mode
Charge Mode";
CM_ SG_ 3221225472 DischargeMode_08 "Ready to Operate
Normal Operating State
Read to Operate (Fully Charged)
BMS in a protected state";
CM_ SG_ 3221225472 ChargeMode_08 "Fault: Low Voltage Protection
Fault: Temperature Protection
Fault: Current Protection
Contactor Issue
Fault: Over Voltage Protection
Fault: Balance Protection
Charger not capable of charging.";
CM_ SG_ 3221225472 CommMode_07 "Standby Mode
Discharge Mode
Charge Mode";
CM_ SG_ 3221225472 DischargeMode_07 "Ready to Operate
Normal Operating State
Read to Operate (Fully Charged)
BMS in a protected state";
CM_ SG_ 3221225472 ChargeMode_07 "Fault: Low Voltage Protection
Fault: Temperature Protection
Fault: Current Protection
Contactor Issue
Fault: Over Voltage Protection
Fault: Balance Protection
Charger not capable of charging.";
CM_ SG_ 3221225472 CommMode_06 "Standby Mode
Discharge Mode
Charge Mode";
CM_ SG_ 3221225472 DischargeMode_06 "Ready to Operate
Normal Operating State
Read to Operate (Fully Charged)
BMS in a protected state";
CM_ SG_ 3221225472 ChargeMode_06 "Fault: Low Voltage Protection
Fault: Temperature Protection
Fault: Current Protection
Contactor Issue
Fault: Over Voltage Protection
Fault: Balance Protection
Charger not capable of charging.";
CM_ SG_ 3221225472 CommMode_05 "Standby Mode
Discharge Mode
Charge Mode";
CM_ SG_ 3221225472 DischargeMode_05 "Ready to Operate
Normal Operating State
Read to Operate (Fully Charged)
BMS in a protected state";
CM_ SG_ 3221225472 ChargeMode_05 "Fault: Low Voltage Protection
Fault: Temperature Protection
Fault: Current Protection
Contactor Issue
Fault: Over Voltage Protection
Fault: Balance Protection
Charger not capable of charging.";
CM_ SG_ 3221225472 CommMode_04 "Standby Mode
Discharge Mode
Charge Mode";
CM_ SG_ 3221225472 DischargeMode_04 "Ready to Operate
Normal Operating State
Read to Operate (Fully Charged)
BMS in a protected state";
CM_ SG_ 3221225472 ChargeMode_04 "Fault: Low Voltage Protection
Fault: Temperature Protection
Fault: Current Protection
Contactor Issue
Fault: Over Voltage Protection
Fault: Balance Protection
Charger not capable of charging.";
CM_ SG_ 3221225472 CommMode_03 "Standby Mode
Discharge Mode
Charge Mode";
CM_ SG_ 3221225472 DischargeMode_03 "Ready to Operate
Normal Operating State
Read to Operate (Fully Charged)
BMS in a protected state";
CM_ SG_ 3221225472 ChargeMode_03 "Fault: Low Voltage Protection
Fault: Temperature Protection
Fault: Current Protection
Contactor Issue
Fault: Over Voltage Protection
Fault: Balance Protection
Charger not capable of charging";
CM_ SG_ 3221225472 AvgCellV_14 "The average cell voltage in the High Voltage Energy Storage 1 pack (or system).";
CM_ SG_ 3221225472 LowestCellVModuleNum_14 "Identifies the location of the module containing the HVES1 Lowest Cell Voltage (SPN 5923).";
CM_ SG_ 3221225472 HighestCellVModuleNum_14 "Identifies the location of the module containing the HVES1 Highest Cell Voltage (SPN 5922).";
CM_ SG_ 3221225472 AvgCellV_13 "The average cell voltage in the High Voltage Energy Storage 1 pack (or system).";
CM_ SG_ 3221225472 LowestCellVModuleNum_13 "Identifies the location of the module containing the HVES1 Lowest Cell Voltage (SPN 5923).";
CM_ SG_ 3221225472 HighestCellVModuleNum_13 "Identifies the location of the module containing the HVES1 Highest Cell Voltage (SPN 5922).";
CM_ SG_ 3221225472 AvgCellV_12 "The average cell voltage in the High Voltage Energy Storage 1 pack (or system).";
CM_ SG_ 3221225472 LowestCellVModuleNum_12 "Identifies the location of the module containing the HVES1 Lowest Cell Voltage (SPN 5923).";
CM_ SG_ 3221225472 HighestCellVModuleNum_12 "Identifies the location of the module containing the HVES1 Highest Cell Voltage (SPN 5922).";
CM_ SG_ 3221225472 AvgCellV_11 "The average cell voltage in the High Voltage Energy Storage 1 pack (or system).";
CM_ SG_ 3221225472 LowestCellVModuleNum_11 "Identifies the location of the module containing the HVES1 Lowest Cell Voltage (SPN 5923).";
CM_ SG_ 3221225472 HighestCellVModuleNum_11 "Identifies the location of the module containing the HVES1 Highest Cell Voltage (SPN 5922).";
CM_ SG_ 3221225472 AvgCellV_10 "The average cell voltage in the High Voltage Energy Storage 1 pack (or system).";
CM_ SG_ 3221225472 LowestCellVModuleNum_10 "Identifies the location of the module containing the HVES1 Lowest Cell Voltage (SPN 5923).";
CM_ SG_ 3221225472 HighestCellVModuleNum_10 "Identifies the location of the module containing the HVES1 Highest Cell Voltage (SPN 5922).";
CM_ SG_ 3221225472 AvgCellV_09 "The average cell voltage in the High Voltage Energy Storage 1 pack (or system).";
CM_ SG_ 3221225472 LowestCellVModuleNum_09 "Identifies the location of the module containing the HVES1 Lowest Cell Voltage (SPN 5923";
CM_ SG_ 3221225472 HighestCellVModuleNum_09 "Identifies the location of the module containing the HVES1 Highest Cell Voltage (SPN 5922).";
CM_ SG_ 3221225472 AvgCellV_08 "The average cell voltage in the High Voltage Energy Storage 1 pack (or system).";
CM_ SG_ 3221225472 LowestCellVModuleNum_08 "Identifies the location of the module containing the HVES1 Lowest Cell Voltage (SPN 5923).";
CM_ SG_ 3221225472 HighestCellVModuleNum_08 "Identifies the location of the module containing the HVES1 Highest Cell Voltage (SPN 5922).";
CM_ SG_ 3221225472 AvgCellV_07 "The average cell voltage in the High Voltage Energy Storage 1 pack (or system).";
CM_ SG_ 3221225472 LowestCellVModuleNum_07 "Identifies the location of the module containing the HVES1 Lowest Cell Voltage (SPN 5923).";
CM_ SG_ 3221225472 HighestCellVModuleNum_07 "Identifies the location of the module containing the HVES1 Highest Cell Voltage (SPN 5922).";
CM_ SG_ 3221225472 AvgCellV_06 "The average cell voltage in the High Voltage Energy Storage 1 pack (or system).";
CM_ SG_ 3221225472 LowestCellVModuleNum_06 "Identifies the location of the module containing the HVES1 Lowest Cell Voltage (SPN 5923).";
CM_ SG_ 3221225472 HighestCellVModuleNum_06 "Identifies the location of the module containing the HVES1 Highest Cell Voltage (SPN 5922).";
CM_ SG_ 3221225472 AvgCellV_05 "The average cell voltage in the High Voltage Energy Storage 1 pack (or system).";
CM_ SG_ 3221225472 LowestCellVModuleNum_05 "Identifies the location of the module containing the HVES1 Lowest Cell Voltage (SPN 5923).";
CM_ SG_ 3221225472 HighestCellVModuleNum_05 "Identifies the location of the module containing the HVES1 Highest Cell Voltage (SPN 5922).";
CM_ SG_ 3221225472 AvgCellV_04 "The average cell voltage in the High Voltage Energy Storage 1 pack (or system).";
CM_ SG_ 3221225472 LowestCellVModuleNum_04 "Identifies the location of the module containing the HVES1 Lowest Cell Voltage (SPN 5923).";
CM_ SG_ 3221225472 HighestCellVModuleNum_04 "Identifies the location of the module containing the HVES1 Highest Cell Voltage (SPN 5922).";
CM_ SG_ 3221225472 AvgCellV_03 "The average cell voltage in the High Voltage Energy Storage 1 pack (or system).";
CM_ SG_ 3221225472 LowestCellVModuleNum_03 "Identifies the location of the module containing the HVES1 Lowest Cell Voltage (SPN 5923).";
CM_ SG_ 3221225472 HighestCellVModuleNum_03 "Identifies the location of the module containing the HVES1 Highest Cell Voltage (SPN 5922).";
CM_ SG_ 3221225472 CellBalancingActive_14 "Indicates whether or not the cells in the High Voltage Energy Storage 1 pack (or system) are currently being balanced.

00 = Cell balancing is not active
01 = Cell balancing is active
10 = Error
11 = Not Available ";
CM_ SG_ 3221225472 CellBalanceStatus_14 "Indicates whether or not the cells in the High Voltage Energy Storage 1 pack (or system) are balanced.

00 = Cells are balanced
01 = Cells are unbalanced
10 = Error
11 = Not ";
CM_ SG_ 3221225472 HVBusContactorStNEG_14 "Position of the High Voltage Energy Storage 1 pack (or system) negative side bus contactor. When this contactor is closed, the negative side of HVES1 is connected to the negative side of the high-voltage bus. If a system controls the positive, ... ";
CM_ SG_ 3221225472 HVBusContactorStPOS_14 "Position of the High Voltage Energy Storage 1 pack (or system) positive side bus contactor. When this contactor is closed, the positive side of HVES1 is connected to the positive side of the high-voltage bus. In systems where all contactors are ... ";
CM_ SG_ 3221225472 CellBalancingActive_13 "Indicates whether or not the cells in the High Voltage Energy Storage 1 pack (or system) are currently being balanced.

00 = Cell balancing is not active
01 = Cell balancing is active
10 = Error
11 = Not Available ";
CM_ SG_ 3221225472 CellBalanceStatus_13 "Indicates whether or not the cells in the High Voltage Energy Storage 1 pack (or system) are balanced.

00 = Cells are balanced
01 = Cells are unbalanced
10 = Error
11 = Not ";
CM_ SG_ 3221225472 HVBusContactorStNEG_13 "Position of the High Voltage Energy Storage 1 pack (or system) negative side bus contactor. When this contactor is closed, the negative side of HVES1 is connected to the negative side of the high-voltage bus. If a system controls the positive, ... ";
CM_ SG_ 3221225472 HVBusContactorStPOS_13 "Position of the High Voltage Energy Storage 1 pack (or system) positive side bus contactor. When this contactor is closed, the positive side of HVES1 is connected to the positive side of the high-voltage bus. In systems where all contactors are ... ";
CM_ SG_ 3221225472 CellBalancingActive_12 "Indicates whether or not the cells in the High Voltage Energy Storage 1 pack (or system) are currently being balanced.

00 = Cell balancing is not active
01 = Cell balancing is active
10 = Error
11 = Not Available ";
CM_ SG_ 3221225472 CellBalanceStatus_12 "Indicates whether or not the cells in the High Voltage Energy Storage 1 pack (or system) are balanced.

00 = Cells are balanced
01 = Cells are unbalanced
10 = Error
11 = Not ";
CM_ SG_ 3221225472 HVBusContactorStNEG_12 "Position of the High Voltage Energy Storage 1 pack (or system) negative side bus contactor. When this contactor is closed, the negative side of HVES1 is connected to the negative side of the high-voltage bus. If a system controls the positive, ... ";
CM_ SG_ 3221225472 HVBusContactorStPOS_12 "Position of the High Voltage Energy Storage 1 pack (or system) positive side bus contactor. When this contactor is closed, the positive side of HVES1 is connected to the positive side of the high-voltage bus. In systems where all contactors are ... ";
CM_ SG_ 3221225472 CellBalancingActive_11 "Indicates whether or not the cells in the High Voltage Energy Storage 1 pack (or system) are currently being balanced.

00 = Cell balancing is not active
01 = Cell balancing is active
10 = Error
11 = Not Available ";
CM_ SG_ 3221225472 CellBalanceStatus_11 "Indicates whether or not the cells in the High Voltage Energy Storage 1 pack (or system) are balanced.

00 = Cells are balanced
01 = Cells are unbalanced
10 = Error
11 = Not ";
CM_ SG_ 3221225472 HVBusContactorStNEG_11 "Position of the High Voltage Energy Storage 1 pack (or system) negative side bus contactor. When this contactor is closed, the negative side of HVES1 is connected to the negative side of the high-voltage bus. If a system controls the positive, ... ";
CM_ SG_ 3221225472 HVBusContactorStPOS_11 "Position of the High Voltage Energy Storage 1 pack (or system) positive side bus contactor. When this contactor is closed, the positive side of HVES1 is connected to the positive side of the high-voltage bus. In systems where all contactors are ... ";
CM_ SG_ 3221225472 CellBalancingActive_10 "Indicates whether or not the cells in the High Voltage Energy Storage 1 pack (or system) are currently being balanced.

00 = Cell balancing is not active
01 = Cell balancing is active
10 = Error
11 = Not Available ";
CM_ SG_ 3221225472 CellBalanceStatus_10 "Indicates whether or not the cells in the High Voltage Energy Storage 1 pack (or system) are balanced.

00 = Cells are balanced
01 = Cells are unbalanced
10 = Error
11 = Not ";
CM_ SG_ 3221225472 HVBusContactorStNEG_10 "Position of the High Voltage Energy Storage 1 pack (or system) negative side bus contactor. When this contactor is closed, the negative side of HVES1 is connected to the negative side of the high-voltage bus. If a system controls the positive, ... ";
CM_ SG_ 3221225472 HVBusContactorStPOS_10 "Position of the High Voltage Energy Storage 1 pack (or system) positive side bus contactor. When this contactor is closed, the positive side of HVES1 is connected to the positive side of the high-voltage bus. In systems where all contactors are ... ";
CM_ SG_ 3221225472 CellBalancingActive_09 "Indicates whether or not the cells in the High Voltage Energy Storage 1 pack (or system) are currently being balanced.

00 = Cell balancing is not active
01 = Cell balancing is active
10 = Error
11 = Not Available ";
CM_ SG_ 3221225472 CellBalanceStatus_09 "Indicates whether or not the cells in the High Voltage Energy Storage 1 pack (or system) are balanced.

00 = Cells are balanced
01 = Cells are unbalanced
10 = Error
11 = Not ";
CM_ SG_ 3221225472 HVBusContactorStNEG_09 "Position of the High Voltage Energy Storage 1 pack (or system) negative side bus contactor. When this contactor is closed, the negative side of HVES1 is connected to the negative side of the high-voltage bus. If a system controls the positive, ... ";
CM_ SG_ 3221225472 HVBusContactorStPOS_09 "Position of the High Voltage Energy Storage 1 pack (or system) positive side bus contactor. When this contactor is closed, the positive side of HVES1 is connected to the positive side of the high-voltage bus. In systems where all contactors are ... ";
CM_ SG_ 3221225472 CellBalancingActive_08 "Indicates whether or not the cells in the High Voltage Energy Storage 1 pack (or system) are currently being balanced.

00 = Cell balancing is not active
01 = Cell balancing is active
10 = Error
11 = Not Available ";
CM_ SG_ 3221225472 CellBalanceStatus_08 "Indicates whether or not the cells in the High Voltage Energy Storage 1 pack (or system) are balanced.

00 = Cells are balanced
01 = Cells are unbalanced
10 = Error
11 = Not ";
CM_ SG_ 3221225472 HVBusContactorStNEG_08 "Position of the High Voltage Energy Storage 1 pack (or system) negative side bus contactor. When this contactor is closed, the negative side of HVES1 is connected to the negative side of the high-voltage bus. If a system controls the positive, ... ";
CM_ SG_ 3221225472 HVBusContactorStPOS_08 "Position of the High Voltage Energy Storage 1 pack (or system) positive side bus contactor. When this contactor is closed, the positive side of HVES1 is connected to the positive side of the high-voltage bus. In systems where all contactors are ... ";
CM_ SG_ 3221225472 CellBalancingActive_07 "Indicates whether or not the cells in the High Voltage Energy Storage 1 pack (or system) are currently being balanced.

00 = Cell balancing is not active
01 = Cell balancing is active
10 = Error
11 = Not Available ";
CM_ SG_ 3221225472 CellBalanceStatus_07 "Indicates whether or not the cells in the High Voltage Energy Storage 1 pack (or system) are balanced.

00 = Cells are balanced
01 = Cells are unbalanced
10 = Error
11 = Not ";
CM_ SG_ 3221225472 HVBusContactorStNEG_07 "Position of the High Voltage Energy Storage 1 pack (or system) negative side bus contactor. When this contactor is closed, the negative side of HVES1 is connected to the negative side of the high-voltage bus. If a system controls the positive, ... ";
CM_ SG_ 3221225472 HVBusContactorStPOS_07 "Position of the High Voltage Energy Storage 1 pack (or system) positive side bus contactor. When this contactor is closed, the positive side of HVES1 is connected to the positive side of the high-voltage bus. In systems where all contactors are ... ";
CM_ SG_ 3221225472 CellBalancingActive_06 "Indicates whether or not the cells in the High Voltage Energy Storage 1 pack (or system) are currently being balanced.

00 = Cell balancing is not active
01 = Cell balancing is active
10 = Error
11 = Not Available ";
CM_ SG_ 3221225472 CellBalanceStatus_06 "Indicates whether or not the cells in the High Voltage Energy Storage 1 pack (or system) are balanced.

00 = Cells are balanced
01 = Cells are unbalanced
10 = Error
11 = Not ";
CM_ SG_ 3221225472 HVBusContactorStNEG_06 "Position of the High Voltage Energy Storage 1 pack (or system) negative side bus contactor. When this contactor is closed, the negative side of HVES1 is connected to the negative side of the high-voltage bus. If a system controls the positive, ... ";
CM_ SG_ 3221225472 HVBusContactorStPOS_06 "Position of the High Voltage Energy Storage 1 pack (or system) positive side bus contactor. When this contactor is closed, the positive side of HVES1 is connected to the positive side of the high-voltage bus. In systems where all contactors are ... ";
CM_ SG_ 3221225472 CellBalancingActive_05 "
Indicates whether or not the cells in the High Voltage Energy Storage 1 pack (or system) are currently being balanced.

00 = Cell balancing is not active
01 = Cell balancing is active
10 = Error
11 = Not Available ";
CM_ SG_ 3221225472 CellBalanceStatus_05 "Indicates whether or not the cells in the High Voltage Energy Storage 1 pack (or system) are balanced.

00 = Cells are balanced
01 = Cells are unbalanced
10 = Error
11 = Not ";
CM_ SG_ 3221225472 HVBusContactorStNEG_05 "Position of the High Voltage Energy Storage 1 pack (or system) negative side bus contactor. When this contactor is closed, the negative side of HVES1 is connected to the negative side of the high-voltage bus. If a system controls the positive, ... ";
CM_ SG_ 3221225472 HVBusContactorStPOS_05 "Position of the High Voltage Energy Storage 1 pack (or system) positive side bus contactor. When this contactor is closed, the positive side of HVES1 is connected to the positive side of the high-voltage bus. In systems where all contactors are ... ";
CM_ SG_ 3221225472 CellBalancingActive_04 "Indicates whether or not the cells in the High Voltage Energy Storage 1 pack (or system) are currently being balanced.

00 = Cell balancing is not active
01 = Cell balancing is active
10 = Error
11 = Not Available ";
CM_ SG_ 3221225472 CellBalanceStatus_04 "Indicates whether or not the cells in the High Voltage Energy Storage 1 pack (or system) are balanced.

00 = Cells are balanced
01 = Cells are unbalanced
10 = Error
11 = Not Available ";
CM_ SG_ 3221225472 HVBusContactorStNEG_04 "Position of the High Voltage Energy Storage 1 pack (or system) negative side bus contactor. When this contactor is closed, the negative side of HVES1 is connected to the negative side of the high-voltage bus. If a system controls the positive, ... ";
CM_ SG_ 3221225472 HVBusContactorStPOS_04 "Position of the High Voltage Energy Storage 1 pack (or system) positive side bus contactor. When this contactor is closed, the positive side of HVES1 is connected to the positive side of the high-voltage bus. In systems where all contactors are ... ";
CM_ SG_ 3221225472 CellBalancingActive_03 "Indicates whether or not the cells in the High Voltage Energy Storage 1 pack (or system) are currently being balanced.

00 = Cell balancing is not active
01 = Cell balancing is active
10 = Error
11 = Not Available ";
CM_ SG_ 3221225472 CellBalanceStatus_03 "Indicates whether or not the cells in the High Voltage Energy Storage 1 pack (or system) are balanced.

00 = Cells are balanced
01 = Cells are unbalanced
10 = Error
11 = Not Available ";
CM_ SG_ 3221225472 HVBusContactorStNEG_03 "Position of the High Voltage Energy Storage 1 pack (or system) negative side bus contactor. When this contactor is closed, the negative side of HVES1 is connected to the negative side of the high-voltage bus. If a system controls the positive, ... ";
CM_ SG_ 3221225472 HVBusContactorStPOS_03 "Position of the High Voltage Energy Storage 1 pack (or system) positive side bus contactor. When this contactor is closed, the positive side of HVES1 is connected to the positive side of the high-voltage bus. In systems where all contactors are ... ";
CM_ SG_ 3221225472 BusVoltage_14 "The voltage level of the high voltage bus, as measured by the High Voltage Energy Storage 1 pack (or system) on the bus side (not the battery side) of its contactors. ";
CM_ SG_ 3221225472 BusVoltage_13 "The voltage level of the high voltage bus, as measured by the High Voltage Energy Storage 1 pack (or system) on the bus side (not the battery side) of its contactors. ";
CM_ SG_ 3221225472 BusVoltage_12 "The voltage level of the high voltage bus, as measured by the High Voltage Energy Storage 1 pack (or system) on the bus side (not the battery side) of its contactors. ";
CM_ SG_ 3221225472 BusVoltage_11 "The voltage level of the high voltage bus, as measured by the High Voltage Energy Storage 1 pack (or system) on the bus side (not the battery side) of its contactors. ";
CM_ SG_ 3221225472 BusVoltage_10 "The voltage level of the high voltage bus, as measured by the High Voltage Energy Storage 1 pack (or system) on the bus side (not the battery side) of its contactors. ";
CM_ SG_ 3221225472 BusVoltage_09 "The voltage level of the high voltage bus, as measured by the High Voltage Energy Storage 1 pack (or system) on the bus side (not the battery side) of its contactors. ";
CM_ SG_ 3221225472 BusVoltage_08 "The voltage level of the high voltage bus, as measured by the High Voltage Energy Storage 1 pack (or system) on the bus side (not the battery side) of its contactors. ";
CM_ SG_ 3221225472 BusVoltage_07 "The voltage level of the high voltage bus, as measured by the High Voltage Energy Storage 1 pack (or system) on the bus side (not the battery side) of its contactors. ";
CM_ SG_ 3221225472 BusVoltage_06 "The voltage level of the high voltage bus, as measured by the High Voltage Energy Storage 1 pack (or system) on the bus side (not the battery side) of its contactors. ";
CM_ SG_ 3221225472 BusVoltage_05 "The voltage level of the high voltage bus, as measured by the High Voltage Energy Storage 1 pack (or system) on the bus side (not the battery side) of its contactors. ";
CM_ SG_ 3221225472 BusVoltage_04 "The voltage level of the high voltage bus, as measured by the High Voltage Energy Storage 1 pack (or system) on the bus side (not the battery side) of its contactors. ";
CM_ SG_ 3221225472 BusVoltage_03 "The voltage level of the high voltage bus, as measured by the High Voltage Energy Storage 1 pack (or system) on the bus side (not the battery side) of its contactors. ";
CM_ SG_ 3221225472 ChargeCapacity_14 "The amount of unused electrical charge storage in the High Voltage Energy Storage 1 pack (or system) that is available to be filled by charging, i.e. �how much empty space is remaining in the tank�. See HVES1 Charge Energy Capacity (SPN 8206) for ... ";
CM_ SG_ 3221225472 DischargeCapacity_14 "The amount of stored electrical charge in the High Voltage Energy Storage 1 pack (or system) that is available for use by the hybrid system, i.e. �how full is the tank�. See HVES1 Discharge Energy Capacity (SPN 8205) for kilowatt-hours (kWh). ";
CM_ SG_ 3221225472 ChargeCapacity_13 "The amount of unused electrical charge storage in the High Voltage Energy Storage 1 pack (or system) that is available to be filled by charging, i.e. �how much empty space is remaining in the tank�. See HVES1 Charge Energy Capacity (SPN 8206) for ... ";
CM_ SG_ 3221225472 DischargeCapacity_13 "The amount of stored electrical charge in the High Voltage Energy Storage 1 pack (or system) that is available for use by the hybrid system, i.e. �how full is the tank�. See HVES1 Discharge Energy Capacity (SPN 8205) for kilowatt-hours (kWh). ";
CM_ SG_ 3221225472 ChargeCapacity_12 "The amount of unused electrical charge storage in the High Voltage Energy Storage 1 pack (or system) that is available to be filled by charging, i.e. �how much empty space is remaining in the tank�. See HVES1 Charge Energy Capacity (SPN 8206) for ... ";
CM_ SG_ 3221225472 DischargeCapacity_12 "The amount of stored electrical charge in the High Voltage Energy Storage 1 pack (or system) that is available for use by the hybrid system, i.e. �how full is the tank�. See HVES1 Discharge Energy Capacity (SPN 8205) for kilowatt-hours (kWh). ";
CM_ SG_ 3221225472 ChargeCapacity_11 "The amount of unused electrical charge storage in the High Voltage Energy Storage 1 pack (or system) that is available to be filled by charging, i.e. �how much empty space is remaining in the tank�. See HVES1 Charge Energy Capacity (SPN 8206) for ... ";
CM_ SG_ 3221225472 DischargeCapacity_11 "The amount of stored electrical charge in the High Voltage Energy Storage 1 pack (or system) that is available for use by the hybrid system, i.e. �how full is the tank�. See HVES1 Discharge Energy Capacity (SPN 8205) for kilowatt-hours (kWh). ";
CM_ SG_ 3221225472 ChargeCapacity_10 "The amount of unused electrical charge storage in the High Voltage Energy Storage 1 pack (or system) that is available to be filled by charging, i.e. �how much empty space is remaining in the tank�. See HVES1 Charge Energy Capacity (SPN 8206) for ... ";
CM_ SG_ 3221225472 DischargeCapacity_10 "The amount of stored electrical charge in the High Voltage Energy Storage 1 pack (or system) that is available for use by the hybrid system, i.e. �how full is the tank�. See HVES1 Discharge Energy Capacity (SPN 8205) for kilowatt-hours (kWh). ";
CM_ SG_ 3221225472 ChargeCapacity_09 "The amount of unused electrical charge storage in the High Voltage Energy Storage 1 pack (or system) that is available to be filled by charging, i.e. �how much empty space is remaining in the tank�. See HVES1 Charge Energy Capacity (SPN 8206) for ... ";
CM_ SG_ 3221225472 DischargeCapacity_09 "The amount of stored electrical charge in the High Voltage Energy Storage 1 pack (or system) that is available for use by the hybrid system, i.e. �how full is the tank�. See HVES1 Discharge Energy Capacity (SPN 8205) for kilowatt-hours (kWh). ";
CM_ SG_ 3221225472 ChargeCapacity_08 "The amount of unused electrical charge storage in the High Voltage Energy Storage 1 pack (or system) that is available to be filled by charging, i.e. �how much empty space is remaining in the tank�. See HVES1 Charge Energy Capacity (SPN 8206) for ... ";
CM_ SG_ 3221225472 DischargeCapacity_08 "The amount of stored electrical charge in the High Voltage Energy Storage 1 pack (or system) that is available for use by the hybrid system, i.e. �how full is the tank�. See HVES1 Discharge Energy Capacity (SPN 8205) for kilowatt-hours (kWh). ";
CM_ SG_ 3221225472 ChargeCapacity_07 "The amount of unused electrical charge storage in the High Voltage Energy Storage 1 pack (or system) that is available to be filled by charging, i.e. �how much empty space is remaining in the tank�. See HVES1 Charge Energy Capacity (SPN 8206) for ... ";
CM_ SG_ 3221225472 DischargeCapacity_07 "The amount of stored electrical charge in the High Voltage Energy Storage 1 pack (or system) that is available for use by the hybrid system, i.e. �how full is the tank�. See HVES1 Discharge Energy Capacity (SPN 8205) for kilowatt-hours (kWh). ";
CM_ SG_ 3221225472 ChargeCapacity_06 "The amount of unused electrical charge storage in the High Voltage Energy Storage 1 pack (or system) that is available to be filled by charging, i.e. �how much empty space is remaining in the tank�. See HVES1 Charge Energy Capacity (SPN 8206) for ... ";
CM_ SG_ 3221225472 DischargeCapacity_06 "The amount of stored electrical charge in the High Voltage Energy Storage 1 pack (or system) that is available for use by the hybrid system, i.e. �how full is the tank�. See HVES1 Discharge Energy Capacity (SPN 8205) for kilowatt-hours (kWh). ";
CM_ SG_ 3221225472 ChargeCapacity_05 "The amount of unused electrical charge storage in the High Voltage Energy Storage 1 pack (or system) that is available to be filled by charging, i.e. �how much empty space is remaining in the tank�. See HVES1 Charge Energy Capacity (SPN 8206) for ... ";
CM_ SG_ 3221225472 DischargeCapacity_05 "The amount of stored electrical charge in the High Voltage Energy Storage 1 pack (or system) that is available for use by the hybrid system, i.e. �how full is the tank�. See HVES1 Discharge Energy Capacity (SPN 8205) for kilowatt-hours (kWh). ";
CM_ SG_ 3221225472 ChargeCapacity_04 "The amount of unused electrical charge storage in the High Voltage Energy Storage 1 pack (or system) that is available to be filled by charging, i.e. �how much empty space is remaining in the tank�. See HVES1 Charge Energy Capacity (SPN 8206) for ... ";
CM_ SG_ 3221225472 DischargeCapacity_04 "The amount of stored electrical charge in the High Voltage Energy Storage 1 pack (or system) that is available for use by the hybrid system, i.e. �how full is the tank�. See HVES1 Discharge Energy Capacity (SPN 8205) for kilowatt-hours (kWh). ";
CM_ SG_ 3221225472 ChargeCapacity_03 "The amount of unused electrical charge storage in the High Voltage Energy Storage 1 pack (or system) that is available to be filled by charging, i.e. �how much empty space is remaining in the tank�. See HVES1 Charge Energy Capacity (SPN 8206) for ... ";
CM_ SG_ 3221225472 DischargeCapacity_03 "The amount of stored electrical charge in the High Voltage Energy Storage 1 pack (or system) that is available for use by the hybrid system, i.e. �how full is the tank�. See HVES1 Discharge Energy Capacity (SPN 8205) for kilowatt-hours (kWh). ";
CM_ SG_ 3221225472 Temperature1_14 "Temperature (Thermistor) 1";
CM_ SG_ 3221225472 Temperature2_14 "Temperature (Thermistor) 2";
CM_ SG_ 3221225472 Temperature3_14 "Temperature (Thermistor) 3";
CM_ SG_ 3221225472 Temperature4_14 "Temperature (Thermistor) 4";
CM_ SG_ 3221225472 Temperature5_14 "Temperature (Thermistor) 5";
CM_ SG_ 3221225472 Temperature6_14 "Temperature (Thermistor) 6";
CM_ SG_ 3221225472 Temperature7_14 "Temperature (Thermistor) 7";
CM_ SG_ 3221225472 Temperature1_13 "Temperature (Thermistor) 1";
CM_ SG_ 3221225472 Temperature2_13 "Temperature (Thermistor) 2";
CM_ SG_ 3221225472 Temperature3_13 "Temperature (Thermistor) 3";
CM_ SG_ 3221225472 Temperature4_13 "Temperature (Thermistor) 4";
CM_ SG_ 3221225472 Temperature5_13 "Temperature (Thermistor) 5";
CM_ SG_ 3221225472 Temperature6_13 "Temperature (Thermistor) 6";
CM_ SG_ 3221225472 Temperature7_13 "Temperature (Thermistor) 7";
CM_ SG_ 3221225472 Temperature1_12 "Temperature (Thermistor) 1";
CM_ SG_ 3221225472 Temperature2_12 "Temperature (Thermistor) 2";
CM_ SG_ 3221225472 Temperature3_12 "Temperature (Thermistor) 3";
CM_ SG_ 3221225472 Temperature4_12 "Temperature (Thermistor) 4";
CM_ SG_ 3221225472 Temperature5_12 "Temperature (Thermistor) 5";
CM_ SG_ 3221225472 Temperature6_12 "Temperature (Thermistor) 6";
CM_ SG_ 3221225472 Temperature7_12 "Temperature (Thermistor) 7";
CM_ SG_ 3221225472 Temperature1_11 "Temperature (Thermistor) 1";
CM_ SG_ 3221225472 Temperature2_11 "Temperature (Thermistor) 2";
CM_ SG_ 3221225472 Temperature3_11 "Temperature (Thermistor) 3";
CM_ SG_ 3221225472 Temperature4_11 "Temperature (Thermistor) 4";
CM_ SG_ 3221225472 Temperature5_11 "Temperature (Thermistor) 5";
CM_ SG_ 3221225472 Temperature6_11 "Temperature (Thermistor) 6";
CM_ SG_ 3221225472 Temperature7_11 "Temperature (Thermistor) 7";
CM_ SG_ 3221225472 Temperature1_10 "Temperature (Thermistor) 1";
CM_ SG_ 3221225472 Temperature2_10 "Temperature (Thermistor) 2";
CM_ SG_ 3221225472 Temperature3_10 "Temperature (Thermistor) 3";
CM_ SG_ 3221225472 Temperature4_10 "Temperature (Thermistor) 4";
CM_ SG_ 3221225472 Temperature5_10 "Temperature (Thermistor) 5";
CM_ SG_ 3221225472 Temperature6_10 "Temperature (Thermistor) 6";
CM_ SG_ 3221225472 Temperature7_10 "Temperature (Thermistor) 7";
CM_ SG_ 3221225472 Temperature1_09 "Temperature (Thermistor) 1";
CM_ SG_ 3221225472 Temperature2_09 "Temperature (Thermistor) 2";
CM_ SG_ 3221225472 Temperature3_09 "Temperature (Thermistor) 3";
CM_ SG_ 3221225472 Temperature4_09 "Temperature (Thermistor) 4";
CM_ SG_ 3221225472 Temperature5_09 "Temperature (Thermistor) 5";
CM_ SG_ 3221225472 Temperature6_09 "Temperature (Thermistor) 6";
CM_ SG_ 3221225472 Temperature7_09 "Temperature (Thermistor) 7";
CM_ SG_ 3221225472 Temperature1_08 "Temperature (Thermistor) 1";
CM_ SG_ 3221225472 Temperature2_08 "Temperature (Thermistor) 2";
CM_ SG_ 3221225472 Temperature3_08 "Temperature (Thermistor) 3";
CM_ SG_ 3221225472 Temperature4_08 "Temperature (Thermistor) 4";
CM_ SG_ 3221225472 Temperature5_08 "Temperature (Thermistor) 5";
CM_ SG_ 3221225472 Temperature6_08 "Temperature (Thermistor) 6";
CM_ SG_ 3221225472 Temperature7_08 "Temperature (Thermistor) 7";
CM_ SG_ 3221225472 Temperature1_07 "Temperature (Thermistor) 1";
CM_ SG_ 3221225472 Temperature2_07 "Temperature (Thermistor) 2";
CM_ SG_ 3221225472 Temperature3_07 "Temperature (Thermistor) 3";
CM_ SG_ 3221225472 Temperature4_07 "Temperature (Thermistor) 4";
CM_ SG_ 3221225472 Temperature5_07 "Temperature (Thermistor) 5";
CM_ SG_ 3221225472 Temperature6_07 "Temperature (Thermistor) 6";
CM_ SG_ 3221225472 Temperature7_07 "Temperature (Thermistor) 7";
CM_ SG_ 3221225472 Temperature1_06 "Temperature (Thermistor) 1 ";
CM_ SG_ 3221225472 Temperature2_06 "Temperature (Thermistor) 2";
CM_ SG_ 3221225472 Temperature3_06 "Temperature (Thermistor) 3";
CM_ SG_ 3221225472 Temperature4_06 "Temperature (Thermistor) 4";
CM_ SG_ 3221225472 Temperature5_06 "Temperature (Thermistor) 5";
CM_ SG_ 3221225472 Temperature6_06 "Temperature (Thermistor) 6";
CM_ SG_ 3221225472 Temperature7_06 "Temperature (Thermistor) 7";
CM_ SG_ 3221225472 Temperature1_05 "Temperature (Thermistor) 1";
CM_ SG_ 3221225472 Temperature2_05 "Temperature (Thermistor) 2";
CM_ SG_ 3221225472 Temperature3_05 "Temperature (Thermistor) 3";
CM_ SG_ 3221225472 Temperature4_05 "Temperature (Thermistor) 4
";
CM_ SG_ 3221225472 Temperature5_05 "Temperature (Thermistor) 5";
CM_ SG_ 3221225472 Temperature6_05 "Temperature (Thermistor) 6";
CM_ SG_ 3221225472 Temperature7_05 "Temperature (Thermistor) 7";
CM_ SG_ 3221225472 Temperature1_04 "Temperature (Thermistor) 1";
CM_ SG_ 3221225472 Temperature2_04 "Temperature (Thermistor) 2";
CM_ SG_ 3221225472 Temperature3_04 "Temperature (Thermistor) 3";
CM_ SG_ 3221225472 Temperature4_04 "Temperature (Thermistor) 4";
CM_ SG_ 3221225472 Temperature5_04 "Temperature (Thermistor) 5";
CM_ SG_ 3221225472 Temperature6_04 "Temperature (Thermistor) 6";
CM_ SG_ 3221225472 Temperature7_04 "Temperature (Thermistor) 7";
CM_ SG_ 3221225472 Temperature1_03 "Temperature (Thermistor) 1 ";
CM_ SG_ 3221225472 Temperature2_03 "Temperature (Thermistor)2";
CM_ SG_ 3221225472 Temperature3_03 "Temperature (Thermistor) 3";
CM_ SG_ 3221225472 Temperature4_03 "Temperature (Thermistor) 4";
CM_ SG_ 3221225472 Temperature5_03 "Temperature (Thermistor) 5";
CM_ SG_ 3221225472 Temperature6_03 "Temperature (Thermistor) 6";
CM_ SG_ 3221225472 Temperature7_03 "Temperature (Thermistor) 7";
CM_ SG_ 3221225472 Temperature8_14 "Temperature (Thermistor) 8";
CM_ SG_ 3221225472 Temperature9_14 "Temperature (Thermistor) 9";
CM_ SG_ 3221225472 Temperature10_14 "Temperature (Thermistor) 10";
CM_ SG_ 3221225472 Temperature11_14 "Temperature (Thermistor) 11";
CM_ SG_ 3221225472 Temperature12_14 "Temperature (Thermistor) 12";
CM_ SG_ 3221225472 Temperature13_14 "Temperature (Thermistor) 13";
CM_ SG_ 3221225472 Temperature14_14 "Temperature (Thermistor) 14";
CM_ SG_ 3221225472 Temperature8_13 "Temperature (Thermistor) 8";
CM_ SG_ 3221225472 Temperature9_13 "Temperature (Thermistor) 9";
CM_ SG_ 3221225472 Temperature10_13 "Temperature (Thermistor) 10";
CM_ SG_ 3221225472 Temperature11_13 "Temperature (Thermistor) 11";
CM_ SG_ 3221225472 Temperature12_13 "Temperature (Thermistor) 12";
CM_ SG_ 3221225472 Temperature13_13 "Temperature (Thermistor) 13";
CM_ SG_ 3221225472 Temperature14_13 "Temperature (Thermistor) 14";
CM_ SG_ 3221225472 Temperature8_12 "Temperature (Thermistor) 8";
CM_ SG_ 3221225472 Temperature9_12 "Temperature (Thermistor) 9";
CM_ SG_ 3221225472 Temperature10_12 "Temperature (Thermistor) 10";
CM_ SG_ 3221225472 Temperature11_12 "Temperature (Thermistor) 11";
CM_ SG_ 3221225472 Temperature12_12 "Temperature (Thermistor) 12";
CM_ SG_ 3221225472 Temperature13_12 "Temperature (Thermistor) 13";
CM_ SG_ 3221225472 Temperature14_12 "Temperature (Thermistor) 14";
CM_ SG_ 3221225472 Temperature8_11 "Temperature (Thermistor) 8";
CM_ SG_ 3221225472 Temperature9_11 "Temperature (Thermistor) 9";
CM_ SG_ 3221225472 Temperature10_11 "Temperature (Thermistor) 10";
CM_ SG_ 3221225472 Temperature11_11 "Temperature (Thermistor) 11";
CM_ SG_ 3221225472 Temperature12_11 "Temperature (Thermistor) 12";
CM_ SG_ 3221225472 Temperature13_11 "Temperature (Thermistor) 13";
CM_ SG_ 3221225472 Temperature14_11 "Temperature (Thermistor) 14";
CM_ SG_ 3221225472 Temperature8_10 "Temperature (Thermistor) 8";
CM_ SG_ 3221225472 Temperature9_10 "Temperature (Thermistor) 9";
CM_ SG_ 3221225472 Temperature10_10 "Temperature (Thermistor) 10";
CM_ SG_ 3221225472 Temperature11_10 "Temperature (Thermistor) 11";
CM_ SG_ 3221225472 Temperature12_10 "Temperature (Thermistor) 12";
CM_ SG_ 3221225472 Temperature13_10 "Temperature (Thermistor) 13";
CM_ SG_ 3221225472 Temperature14_10 "Temperature (Thermistor) 14";
CM_ SG_ 3221225472 Temperature8_09 "Temperature (Thermistor) 8";
CM_ SG_ 3221225472 Temperature9_09 "Temperature (Thermistor) 9";
CM_ SG_ 3221225472 Temperature10_09 "Temperature (Thermistor) 10";
CM_ SG_ 3221225472 Temperature11_09 "Temperature (Thermistor) 11";
CM_ SG_ 3221225472 Temperature12_09 "Temperature (Thermistor) 12";
CM_ SG_ 3221225472 Temperature13_09 "Temperature (Thermistor) 13";
CM_ SG_ 3221225472 Temperature14_09 "Temperature (Thermistor) 14";
CM_ SG_ 3221225472 Temperature8_08 "Temperature (Thermistor) 8";
CM_ SG_ 3221225472 Temperature9_08 "Temperature (Thermistor) 9";
CM_ SG_ 3221225472 Temperature10_08 "Temperature (Thermistor) 10";
CM_ SG_ 3221225472 Temperature11_08 "Temperature (Thermistor) 11";
CM_ SG_ 3221225472 Temperature12_08 "Temperature (Thermistor) 12";
CM_ SG_ 3221225472 Temperature13_08 "Temperature (Thermistor) 13";
CM_ SG_ 3221225472 Temperature14_08 "Temperature (Thermistor) 14";
CM_ SG_ 3221225472 Temperature8_07 "Temperature (Thermistor) 8";
CM_ SG_ 3221225472 Temperature9_07 "Temperature (Thermistor) 9";
CM_ SG_ 3221225472 Temperature10_07 "Temperature (Thermistor) 10";
CM_ SG_ 3221225472 Temperature11_07 "Temperature (Thermistor) 11";
CM_ SG_ 3221225472 Temperature12_07 "Temperature (Thermistor) 12
";
CM_ SG_ 3221225472 Temperature13_07 "Temperature (Thermistor) 13";
CM_ SG_ 3221225472 Temperature14_07 "Temperature (Thermistor) 14";
CM_ SG_ 3221225472 Temperature8_06 "Temperature (Thermistor) 8";
CM_ SG_ 3221225472 Temperature9_06 "Temperature (Thermistor) 9";
CM_ SG_ 3221225472 Temperature10_06 "Temperature (Thermistor) 10";
CM_ SG_ 3221225472 Temperature11_06 "Temperature (Thermistor) 11";
CM_ SG_ 3221225472 Temperature12_06 "Temperature (Thermistor) 12";
CM_ SG_ 3221225472 Temperature13_06 "Temperature (Thermistor) 13";
CM_ SG_ 3221225472 Temperature14_06 "Temperature (Thermistor) 14";
CM_ SG_ 3221225472 Temperature8_05 "Temperature (Thermistor) 8";
CM_ SG_ 3221225472 Temperature9_05 "Temperature (Thermistor) 9";
CM_ SG_ 3221225472 Temperature10_05 "Temperature (Thermistor) 10";
CM_ SG_ 3221225472 Temperature11_05 "Temperature (Thermistor) 11";
CM_ SG_ 3221225472 Temperature12_05 "Temperature (Thermistor) 12";
CM_ SG_ 3221225472 Temperature13_05 "Temperature (Thermistor) 13";
CM_ SG_ 3221225472 Temperature14_05 "Temperature (Thermistor) 14";
CM_ SG_ 3221225472 Temperature8_04 "Temperature (Thermistor) 8";
CM_ SG_ 3221225472 Temperature9_04 "Temperature (Thermistor) 9";
CM_ SG_ 3221225472 Temperature10_04 "Temperature (Thermistor) 10";
CM_ SG_ 3221225472 Temperature11_04 "Temperature (Thermistor) 11";
CM_ SG_ 3221225472 Temperature12_04 "Temperature (Thermistor) 12";
CM_ SG_ 3221225472 Temperature13_04 "Temperature (Thermistor) 13";
CM_ SG_ 3221225472 Temperature14_04 "Temperature (Thermistor) 14";
CM_ SG_ 3221225472 Temperature8_03 "Temperature (Thermistor) 8";
CM_ SG_ 3221225472 Temperature9_03 "Temperature (Thermistor) 9";
CM_ SG_ 3221225472 Temperature10_03 "Temperature (Thermistor) 10";
CM_ SG_ 3221225472 Temperature11_03 "Temperature (Thermistor) 11";
CM_ SG_ 3221225472 Temperature12_03 "Temperature (Thermistor) 12";
CM_ SG_ 3221225472 Temperature13_03 "Temperature (Thermistor) 13";
CM_ SG_ 3221225472 Temperature14_03 "Temperature (Thermistor) 14
";
CM_ SG_ 3221225472 VoltageCell1_14 "Voltage (Cell) 1";
CM_ SG_ 3221225472 VoltageCell2_14 "Voltage (Cell) 2";
CM_ SG_ 3221225472 VoltageCell3_14 "Voltage (Cell) 3";
CM_ SG_ 3221225472 VoltageCell4_14 "Voltage (Cell) 4";
CM_ SG_ 3221225472 VoltageCell1_13 "Voltage (Cell) 1";
CM_ SG_ 3221225472 VoltageCell2_13 "Voltage (Cell) 2";
CM_ SG_ 3221225472 VoltageCell3_13 "Voltage (Cell) 3";
CM_ SG_ 3221225472 VoltageCell4_13 "Voltage (Cell) 4";
CM_ SG_ 3221225472 VoltageCell1_12 "Voltage (Cell) 1";
CM_ SG_ 3221225472 VoltageCell2_12 "Voltage (Cell) 2";
CM_ SG_ 3221225472 VoltageCell3_12 "Voltage (Cell) 4";
CM_ SG_ 3221225472 VoltageCell4_12 "Voltage (Cell) 4";
CM_ SG_ 3221225472 VoltageCell1_11 "Voltage (Cell) 1";
CM_ SG_ 3221225472 VoltageCell2_11 "Voltage (Cell) 2";
CM_ SG_ 3221225472 VoltageCell3_11 "Voltage (Cell) 3";
CM_ SG_ 3221225472 VoltageCell4_11 "Voltage (Cell) 4";
CM_ SG_ 3221225472 VoltageCell1_10 "Voltage (Cell) 1";
CM_ SG_ 3221225472 VoltageCell2_10 "Voltage (Cell) 2";
CM_ SG_ 3221225472 VoltageCell3_10 "Voltage (Cell) 3";
CM_ SG_ 3221225472 VoltageCell4_10 "Voltage (Cell) 4";
CM_ SG_ 3221225472 VoltageCell1_09 "Voltage (Cell) 1";
CM_ SG_ 3221225472 VoltageCell2_09 "Voltage (Cell) 2";
CM_ SG_ 3221225472 VoltageCell3_09 "Voltage (Cell) 4";
CM_ SG_ 3221225472 VoltageCell4_09 "Voltage (Cell) 4";
CM_ SG_ 3221225472 VoltageCell1_08 "Voltage (Cell) 1";
CM_ SG_ 3221225472 VoltageCell2_08 "Voltage (Cell) 2";
CM_ SG_ 3221225472 VoltageCell3_08 "Voltage (Cell) 3";
CM_ SG_ 3221225472 VoltageCell4_08 "Voltage (Cell) 4";
CM_ SG_ 3221225472 VoltageCell1_07 "Voltage (Cell) 1";
CM_ SG_ 3221225472 VoltageCell2_07 "Voltage (Cell) 2";
CM_ SG_ 3221225472 VoltageCell3_07 "Voltage (Cell) 3";
CM_ SG_ 3221225472 VoltageCell4_07 "Voltage (Cell) 4";
CM_ SG_ 3221225472 VoltageCell1_06 "Voltage (Cell) 1";
CM_ SG_ 3221225472 VoltageCell2_06 "Voltage (Cell) 2";
CM_ SG_ 3221225472 VoltageCell3_06 "Voltage (Cell) 3";
CM_ SG_ 3221225472 VoltageCell4_06 "Voltage (Cell) 4";
CM_ SG_ 3221225472 VoltageCell1_05 "Voltage (Cell) 1";
CM_ SG_ 3221225472 VoltageCell2_05 "Voltage (Cell) 2";
CM_ SG_ 3221225472 VoltageCell3_05 "Voltage (Cell) 3";
CM_ SG_ 3221225472 VoltageCell4_05 "Voltage (Cell) 4";
CM_ SG_ 3221225472 VoltageCell1_04 "Voltage (Cell) 1";
CM_ SG_ 3221225472 VoltageCell2_04 "Voltage (Cell) 2";
CM_ SG_ 3221225472 VoltageCell3_04 "Voltage (Cell) 3";
CM_ SG_ 3221225472 VoltageCell4_04 "Voltage (Cell) 4";
CM_ SG_ 3221225472 VoltageCell1_03 "Voltage (Cell) 1";
CM_ SG_ 3221225472 VoltageCell2_03 "Voltage (Cell) 2";
CM_ SG_ 3221225472 VoltageCell3_03 "Voltage (Cell) 3";
CM_ SG_ 3221225472 VoltageCell4_03 "Voltage (Cell) 4";
CM_ SG_ 3221225472 VoltageCell9_14 "Voltage (Cell) 9";
CM_ SG_ 3221225472 VoltageCell10_14 "Voltage (Cell) 10";
CM_ SG_ 3221225472 VoltageCell11_14 "Voltage (Cell) 11";
CM_ SG_ 3221225472 VoltageCell12_14 "Voltage (Cell) 12";
CM_ SG_ 3221225472 VoltageCell9_13 "Voltage (Cell) 9";
CM_ SG_ 3221225472 VoltageCell10_13 "Voltage (Cell) 10";
CM_ SG_ 3221225472 VoltageCell11_13 "Voltage (Cell) 11";
CM_ SG_ 3221225472 VoltageCell12_13 "Voltage (Cell) 12";
CM_ SG_ 3221225472 VoltageCell9_12 "Voltage (Cell) 9";
CM_ SG_ 3221225472 VoltageCell10_12 "Voltage (Cell) 10";
CM_ SG_ 3221225472 VoltageCell11_12 "Voltage (Cell) 11";
CM_ SG_ 3221225472 VoltageCell12_12 "Voltage (Cell) 12";
CM_ SG_ 3221225472 VoltageCell9_11 "Voltage (Cell) 9";
CM_ SG_ 3221225472 VoltageCell10_11 "Voltage (Cell) 10";
CM_ SG_ 3221225472 VoltageCell11_11 "Voltage (Cell) 11";
CM_ SG_ 3221225472 VoltageCell12_11 "Voltage (Cell) 12";
CM_ SG_ 3221225472 VoltageCell9_10 "Voltage (Cell) 9";
CM_ SG_ 3221225472 VoltageCell10_10 "Voltage (Cell) 10";
CM_ SG_ 3221225472 VoltageCell11_10 "Voltage (Cell) 11";
CM_ SG_ 3221225472 VoltageCell12_10 "Voltage (Cell) 12";
CM_ SG_ 3221225472 VoltageCell9_09 "Voltage (Cell) 9";
CM_ SG_ 3221225472 VoltageCell10_09 "Voltage (Cell) 10";
CM_ SG_ 3221225472 VoltageCell11_09 "Voltage (Cell) 11";
CM_ SG_ 3221225472 VoltageCell12_09 "Voltage (Cell) 12";
CM_ SG_ 3221225472 VoltageCell9_08 "Voltage (Cell) 9";
CM_ SG_ 3221225472 VoltageCell10_08 "Voltage (Cell) 10";
CM_ SG_ 3221225472 VoltageCell11_08 "Voltage (Cell) 11";
CM_ SG_ 3221225472 VoltageCell12_08 "Voltage (Cell) 12";
CM_ SG_ 3221225472 VoltageCell9_07 "Voltage (Cell) 9";
CM_ SG_ 3221225472 VoltageCell10_07 "Voltage (Cell) 10";
CM_ SG_ 3221225472 VoltageCell11_07 "Voltage (Cell) 11";
CM_ SG_ 3221225472 VoltageCell12_07 "Voltage (Cell) 12";
CM_ SG_ 3221225472 VoltageCell9_06 "Voltage (Cell) 9";
CM_ SG_ 3221225472 VoltageCell10_06 "Voltage (Cell) 10";
CM_ SG_ 3221225472 VoltageCell11_06 "Voltage (Cell) 11";
CM_ SG_ 3221225472 VoltageCell12_06 "Voltage (Cell) 12";
CM_ SG_ 3221225472 VoltageCell9_05 "Voltage (Cell) 9";
CM_ SG_ 3221225472 VoltageCell10_05 "Voltage (Cell) 10";
CM_ SG_ 3221225472 VoltageCell11_05 "Voltage (Cell) 11";
CM_ SG_ 3221225472 VoltageCell12_05 "Voltage (Cell) 12";
CM_ SG_ 3221225472 VoltageCell9_04 "Voltage (Cell) 9";
CM_ SG_ 3221225472 VoltageCell10_04 "Voltage (Cell) 10";
CM_ SG_ 3221225472 VoltageCell11_04 "Voltage (Cell) 11";
CM_ SG_ 3221225472 VoltageCell12_04 "Voltage (Cell) 12";
CM_ SG_ 3221225472 VoltageCell9_03 "Voltage (Cell) 9";
CM_ SG_ 3221225472 VoltageCell10_03 "Voltage (Cell) 10";
CM_ SG_ 3221225472 VoltageCell11_03 "Voltage (Cell) 11";
CM_ SG_ 3221225472 VoltageCell12_03 "Voltage (Cell) 12";
CM_ SG_ 3221225472 ChargeMode1 "0=cc,253=CV,251=terminate ";
CM_ SG_ 3221225472 HighestCMATemperature_14 "Highest CMA Temperature";
CM_ SG_ 3221225472 LowestCMATemperature_14 "Lowest CMA Temperature";
CM_ SG_ 3221225472 AverageCMATemperature_14 "Average CMA Temperature";
CM_ SG_ 3221225472 OverrideCommand_01 "Clear [Permanent] Fault ->  If Byte 1=207 (HEX CF), clear any permanent faults.
Disable Alarm ->   If Byte 1=218 (HEX DA), overide an active BMS alarm and sets ALARM = NO until key-cycled or until Byte 1=0 (resume normal operation).
Disable Fault ->  If Byte 1=223 (HEX DF), overide an active BMS fault and alarm and sets FAULT, ALARM = NO until key-cycled or until Byte 1=0 (resume normal operation).
Force [Contactor] Break ->  If Byte 1=251 (HEX FB), force turn-off (open) the contactor until key-cycled or until Byte 1=0 (resume normal operation).
Force [Contactor] Closed -> If Byte 1=252 (HEX FC), force turn-on (close) the contactor until key-cycled or until Byte 1=0 (resume normal operation).";
CM_ SG_ 3221225472 OverrideCommand_02 "Clear [Permanent] Fault -> If Byte 1=207 (HEX CF), clear any permanent faults.
Disable Alarm -> If Byte 1=218 (HEX DA), overide an active BMS alarm and sets ALARM = NO until key-cycled or until Byte 1=0 (resume normal operation).
Disable Fault -> If Byte 1=223 (HEX DF), overide an active BMS fault and alarm and sets FAULT, ALARM = NO until key-cycled or until Byte 1=0 (resume normal operation).
Force [Contactor] Break -> If Byte 1=251 (HEX FB), force turn-off (open) the contactor until key-cycled or until Byte 1=0 (resume normal operation).
Force [Contactor] Closed -> If Byte 1=252 (HEX FC), force turn-on (close) the contactor until key-cycled or until Byte 1=0 (resume normal operation). ";
BA_DEF_  "DBName" STRING ;
BA_DEF_ SG_  "SigType" ENUM  "Default","Range","RangeSigned","ASCII","Discrete","Control","ReferencePGN","DTC","StringDelimiter","StringLength","StringLengthControl","MessageCounter","MessageChecksum";
BA_DEF_ SG_  "GenSigSendType" ENUM  "Cyclic","OnWrite","OnWriteWithRepetition","OnChange","OnChangeWithRepetition","IfActive","IfActiveWithRepetition","NoSigSendType";
BA_DEF_ SG_  "GenSigILSupport" ENUM  "No","Yes";
BA_DEF_ SG_  "GenSigEVName" STRING ;
BA_DEF_ SG_  "SPN" INT 0 524287;
BA_DEF_ BO_  "GenMsgILSupport" ENUM  "No","Yes";
BA_DEF_ BO_  "GenMsgDelayTime" INT 0 1000;
BA_DEF_ BO_  "GenMsgRequestable" INT 0 1;
BA_DEF_ BO_  "GenMsgSendType" ENUM  "cyclic","NotUsed","NotUsed","NotUsed","NotUsed","NotUsed","NotUsed","IfActive","noMsgSendType";
BA_DEF_ BO_  "VFrameFormat" ENUM  "StandardCAN","ExtendedCAN","reserved","J1939PG";
BA_DEF_ BO_  "GenMsgCycleTime" INT 0 3600000;
BA_DEF_ BU_  "NmStationAddress" INT 0 255;
BA_DEF_  "SAE_J1939_DA_SpecVersion" STRING ;
BA_DEF_  "SAE_J1939_81_SpecVersion" STRING ;
BA_DEF_  "DatabaseVersion" STRING ;
BA_DEF_  "BusType" STRING ;
BA_DEF_  "ProtocolType" STRING ;
BA_DEF_  "SAE_J1939_75_SpecVersion" STRING ;
BA_DEF_  "SAE_J1939_21_SpecVersion" STRING ;
BA_DEF_  "SAE_J1939_73_SpecVersion" STRING ;
BA_DEF_  "SAE_J1939_71_SpecVersion" STRING ;
BA_DEF_DEF_  "DBName" "";
BA_DEF_DEF_  "SigType" "Default";
BA_DEF_DEF_  "GenSigSendType" "NoSigSendType";
BA_DEF_DEF_  "GenSigILSupport" "Yes";
BA_DEF_DEF_  "GenSigEVName" "Env@Nodename_@Signame";
BA_DEF_DEF_  "SPN" 0;
BA_DEF_DEF_  "GenMsgILSupport" "Yes";
BA_DEF_DEF_  "GenMsgDelayTime" 0;
BA_DEF_DEF_  "GenMsgRequestable" 1;
BA_DEF_DEF_  "GenMsgSendType" "noMsgSendType";
BA_DEF_DEF_  "VFrameFormat" "J1939PG";
BA_DEF_DEF_  "GenMsgCycleTime" 0;
BA_DEF_DEF_  "NmStationAddress" 254;
BA_DEF_DEF_  "SAE_J1939_DA_SpecVersion" "";
BA_DEF_DEF_  "SAE_J1939_81_SpecVersion" "";
BA_DEF_DEF_  "DatabaseVersion" "";
BA_DEF_DEF_  "BusType" "";
BA_DEF_DEF_  "ProtocolType" "";
BA_DEF_DEF_  "SAE_J1939_75_SpecVersion" "";
BA_DEF_DEF_  "SAE_J1939_21_SpecVersion" "";
BA_DEF_DEF_  "SAE_J1939_73_SpecVersion" "";
BA_DEF_DEF_  "SAE_J1939_71_SpecVersion" "";
BA_ "SAE_J1939_DA_SpecVersion" "2017-01";
BA_ "SAE_J1939_81_SpecVersion" "2017-01";
BA_ "DatabaseVersion" "10.0";
BA_ "BusType" "CAN";
BA_ "ProtocolType" "J1939";
BA_ "SAE_J1939_75_SpecVersion" "2017-01";
BA_ "SAE_J1939_21_SpecVersion" "2017-01";
BA_ "SAE_J1939_73_SpecVersion" "2017-01";
BA_ "SAE_J1939_71_SpecVersion" "2017-01";
BA_ "DBName" "J1939";
BA_ "SAE_J1939_DA_SpecVersion" "2017-01";
BA_ "SAE_J1939_81_SpecVersion" "2017-01";
BA_ "DatabaseVersion" "10.0";
BA_ "BusType" "CAN";
BA_ "ProtocolType" "J1939";
BA_ "SAE_J1939_75_SpecVersion" "2017-01";
BA_ "SAE_J1939_21_SpecVersion" "2017-01";
BA_ "SAE_J1939_73_SpecVersion" "2017-01";
BA_ "SAE_J1939_71_SpecVersion" "2017-01";
BA_ "DBName" "J1939";
BA_ "SAE_J1939_DA_SpecVersion" "2017-01";
BA_ "SAE_J1939_81_SpecVersion" "2017-01";
BA_ "DatabaseVersion" "10.0";
BA_ "BusType" "CAN";
BA_ "ProtocolType" "J1939";
BA_ "SAE_J1939_75_SpecVersion" "2017-01";
BA_ "SAE_J1939_21_SpecVersion" "2017-01";
BA_ "SAE_J1939_73_SpecVersion" "2017-01";
BA_ "SAE_J1939_71_SpecVersion" "2017-01";
BA_ "DBName" "J1939";
BA_ "SAE_J1939_DA_SpecVersion" "2017-01";
BA_ "SAE_J1939_81_SpecVersion" "2017-01";
BA_ "DatabaseVersion" "10.0";
BA_ "BusType" "CAN";
BA_ "ProtocolType" "J1939";
BA_ "SAE_J1939_75_SpecVersion" "2017-01";
BA_ "SAE_J1939_21_SpecVersion" "2017-01";
BA_ "SAE_J1939_73_SpecVersion" "2017-01";
BA_ "SAE_J1939_71_SpecVersion" "2017-01";
BA_ "DBName" "J1939";
